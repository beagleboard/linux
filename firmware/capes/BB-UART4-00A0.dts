/*
 * Copyright (C) 2013 CircuitCo
 *
 * Virtual cape for UART4 on connector pins P9.13 P9.11
 *
 * This program is free software; you can redistribute it and/or modify
 * it under the terms of the GNU General Public License version 2 as
 * published by the Free Software Foundation.
 */
/dts-v1/;
/plugin/;

/ {
	compatible = "ti,beaglebone", "ti,beaglebone-black";

	/* identification */
	part-number = "BB-UART4";
	version = "00A0";

	/* state the resources this cape uses */
	exclusive-use =
		/* the pin header uses */
		"P9.13",	/* uart4_txd */
		"P9.11",	/* uart4_rxd */
		/* the hardware ip uses */
		"uart4";

	fragment@0 {
		target = <&am33xx_pinmux>;
		__overlay__ {
			bb_uart4_pins: pinmux_bb_uart4_pins {
				pinctrl-single,pins = <
					0x070 0x26	/* gpmc_wait0.uart4_rxd | MODE6 */
					0x074 0x06	/* gpmc_wpn.uart4_txd | MODE6 */
				>;
			};
		};
	};

	fragment@1 {
		target = <&uart5>;	/* really uart4 */
		__overlay__ {
			status = "okay";
			pinctrl-names = "default";
			pinctrl-0 = <&bb_uart4_pins>;
		};
	};
};
