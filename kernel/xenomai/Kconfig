## lib/math/Kconfig
```kconfig
# SPDX-License-Identifier: GPL-2.0-only
config CORDIC
	tristate "CORDIC algorithm"
	help
	  This option provides an implementation of the CORDIC algorithm;
	  calculations are in fixed point. Module will be called cordic.

config PRIME_NUMBERS
	tristate "Simple prime number generator for testing"
	help
	  This option provides a simple prime number generator for test
	  modules.

	  If unsure, say N.

config RATIONAL
	tristate

config MATH_KUNIT_TEST
	tristate "KUnit test for math helper functions"
	depends on KUNIT
	default KUNIT_ALL_TESTS

	help
	  This builds unit test for math helper functions as defined in lib/math
	  and math.h.

	  For more information on KUNIT and unit tests in general, please refer
	  to the KUnit documentation in Documentation/dev-tools/kunit/.

	  If unsure, say N.
```

## net/rpmsg/Kconfig
```kconfig
# SPDX-License-Identifier: GPL-2.0
#
# RPMsg Sockets
#

config RPMSG_PROTO
	tristate "RPMsg Sockets over virtio-rpmsg transport"
	default n
	depends on RPMSG_VIRTIO
	depends on REMOTEPROC
	help
	  An rpmsg driver that provides support for remote processor messaging
	  sockets over the virtio rpmsg transport. This exposes a socket
	  interface to user space to allow applications to communicate with
	  various remote processors over this transport. This is currently
	  designed to work with the TI IPC stack on various available TI SoCs,
	  but can be generalized easily enough.

	  If unsure, say N.
```

## sound/arm/Kconfig
```kconfig
# ALSA ARM drivers

menuconfig SND_ARM
	bool "ARM sound devices"
	depends on ARM
	default y
	help
	  Support for sound devices specific to ARM architectures.
	  Drivers that are implemented on ASoC can be found in
	  "ALSA for SoC audio support" section.

if SND_ARM

config SND_SA11XX_UDA1341
	tristate "SA11xx UDA1341TS driver (iPaq H3600)"
	depends on ARCH_SA1100 && L3
	select SND_PCM
	help
	  Say Y here if you have a Compaq iPaq H3x00 handheld computer
	  and want to use its Philips UDA 1341 audio chip.

	  To compile this driver as a module, choose M here: the module
	  will be called snd-sa11xx-uda1341.

config SND_ARMAACI
	tristate "ARM PrimeCell PL041 AC Link support"
	depends on ARM_AMBA
	select SND_PCM
	select SND_AC97_CODEC

config SND_PXA2XX_PCM
	tristate
	select SND_PCM

config SND_PXA2XX_LIB
	tristate
	select SND_AC97_CODEC if SND_PXA2XX_LIB_AC97

config SND_PXA2XX_LIB_AC97
	bool

config SND_PXA2XX_AC97
	tristate "AC97 driver for the Intel PXA2xx chip"
	depends on ARCH_PXA
	select SND_PXA2XX_PCM
	select SND_AC97_CODEC
	select SND_PXA2XX_LIB
	select SND_PXA2XX_LIB_AC97
	help
	  Say Y or M if you want to support any AC97 codec attached to
	  the PXA2xx AC97 interface.

config SND_OMAP_AIC23
	tristate "OMAP AIC23 alsa driver (osk5912)"
	depends on ARCH_OMAP && SND
	select SND_PCM
	#select I2C
	#select I2C_OMAP if ARCH_OMAP
	select SENSORS_TLV320AIC23
	help
	  Say Y here if you have a OSK platform board
	  and want to use its AIC23 audio chip.

	  To compile this driver as a module, choose M here: the module
	  will be called snd-omap-aic23.
	  
config SND_OMAP_TSC2101
 	tristate "OMAP TSC2101 alsa driver"
 	depends on ARCH_OMAP && SND
 	select SND_PCM
         select SPI_TSC2101
 	help
 	  Say Y here if you have a OMAP platform board
 	  and want to use its TSC2101 audio chip. Driver has
 	  been tested with H2 and iPAQ h6300.
 
 	  To compile this driver as a module, choose M here: the module
 	  will be called snd-omap-tsc2101.

config SND_SX1
 	tristate "Siemens SX1 Egold alsa driver"
 	depends on ARCH_OMAP && SND
 	select SND_PCM
 	help
 	  Say Y here if you have a OMAP310 based Siemens SX1.

 	  To compile this driver as a module, choose M here: the module
 	  will be called snd-omap-sx1.

config SND_OMAP_TSC2102
 	tristate "OMAP TSC2102 alsa driver"
 	depends on ARCH_OMAP && SND
 	select SND_PCM
	select SPI_TSC2102
 	help
 	  Say Y here if you have an OMAP platform board
 	  and want to use its TSC2102 audio chip.

 	  To compile this driver as a module, choose M here: the module
 	  will be called snd-omap-tsc2102.

config SND_OMAP24XX_EAC
	tristate "Audio driver for OMAP24xx EAC"
	depends on SND
	help
	  Audio driver for Enhanced Audio Controller found in TI's OMAP24xx
	  processors.

	  Currently contains only low-level support functions for
	  initializing EAC HW, creating ALSA sound card instance for it
	  and registering mixer controls implemented by a codec driver.
	  PCM stream is expected to be under DSP co-processor control.

	  To compile this driver as a module, choose M here: the module
	  will be called snd-omap24xx-eac.

endif	# SND_ARM
```

## sound/soc/ctag/Kconfig
```kconfig
config  SND_DAVINCI_SOC_CTAG_FACE_2_4
        tristate "SoC Audio Support for CTAG face-2-4 Audio Card (AD1938)"
        depends on SND_SOC_DAVINCI_MCASP
        select SND_SOC_AD193X_SPI
        help
          Say Y if you want to add support for CTAG face-2-4 Audio Card
```

## sound/soc/thead/Kconfig
```kconfig
# SPDX-License-Identifier: GPL-2.0-only

config SND_SOC_THEAD_LIGHT
        tristate "Light audio i2s Driver Support"
	select SND_SOC_GENERIC_DMAENGINE_PCM
	default n
        help
          Say Y or M if you want to add support for codecs attached to the
          SND_SOCTHEAD_LIGHT interface

config SND_SOC_AW87519
	tristate "SoC Audio for awinic AW87519 Smart K PA"
	select SND_SOC_GENERIC_DMAENGINE_PCM
	depends on I2C
	help
	  This option enables support for AW87519 Smart K PA.
```

## sound/soc/ti/Kconfig
```kconfig
menu "Audio support for Texas Instruments SoCs"
depends on DMA_OMAP || TI_EDMA || TI_K3_NAVSS_UDMA || (ARM && COMPILE_TEST)

config SND_SOC_TI_EDMA_PCM
	tristate
	select SND_SOC_GENERIC_DMAENGINE_PCM

config SND_SOC_TI_SDMA_PCM
	tristate
	select SND_DMAENGINE_PCM

config SND_SOC_TI_UDMA_PCM
	tristate
	select SND_SOC_GENERIC_DMAENGINE_PCM

comment "Texas Instruments DAI support for:"
config SND_SOC_TI_MCASP
	tristate "TI Multichannel Audio Serial Port (McASP) support"
	select SND_SOC_TI_EDMA_PCM if TI_EDMA
	select SND_SOC_TI_SDMA_PCM if DMA_OMAP
	select SND_SOC_TI_UDMA_PCM if TI_K3_NAVSS_UDMA
	help
	  Say Y or M here if you want to have support for McASP IP found in
	  various Texas Instruments SoCs like:
	  - daVinci devices
	  - Sitara line of SoCs (AM335x, AM438x, etc)
	  - DRA7x devices
	  - Keystone devices
	  - AM65x devices

config SND_SOC_DAVINCI_ASP
	tristate "TI daVinci Audio Serial Port (ASP) or McBSP suport"
	depends on ARCH_DAVINCI
	select SND_SOC_TI_EDMA_PCM
	help
	  Say Y or M here if you want audio support via daVinci ASP or McBSP.
	  The driver only implements the ASP support which is a subset of
	  daVinci McBSP (w/o the multichannel support).

config SND_SOC_DAVINCI_VCIF
	tristate "TI daVinci Voice Interface (VCIF) suport"
	depends on ARCH_DAVINCI
	select SND_SOC_TI_EDMA_PCM
	help
	  Say Y or M here if you want audio support via daVinci VCIF.

config SND_SOC_OMAP_DMIC
	tristate "TI Digital Microphone Module (DMIC) support"
	depends on (ARCH_OMAP4 || SOC_OMAP5) && DMA_OMAP
	select SND_SOC_TI_SDMA_PCM
	help
	  Say Y or M here if you want to have support for DMIC IP found in
	  OMAP4 and OMAP5.

config SND_SOC_OMAP_HDMI
	tristate "SoC Audio support for OMAP4/5 HDMI"
	depends on (ARCH_OMAP4 || SOC_OMAP5) && DMA_OMAP
	select SND_SOC_TI_SDMA_PCM
	help
	  For HDMI audio to work OMAPDSS HDMI support should be
	  enabled.
	  The hdmi audio driver implements cpu-dai component using the
	  callbacks provided by OMAPDSS and registers the component
	  under DSS HDMI device. Omap-pcm is registered for platform
	  component also under DSS HDMI device. Dummy codec is used as
	  as codec component. The hdmi audio driver implements also
	  the card and registers it under its own platform device.
	  The device for the driver is registered by OMAPDSS hdmi
	  driver.

config SND_SOC_OMAP_MCBSP
	tristate "TI Multichannel Buffered Serial Port (McBSP) support"
	depends on (ARCH_OMAP || ARCH_OMAP1) && DMA_OMAP
	select SND_SOC_TI_SDMA_PCM
	help
	  Say Y or M here if you want to have support for McBSP IP found in
	  Texas Instruments OMAP1/2/3/4/5 SoCs.

config SND_SOC_OMAP_MCPDM
	tristate "TI Multichannel PDM Controller (McPDM) support"
	depends on (ARCH_OMAP4 || SOC_OMAP5) && DMA_OMAP
	select SND_SOC_TI_SDMA_PCM
	help
	  Say Y or M here if you want to have support for McPDM IP found in
	  OMAP4 and OMAP5.

comment "Audio support for boards with Texas Instruments SoCs"
config SND_SOC_NOKIA_N810
	tristate "SoC Audio support for Nokia N810"
	depends on MACH_NOKIA_N810 && I2C && OMAP_MUX
	select SND_SOC_OMAP_MCBSP
	select SND_SOC_TLV320AIC3X
	help
	  Say Y or M if you want to add support for SoC audio on Nokia N810.

config SND_SOC_NOKIA_RX51
	tristate "SoC Audio support for Nokia RX-51"
	depends on ARM && (MACH_NOKIA_RX51 || COMPILE_TEST) && I2C && GPIOLIB
	select SND_SOC_OMAP_MCBSP
	select SND_SOC_TLV320AIC3X
	select SND_SOC_TPA6130A2
	help
	  Say Y or M if you want to add support for SoC audio on Nokia RX-51
	  hardware. This is also known as Nokia N900 product.

config SND_SOC_AMS_DELTA
	tristate "SoC Audio support for Amstrad E3 (Delta) videophone"
	depends on MACH_AMS_DELTA && TTY
	select SND_SOC_OMAP_MCBSP
	select SND_SOC_CX20442
	help
	  Say Y  or M if you want to add support  for SoC audio device 
	  connected to a handset and a speakerphone found on Amstrad E3 (Delta)
	  videophone.

	  Note that in order to get those devices fully supported,  you have to
	  build  the kernel  with  standard  serial port  driver  included  and
	  configured for at least 4 ports.  Then, from userspace, you must load
	  a line discipline #19 on the modem (ttyS3) serial line.  The simplest
	  way to achieve this is to install util-linux-ng  and use the included
	  ldattach  utility.  This  can be  started  automatically  from  udev,
	  a simple rule like this one should do the trick (it does for me):
	  	ACTION=="add", KERNEL=="controlC0", \
				RUN+="/usr/sbin/ldattach 19 /dev/ttyS3"

config SND_SOC_OMAP_OSK5912
	tristate "SoC Audio support for omap osk5912"
	depends on MACH_OMAP_OSK && I2C
	select SND_SOC_OMAP_MCBSP
	select SND_SOC_TLV320AIC23_I2C
	help
	  Say Y or M if you want to add support for SoC audio on osk5912.

config SND_SOC_AM3517EVM
	tristate "SoC Audio support for OMAP3517 / AM3517 EVM"
	depends on MACH_OMAP3517EVM && I2C
	select SND_SOC_OMAP_MCBSP
	select SND_SOC_TLV320AIC23_I2C
	help
	  Say Y or M if you want to add support for SoC audio on the
	  OMAP3517 / AM3517 EVM.

config SND_SOC_OMAP_TWL4030
	tristate "SoC Audio support for TI SoC based boards with twl4030 codec"
	depends on TWL4030_CORE && DMA_OMAP
	select SND_SOC_OMAP_MCBSP
	select SND_SOC_TWL4030
	help
	  Say Y or M if you want to add support for SoC audio on TI SoC based
	  boards using twl4030 as c codec. This driver currently supports:
	  - Beagleboard or Devkit8000
	  - Gumstix Overo or CompuLab CM-T35/CM-T3730
	  - IGEP v2
	  - OMAP3EVM
	  - SDP3430
	  - Zoom2

config SND_SOC_OMAP_ABE_TWL6040
	tristate "SoC Audio support for OMAP boards using ABE and twl6040 codec"
	depends on TWL6040_CORE && (ARCH_OMAP4 || SOC_OMAP5 || COMPILE_TEST)
	select SND_SOC_OMAP_DMIC
	select SND_SOC_OMAP_MCPDM
	select SND_SOC_OMAP_DMIC
	select SND_SOC_TWL6040
	help
	  Say Y or M if you want to add support for SoC audio on OMAP boards
	  using ABE and twl6040 codec. This driver currently supports:
	  - SDP4430/Blaze boards
	  - PandaBoard (4430)
	  - PandaBoardES (4460)

config SND_SOC_OMAP_OMAP3_PANDORA
	tristate "SoC Audio support for OMAP3 Pandora"
	depends on TWL4030_CORE && MACH_OMAP3_PANDORA
	select SND_SOC_OMAP_MCBSP
	select SND_SOC_TWL4030
	help
	  Say Y or M if you want to add support for SoC audio on the OMAP3 Pandora.

endmenu
```
