## drivers/pci/endpoint/Kconfig
```kconfig
#
# PCI Endpoint Support
#

menu "PCI Endpoint"

config PCI_ENDPOINT
	tristate "PCI Endpoint Support"
	select CONFIGFS_FS
	help
	   Enable this configuration option to support configurable PCI
	   endpoint. This should be enabled if the platform has a PCI
	   controller that can operate in endpoint mode.

	   Enabling this option will build the endpoint library, which
	   includes endpoint controller library and endpoint function
	   library. This will also enable the configfs entry required to
	   configure the endpoint function and used to bind the
	   function with a endpoint controller.

	   If in doubt, say "N" to disable Endpoint support.

source "drivers/pci/endpoint/functions/Kconfig"

endmenu
```

## drivers/phy/synopsys/Kconfig
```kconfig
#SPDX-License-Identifier: GPL-2.0-only

config PHY_DW_DPHY
	tristate "Synopsys DesignWare MIPI D-PHY Support"
	depends on HAS_IOMEM && OF
	select GENERIC_PHY
	select GENERIC_PHY_MIPI_DPHY
	help
	  Choose this option if you have DesignWare D-PHY in your system.
	  If M is selected, the module will be called dw-dphy.
```

## drivers/pinctrl/thead/Kconfig
```kconfig
# SPDX-License-Identifier: GPL-2.0-only
config PINCTRL_LIGHT
	bool "T-head light pinctrl driver"
	depends on SOC_THEAD
	select GENERIC_PINCTRL_GROUPS
	select GENERIC_PINMUX_FUNCTIONS
	select GENERIC_PINCONF
	default y
	help
	  Say Y here to enable the T-head light pinctrl driver
```

## drivers/power/voltdm/Kconfig
```kconfig
config VOLTAGE_DOMAIN
	bool
	depends on COMMON_CLK && OF && PM_OPP
	default y if COMMON_CLK
	---help---
	  Core voltage domain framework using common clock framework's
	  notifier mechanism.

menu "Voltage Domain Framework Drivers"
	depends on VOLTAGE_DOMAIN

config VOLTAGE_DOMAIN_OMAP
	tristate "TI OMAP Voltage domain driver"
	---help---
	  Voltage domain support for OMAP platforms which need
	  vdd regulator and Adaptive Body Bias(ABB) regulator
	  support

endmenu
```

## drivers/pwm/Kconfig
```kconfig
#
# PWM infrastructure and devices
#

menuconfig GENERIC_PWM
	tristate "PWM Support"
	default n
	help
	  Enables PWM device support implemented via a generic
	  framework.  If unsure, say N.

config DAVINCI_EHRPWM
	bool "Davinci eHRPWM support"
	select HAVE_PWM
	depends on GENERIC_PWM && ARCH_DAVINCI_DA850
	help
	  This option enables support for eHRPWM driver. If
	  unsure, say N.
```

## drivers/remoteproc/Kconfig
```kconfig
menu "Remoteproc drivers"

# REMOTEPROC gets selected by whoever wants it
config REMOTEPROC
	tristate
	depends on HAS_DMA
	select CRC32
	select FW_LOADER
	select VIRTIO
	select VIRTUALIZATION

config OMAP_REMOTEPROC
	tristate "OMAP remoteproc support"
	depends on HAS_DMA
	depends on ARCH_OMAP4 || SOC_OMAP5 || SOC_DRA7XX
	depends on OMAP_IOMMU
	select REMOTEPROC
	select MAILBOX
	select OMAP2PLUS_MBOX
	select RPMSG
	help
	  Say y here to support OMAP's remote processors (dual M3
	  and DSP on OMAP4) via the remote processor framework.

	  Currently only supported on OMAP4.

	  Usually you want to say y here, in order to enable multimedia
	  use-cases to run on your platform (multimedia codecs are
	  offloaded to remote DSP processors using this framework).

	  It's safe to say n here if you're not interested in multimedia
	  offloading or just want a bare minimum kernel.

config OMAP_REMOTEPROC_WATCHDOG
	bool "OMAP remoteproc watchdog timer"
	depends on OMAP_REMOTEPROC
	default n
	help
	  Say Y here to enable watchdog timer for remote processors.

	  This option controls the watchdog functionality for the remote
	  processors in OMAP. Dedicated OMAP DMTimers are used by the remote
	  processors and triggers the timer interrupt upon a watchdog
	  detection.

config STE_MODEM_RPROC
	tristate "STE-Modem remoteproc support"
	depends on HAS_DMA
	select REMOTEPROC
	default n
	help
	  Say y or m here to support STE-Modem shared memory driver.
	  This can be either built-in or a loadable module.
	  If unsure say N.

config WKUP_M3_RPROC
	tristate "AMx3xx Wakeup M3 remoteproc support"
	depends on SOC_AM33XX || SOC_AM43XX
	select REMOTEPROC
	help
	  Say y here to support Wakeup M3 remote processor on TI AM33xx
	  and AM43xx family of SoCs.

	  Required for Suspend-to-RAM on AM33xx and AM43xx SoCs. Also needed
	  for deep CPUIdle states on AM33xx SoCs. Allows for loading of the
	  firmware onto these remote processors.
	  If unsure say N.

config DA8XX_REMOTEPROC
	tristate "DA8xx/OMAP-L13x remoteproc support"
	depends on ARCH_DAVINCI_DA8XX
	select CMA if MMU
	select REMOTEPROC
	select RPMSG
	help
	  Say y here to support DA8xx/OMAP-L13x remote processors via the
	  remote processor framework.

	  You want to say y here in order to enable AMP
	  use-cases to run on your platform (multimedia codecs are
	  offloaded to remote DSP processors using this framework).

	  This module controls the name of the firmware file that gets
	  loaded on the DSP.  This file must reside in the /lib/firmware
	  directory.  It can be specified via the module parameter
	  da8xx_fw_name=<filename>, and if not specified will default to
	  "rproc-dsp-fw".

	  It's safe to say n here if you're not interested in multimedia
	  offloading.

config PRUSS_REMOTEPROC
	tristate "TI PRUSS remoteproc support"
	depends on HAS_DMA
	depends on SOC_AM33XX || SOC_AM43XX || SOC_DRA7XX || ARCH_KEYSTONE
	select REMOTEPROC
	select MAILBOX
	select OMAP2PLUS_MBOX if ARCH_OMAP2PLUS
	select RPMSG
	default n
	help
	  Support for TI PRU-ICSS remote processors via the remote processor
	  framework.

	  Currently supported on AM33xx SoCs.

	  Say Y or M here to support the Programmable Realtime Unit (PRU)
	  processors on various TI SoCs. It's safe to say N here if you're
	  not interested in the PRU or if you are unsure.
	  If unsure say N.

config KEYSTONE_REMOTEPROC
	tristate "Keystone Remoteproc support"
	depends on ARCH_KEYSTONE
	depends on RESET_CONTROLLER
	depends on UIO
	select REMOTEPROC
	select RPMSG
	help
	  Say y here here to support Keystone remote processors (DSP)
	  via the remote processor framework. The drivers support a user-land driven
	  interface to the remoteprocessor download

	  It's safe to say n here if you're not interested in multimedia
	  offloading or just want a bare minimum kernel.

endmenu
```

## drivers/reset/Kconfig
```kconfig
config ARCH_HAS_RESET_CONTROLLER
	bool

menuconfig RESET_CONTROLLER
	bool "Reset Controller Support"
	default y if ARCH_HAS_RESET_CONTROLLER
	help
	  Generic Reset Controller support.

	  This framework is designed to abstract reset handling of devices
	  via GPIOs or SoC-internal reset controller modules.

	  If unsure, say no.

config SYSCON_RESET
	tristate "SYSCON Reset Driver"
	depends on RESET_CONTROLLER
	depends on HAS_IOMEM
	select MFD_SYSCON
	help
	  This enables the reset driver support for devices with memory-mapped
	  reset registers as part of a syscon device node. If you wish to use
	  the reset framework for such memory-mapped devices, say Y here.
	  Otherwise, say N.

config TI_SCI_RESET
	tristate "TI System Control Interface (TI-SCI) reset driver"
	depends on RESET_CONTROLLER
	depends on TI_SCI_PROTOCOL
	help
	  This enables the reset driver support over TI System Control Interface
	  for TI's Keystone family of SoCs. If you wish to use reset resources
	  managed by the TI System Controller, say Y here. Otherwise, say N.

source "drivers/reset/sti/Kconfig"
```

## drivers/rpmsg-kdrv/Kconfig
```kconfig
# SPDX-License-Identifier: GPL-2.0

menu "Rpmsg virtual device drivers"

# RPMSG always gets selected by whoever wants it
config RPMSG_KDRV
	tristate "RPMSG virtual device interface"
	select RPMSG
	help
	  Say Y here enable support for RPMSG based remote devices, usually
	  exported by a firmware running rpmsg stack and remote_device stack.
	  This feature enables the framework for para-virtualizing entire H/W
	  or specific resources of a hardware

endmenu
```

## drivers/rpmsg/Kconfig
```kconfig
# SPDX-License-Identifier: GPL-2.0

menu "Rpmsg drivers"

# RPMSG always gets selected by whoever wants it
config RPMSG
	tristate

config RPMSG_CHAR
	tristate "RPMSG device interface"
	depends on RPMSG
	depends on NET
	help
	  Say Y here to export rpmsg endpoints as device files, usually found
	  in /dev. They make it possible for user-space programs to send and
	  receive rpmsg packets.

config RPMSG_QCOM_GLINK_NATIVE
	tristate
	select RPMSG

config RPMSG_QCOM_GLINK_RPM
	tristate "Qualcomm RPM Glink driver"
        select RPMSG_QCOM_GLINK_NATIVE
	depends on HAS_IOMEM
	depends on MAILBOX
	help
	  Say y here to enable support for the GLINK RPM communication driver,
	  which serves as a channel for communication with the RPM in GLINK
	  enabled systems.

config RPMSG_QCOM_GLINK_SMEM
	tristate "Qualcomm SMEM Glink driver"
	select RPMSG_QCOM_GLINK_NATIVE
	depends on MAILBOX
	depends on QCOM_SMEM
	help
	  Say y here to enable support for the GLINK SMEM communication driver,
	  which provides support for using the GLINK communication protocol
	  over SMEM.

config RPMSG_QCOM_SMD
	tristate "Qualcomm Shared Memory Driver (SMD)"
	depends on MAILBOX
	depends on QCOM_SMEM
	select RPMSG
	help
	  Say y here to enable support for the Qualcomm Shared Memory Driver
	  providing communication channels to remote processors in Qualcomm
	  platforms.

config RPMSG_VIRTIO
	tristate "Virtio RPMSG bus driver"
	depends on HAS_DMA
	select RPMSG
	select VIRTIO

config RPMSG_RPC
	tristate "rpmsg Remote Procedure Call driver"
	default n
	depends on RPMSG_VIRTIO
	depends on REMOTEPROC
	depends on OMAP_REMOTEPROC
	select DMA_SHARED_BUFFER
	help
	  An rpmsg driver that exposes the Remote Procedure Call API to
	  user space, in order to allow applications to distribute
	  remote calls to more power-efficient remote processors. This is
	  currently available only on OMAP4+ systems.

config RPMSG_PRU
	tristate "PRU RPMsg Communication driver"
	depends on RPMSG_VIRTIO
	depends on REMOTEPROC
	depends on PRU_REMOTEPROC
	help
	  An rpmsg driver that exposes interfaces to user space, to allow
	  applications to communicate with the PRU processors on available
	  TI SoCs. This is restricted to SoCs that have the PRUSS remoteproc
	  support.

	  If unsure, say N.

endmenu
```

## drivers/rstctl/Kconfig
```kconfig
#
# RSTCTL infrastructure and drivers
#

menuconfig RSTCTL
	bool "Reset control subsystem"
	help
	  Select this to enable the reset control subsystem

if RSTCTL

config RSTCTL_GPIO
	tristate "GPIO reset driver"
	depends on RSTCTL
	help
	  This selects the GPIO based reset driver

config RSTCTL_TEST
	tristate "Test reset driver"
	depends on RSTCTL
	help
	  This selects the test reset driver

config RSTCTL_TEST_CONSUMER
	tristate "Test reset consumer driver"
	depends on RSTCTL
	help
	  This select the test reset consumer driver

endif
```

## drivers/soc/thead/Kconfig
```kconfig
# SPDX-License-Identifier: GPL-2.0-only
if SOC_THEAD || COMPILE_TEST

menu "Thead SoC drivers"

config LIGHT_IOPMP
	tristate "Thead light iopmp support"
	default y
	help
	  This driver supports Light IOPMP built-in for security system.

config LIGHT_SUSPEND
	bool "Thead light system suspend support"
	depends on PM
	default n
	help
	 This driver supports system suspend low power feature in Light FM platform

endmenu

endif
```

## drivers/soc/ti/Kconfig
```kconfig
# 64-bit ARM SoCs from TI
if ARM64

if ARCH_K3

config ARCH_K3_AM6_SOC
	bool "K3 AM6 SoC"
	help
	  Enable support for TI's AM6 SoC Family support

config ARCH_K3_J721E_SOC
	bool "K3 J721E SoC"
	help
	  Enable support for TI's J721E SoC Family support

endif

endif

#
# TI SOC drivers
#
menuconfig SOC_TI
	bool "TI SOC drivers support"

if SOC_TI

config KEYSTONE_DSP_MEM
	tristate "TI Keystone DSP Memory Mapping Driver"
	depends on ARCH_KEYSTONE
	help
	  Userspace memory mapping interface driver for TI Keystone SoCs.
	  Provides access to MSM SRAM memory regions and dedicated DDR
	  carveout memory regions to user space to aid userspace loading
	  of the DSPs within the SoC.

	  If unsure, say N.

config KEYSTONE_NAVIGATOR_QMSS
	tristate "Keystone Queue Manager Sub System"
	depends on ARCH_KEYSTONE
	help
	  Say y here to support the Keystone multicore Navigator Queue
	  Manager support. The Queue Manager is a hardware module that
	  is responsible for accelerating management of the packet queues.
	  Packets are queued/de-queued by writing/reading descriptor address
	  to a particular memory mapped location in the Queue Manager module.

	  If unsure, say N.

config KEYSTONE_NAVIGATOR_DMA
	tristate "TI Keystone Navigator Packet DMA support"
	depends on ARCH_KEYSTONE
	help
	  Say y tp enable support for the Keystone Navigator Packet DMA on
	  on Keystone family of devices. It sets up the dma channels for the
	  Queue Manager Sub System.

	  If unsure, say N.

config AMX3_PM
	tristate "AMx3 Power Management"
	depends on SOC_AM33XX || SOC_AM43XX
	depends on WKUP_M3_IPC && TI_EMIF_SRAM && SRAM && RTC_DRV_OMAP
	help
	  Enable power management on AM335x and AM437x. Required for suspend to mem
	  and standby states on both AM335x and AM437x platforms and for deeper cpuidle
	  c-states on AM335x. Also required for rtc and ddr in self-refresh low
	  power mode on AM437x platforms.

config WKUP_M3_IPC
	tristate "TI AMx3 Wkup-M3 IPC Driver"
	depends on WKUP_M3_RPROC
	depends on OMAP2PLUS_MBOX
	help
	  TI AM33XX and AM43XX have a Cortex M3, the Wakeup M3, to handle
	  low power transitions. This IPC driver provides the necessary API
	  to communicate and use the Wakeup M3 for PM features like suspend
	  resume and boots it using wkup_m3_rproc driver.

config TI_SCI_PM_DOMAINS
	tristate "TI SCI PM Domains Driver"
	depends on TI_SCI_PROTOCOL
	depends on PM_GENERIC_DOMAINS
	help
	  Generic power domain implementation for TI device implementing
	  the TI SCI protocol.

	  To compile this as a module, choose M here. The module will be
	  called ti_sci_pm_domains. Note this is needed early in boot before
	  rootfs may be available.

config TI_PRUSS
	tristate "TI PRU-ICSS Subsystem Platform drivers"
	depends on SOC_AM33XX || SOC_AM43XX || SOC_DRA7XX || ARCH_KEYSTONE || ARCH_K3
	select MFD_SYSCON
	help
	  TI PRU-ICSS Subsystem platform specific support.

	  Say Y or M here to support the Programmable Realtime Unit (PRU)
	  processors on various TI SoCs. It's safe to say N here if you're
	  not interested in the PRU or if you are unsure.

config TI_K3_RINGACC
	tristate "K3 Ring accelerator Sub System"
	depends on ARCH_K3 || COMPILE_TEST
	default y
	help
	  Say y here to support the K3 Ring accelerator module.
	  The Ring Accelerator (RINGACC or RA)  provides hardware acceleration
	  to enable straightforward passing of work between a producer
	  and a consumer. There is one RINGACC module per NAVSS on TI AM65x SoCs
	  If unsure, say N.

config TI_K3_RINGACC_DEBUG
	tristate "K3 Ring accelerator Sub System tests and debug"
	depends on TI_K3_RINGACC
	default n

config TI_K3_UDMA_DESC_POOL
	tristate "K3 CPPI5 DMA descriptors pool"
	depends on ARCH_K3
	help
	  Say y here to enable support for creating and maintaining a
	  pool of descriptors usable with CPPI5 DMA. Such pools are
	  required for networking usecases.

config TI_PAT
	tristate "TI PAT DMA-BUF exporter"
	depends on ARCH_K3
	select REGMAP
	help
	  Driver for TI Page-based Address Translator (PAT). This driver
	  provides the an API allowing the remapping of a non-contiguous
	  DMA-BUF into a contiguous one that is sutable for devices needing
	  contiguous memory.

endif # SOC_TI
```
