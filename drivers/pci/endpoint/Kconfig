## drivers/ssi/Kconfig
```kconfig
menu "Synchronous Serial Interfaces (SSI)"

config OMAP_UWIRE
	depends on ARCH_OMAP1
	tristate "MicroWire support on OMAP"
	---help---
	  Say Y here if you want support for the MicroWire interface
	  on an OMAP processor.

config OMAP_TSC2101
	depends on ARCH_OMAP1 || ARCH_OMAP24XX
	tristate "TSC2101 codec support for Touchscreen and audio"
	select OMAP_UWIRE if MACH_OMAP_H3 || MACH_OMAP_H2
	select GPIOEXPANDER_OMAP if MACH_OMAP_H3
	---help---
	  Say Y here if you want support for the TSC2101 codec.  It is
	  needed for touchscreen and audio on OMAP1610 and 1710.
endmenu
```

## drivers/staging/android/ion/Kconfig
```kconfig
# SPDX-License-Identifier: GPL-2.0
menuconfig ION
	bool "Ion Memory Manager"
	depends on HAS_DMA && MMU
	select GENERIC_ALLOCATOR
	select DMA_SHARED_BUFFER
	help
	  Choose this option to enable the ION Memory Manager,
	  used by Android to efficiently allocate buffers
	  from userspace that can be shared between drivers.
	  If you're not using Android its probably safe to
	  say N here.

source "drivers/staging/android/ion/heaps/Kconfig"

config ION_UNMAPPED_HEAP
	bool "ION unmapped heap support"
	depends on ION && (ARM || ARM64)
	help
	  Choose this option to enable UNMAPPED heaps with Ion. This heap is
	  backed in specific memory pools, carveout from the Linux memory.
	  Unless you know your system has these regions, you should say N here.

config ION_DUMMY_UNMAPPED_HEAP
	bool "ION dummy driver define an ION unmapped heap"
	depends on ION_UNMAPPED_HEAP
	help
	  Dummy ION driver will create a unmapped heap from physical
	  location provided through CONFIG_ION_DUMMY_UNMAPPED_BASE and
	  CONFIG_ION_DUMMY_UNMAPPED_SIZE.

config ION_DUMMY_UNMAPPED_BASE
	hex "Physical base address of the ION unmapped heap"
	depends on ION_DUMMY_UNMAPPED_HEAP
	default 0
	help
	  Allows one the statically define an unmapped heap from the
	  ION dummy driver to exercice unamped heaps buffer managment.

config ION_DUMMY_UNMAPPED_SIZE
	hex "Physical byte size of the ION unmapped heap"
	depends on ION_DUMMY_UNMAPPED_HEAP
	default 0
	help
	  Allows one the statically define an unmapped heap from the
	  ION dummy driver to exercice unamped heaps buffer managment.
```

## drivers/tee/optee/Kconfig
```kconfig
# SPDX-License-Identifier: GPL-2.0-only
# OP-TEE Trusted Execution Environment Configuration
config OPTEE
	tristate "OP-TEE"
	depends on HAVE_ARM_SMCCC || RISCV_SBI
	depends on MMU
	help
	  This implements the OP-TEE Trusted Execution Environment (TEE)
	  driver.

config OPTEE_SHM_NUM_PRIV_PAGES
	int "Private Shared Memory Pages"
	default 1
	depends on OPTEE
	help
	  This sets the number of private shared memory pages to be
	  used by OP-TEE TEE driver.

config OPTEE_BENCHMARK
	bool "OP-TEE Benchmark (EXPERIMENTAL)"
	depends on OPTEE
	help
	  This enables benchmarking feature in the OP-TEE Trusted
	  Execution Environment (TEE) driver.
```

## drivers/usb/musb/Kconfig
```kconfig
#
# USB Dual Role (OTG-ready) Controller Drivers
# for silicon based on Mentor Graphics INVENTRA designs
#

# (M)HDRC = (Multipoint) Highspeed Dual-Role Controller
config USB_MUSB_HDRC
	tristate 'Inventra Highspeed Dual Role Controller (TI, ADI, ...)'
	depends on USB && USB_GADGET
	select NOP_USB_XCEIV if (ARCH_DAVINCI || MACH_OMAP3EVM || BLACKFIN)
	select NOP_USB_XCEIV if (SOC_OMAPTI81XX || SOC_OMAPAM33XX)
	select TWL4030_USB if MACH_OMAP_3430SDP
	select TWL6030_USB if MACH_OMAP_4430SDP || MACH_OMAP4_PANDA
	select USB_OTG_UTILS
	select USB_GADGET_DUALSPEED
	help
	  Say Y here if your system has a dual role high speed USB
	  controller based on the Mentor Graphics silicon IP.  Then
	  configure options to match your silicon and the board
	  it's being used with, including the USB peripheral role,
	  or the USB host role, or both.

	  Texas Instruments familiies using this IP include DaVinci
	  (35x, 644x ...), OMAP 243x, OMAP 3, and TUSB 6010.

	  Analog Devices parts using this IP include Blackfin BF54x,
	  BF525 and BF527.

	  If you do not know what this is, please say N.

	  To compile this driver as a module, choose M here; the
	  module will be called "musb-hdrc".

if USB_MUSB_HDRC

comment "Platform Glue Layer"

config USB_MUSB_DAVINCI_GLUE
	select USB_MUSB_DAVINCI
	tristate "DaVinci"
	depends on ARCH_DAVINCI_DMx && USB_MUSB_HDRC

config USB_MUSB_DA8XX_GLUE
	select USB_MUSB_DA8XX
	tristate "DA8xx/OMAP-L1x"
	depends on ARCH_DAVINCI_DA8XX && USB_MUSB_HDRC

config USB_MUSB_TUSB6010_GLUE
	select USB_MUSB_TUSB6010
	tristate "TUSB6010"
	depends on ARCH_OMAP && USB_MUSB_HDRC

config USB_MUSB_OMAP2PLUS_GLUE
	select USB_MUSB_OMAP2PLUS
	tristate "OMAP2430 and onwards"
	depends on ARCH_OMAP2PLUS && USB_MUSB_HDRC

config USB_MUSB_AM35X_GLUE
	select USB_MUSB_AM35X
	tristate "AM35x"
	depends on ARCH_OMAP && USB_MUSB_HDRC

config USB_MUSB_TI81XX_GLUE
	select USB_MUSB_TI81XX
	tristate "TI81XX onward"
	depends on (SOC_OMAPTI81XX || SOC_OMAPAM33XX) && USB_MUSB_HDRC

config USB_MUSB_BLACKFIN_GLUE
	select USB_MUSB_BLACKFIN
	tristate "Blackfin"
	depends on (BF54x && !BF544) || (BF52x && ! BF522 && !BF523) && USB_MUSB_HDRC

config USB_MUSB_UX500_GLUE
	select USB_MUSB_UX500
	tristate "U8500 and U5500"
	depends on (ARCH_U8500 && AB8500_USB) && USB_MUSB_HDRC

config USB_MUSB_DAVINCI
	bool
	default n
config USB_MUSB_DA8XX
	bool
	default n
config USB_MUSB_TUSB6010
	bool
	default n
config USB_MUSB_OMAP2PLUS
	bool
	default n
config USB_MUSB_AM35X
	bool
	default n
config USB_MUSB_TI81XX
	bool
	default n
config USB_MUSB_BLACKFIN
	bool
	default n
config USB_MUSB_UX500
	bool
	default n

choice
	prompt 'MUSB DMA mode'
	depends on !MUSB_PIO_ONLY
	default USB_UX500_DMA_HW if USB_MUSB_UX500
	default USB_INVENTRA_DMA_HW if USB_MUSB_OMAP2PLUS || USB_MUSB_BLACKFIN
	default USB_TI_CPPI_DMA_HW if USB_MUSB_DAVINCI
	default USB_TUSB_OMAP_DMA_HW if USB_MUSB_TUSB6010
	default USB_TI_CPPI41_DMA_HW if USB_MUSB_DA8XX || USB_MUSB_AM35X || USB_MUSB_TI81XX
	help
	  Unfortunately, only one option can be enabled here. Ideally one
	  should be able to build all these drivers into one kernel to
	  allow using DMA on multiplatform kernels.

config USB_UX500_DMA_HW
	tristate 'ST Ericsson U8500 and U5500'
	select USB_UX500_DMA
	depends on USB_MUSB_UX500
	help
	  Enable DMA transfers on UX500 platforms.

config USB_INVENTRA_DMA_HW
	tristate 'Inventra'
	select USB_INVENTRA_DMA
	depends on (USB_MUSB_OMAP2PLUS || USB_MUSB_BLACKFIN) && !USB_MUSB_AM35X
	help
	  Enable DMA transfers using Mentor's engine.

config USB_TI_CPPI_DMA_HW
	tristate 'TI CPPI (Davinci)'
	select USB_TI_CPPI_DMA
	depends on USB_MUSB_DAVINCI
	help
	  Enable DMA transfers when TI CPPI DMA is available.

config USB_TI_CPPI41_DMA_HW
	tristate 'TI CPPI4.1'
	select USB_TI_CPPI41_DMA
	depends on USB_MUSB_DA8XX || USB_MUSB_AM35X || USB_MUSB_TI81XX
	select CPPI41
	help
	 Configure this option to include the CPPI 4.1 support,
	 The CPPI 4.1 DMA engine integrated with musb controller
	 accelarate the usb packet transmission and receception
	 to/from musb endpoints.

config USB_TUSB_OMAP_DMA_HW
	tristate 'TUSB 6010'
	select USB_TUSB_OMAP_DMA
	depends on USB_MUSB_TUSB6010
	depends on ARCH_OMAP
	help
	  Enable DMA transfers on TUSB 6010 when OMAP DMA is available.

endchoice

config MUSB_PIO_ONLY
	bool 'Disable DMA (always use PIO)'
	default USB_MUSB_TUSB6010 || USB_MUSB_DA8XX
	help
	  All data is copied between memory and FIFO by the CPU.
	  DMA controllers are ignored.

	  Do not choose this unless DMA support for your SOC or board
	  is unavailable (or unstable).  When DMA is enabled at compile time,
	  you can still disable it at run time using the "use_dma=n" module
	  parameter.

config USB_INVENTRA_DMA
	bool
	default n

config USB_TI_CPPI_DMA
	bool
	default n

config USB_TI_CPPI41_DMA
	bool
	default n

config USB_TUSB_OMAP_DMA
	bool
	default n

config USB_UX500_DMA
	bool
	default n

endif # USB_MUSB_HDRC
```

## drivers/video/omap/Kconfig
```kconfig
config FB_OMAP
	tristate "OMAP frame buffer support (EXPERIMENTAL)"
        depends on FB
	select FB_SOFT_CURSOR
        help
          Frame buffer driver for OMAP based boards.

config FB_OMAP_LCDC_INTERNAL
	bool "Internal LCD controller support"
	depends on FB_OMAP
	help
	  Say Y here, if you want to have support for the internal OMAP
	  LCD controller. If unsure, say Y.

config FB_OMAP_LCDC_EXTERNAL
	bool "External LCD controller support"
	depends on FB_OMAP
	help
	  Say Y here, if you want to have support for boards with an
	  external LCD controller connected to the SoSSI/RFBI interface. 

config FB_OMAP_MANUAL_UPDATE
	bool "Default to manual update mode"
	depends on FB_OMAP && FB_OMAP_LCDC_EXTERNAL
	help
	  Say Y here, if your user-space applications are capable of
	  notifying the frame buffer driver when a change has occured in
          the frame buffer content and thus a reload of the image data to
	  the external frame buffer is required. If unsure, say N.

config FB_OMAP_DMA_TUNE
        bool "Set DMA SDRAM access priority high"
        depends on FB_OMAP && ARCH_OMAP1
        help
          On systems in which video memory is in system memory
          (SDRAM) this will speed up graphics DMA operations.
          If you have such a system and want to use rotation
          answer yes. Answer no if you have a dedicated video
          memory, or don't use any of the accelerated features.
```

## drivers/xenomai/Kconfig
```kconfig
menu "Drivers"

config XENO_OPT_RTDM_COMPAT_DEVNODE
	bool "Enable legacy pathnames for named RTDM devices"
	default y
	help
	This compatibility option allows applications to open named
	RTDM devices using the legacy naming scheme, i.e.

	fd = open("devname", ...);
	   or
	fd = open("/dev/devname", ...);

	When such a request is received by RTDM, a warning message is
	issued to the kernel log whenever XENO_OPT_DEBUG_LEGACY is
	also enabled in the kernel configuration.

	Applications should open named devices via their actual device
	nodes instead, i.e.

	fd = open("/dev/rtdm/devname", ...);

source "drivers/xenomai/autotune/Kconfig"
source "drivers/xenomai/serial/Kconfig"
source "drivers/xenomai/testing/Kconfig"
source "drivers/xenomai/can/Kconfig"
source "drivers/xenomai/net/Kconfig"
source "drivers/xenomai/analogy/Kconfig"
source "drivers/xenomai/ipc/Kconfig"
source "drivers/xenomai/udd/Kconfig"
source "drivers/xenomai/gpio/Kconfig"
source "drivers/xenomai/gpiopwm/Kconfig"
source "drivers/xenomai/spi/Kconfig"

endmenu
```

## drivers/xenomai/analogy/Kconfig
```kconfig
menu "ANALOGY drivers"

config XENO_DRIVERS_ANALOGY
	tristate "ANALOGY interface"
	help

	ANALOGY is a framework aimed at supporting data acquisition
	devices.

config XENO_DRIVERS_ANALOGY_DEBUG
       depends on XENO_DRIVERS_ANALOGY
       bool "Analogy debug trace"
       default n
       help

       Enable debugging traces in Analogy so as to monitor Analogy's
       core and drivers behaviours.

config XENO_DRIVERS_ANALOGY_DEBUG_FTRACE
       depends on XENO_DRIVERS_ANALOGY_DEBUG
       bool "Analogy debug ftrace"
       default n
       help

       Route the Analogy a4l_dbg and a4l_info statements to /sys/kernel/debug/

config XENO_DRIVERS_ANALOGY_DEBUG_LEVEL
       depends on XENO_DRIVERS_ANALOGY_DEBUG
       int "Analogy core debug level threshold"
       default 0
       help

       Define the level above which the debugging traces will not be
       displayed.

       WARNING: this threshold is only applied on the Analogy
       core. That will not affect the driver.

config XENO_DRIVERS_ANALOGY_DRIVER_DEBUG_LEVEL
       depends on XENO_DRIVERS_ANALOGY_DEBUG
       int "Analogy driver debug level threshold"
       default 0
       help

       Define the level above which the debugging traces will not be
       displayed.

       WARNING: this threshold is only applied on the Analogy
       driver. That will not affect the core.

source "drivers/xenomai/analogy/testing/Kconfig"
source "drivers/xenomai/analogy/intel/Kconfig"
source "drivers/xenomai/analogy/national_instruments/Kconfig"
source "drivers/xenomai/analogy/sensoray/Kconfig"

endmenu
```

## drivers/xenomai/analogy/intel/Kconfig
```kconfig
config XENO_DRIVERS_ANALOGY_8255
	depends on XENO_DRIVERS_ANALOGY
	tristate "8255 driver"
	default n

config XENO_DRIVERS_ANALOGY_PARPORT
	depends on XENO_DRIVERS_ANALOGY && X86
	tristate "Standard parallel port driver"
	default n
```

## drivers/xenomai/analogy/national_instruments/Kconfig
```kconfig
config XENO_DRIVERS_ANALOGY_NI_MITE
	depends on XENO_DRIVERS_ANALOGY && PCI
	tristate "NI MITE driver"
	default n

config XENO_DRIVERS_ANALOGY_NI_TIO
	depends on XENO_DRIVERS_ANALOGY
	tristate "NI TIO driver"
	default n

config XENO_DRIVERS_ANALOGY_NI_MIO       
	depends on XENO_DRIVERS_ANALOGY && XENO_DRIVERS_ANALOGY_NI_TIO && PCI
	tristate "NI MIO driver"
	default n

config XENO_DRIVERS_ANALOGY_NI_PCIMIO       
	depends on XENO_DRIVERS_ANALOGY && PCI
	select XENO_DRIVERS_ANALOGY_NI_MITE
	select XENO_DRIVERS_ANALOGY_NI_TIO
	select XENO_DRIVERS_ANALOGY_NI_MIO
	select XENO_DRIVERS_ANALOGY_8255
	tristate "NI PCIMIO driver"
	default n

config XENO_DRIVERS_ANALOGY_NI_670x       
	depends on EXPERIMENTAL && XENO_DRIVERS_ANALOGY && PCI
	select XENO_DRIVERS_ANALOGY_NI_MITE
	select XENO_DRIVERS_ANALOGY_NI_TIO
	select XENO_DRIVERS_ANALOGY_NI_MIO
	select XENO_DRIVERS_ANALOGY_8255
	tristate "NI 670X driver (EXPERIMENTAL)"
	default n

config XENO_DRIVERS_ANALOGY_NI_660x       
	depends on EXPERIMENTAL && XENO_DRIVERS_ANALOGY && PCI
	select XENO_DRIVERS_ANALOGY_NI_MITE
	select XENO_DRIVERS_ANALOGY_NI_TIO
	select XENO_DRIVERS_ANALOGY_NI_MIO
	select XENO_DRIVERS_ANALOGY_8255
	tristate "NI 660X driver (EXPERIMENTAL)"
	default n
```

## drivers/xenomai/analogy/sensoray/Kconfig
```kconfig
config XENO_DRIVERS_ANALOGY_S526
	depends on XENO_DRIVERS_ANALOGY
	tristate "Sensoray Model 526 driver"
	default n
```

## drivers/xenomai/analogy/testing/Kconfig
```kconfig
config XENO_DRIVERS_ANALOGY_FAKE
	depends on XENO_DRIVERS_ANALOGY
	tristate "Fake driver"
	default n
	help

	The fake driver displays many subdevices:
	- 0: analog input;
	- 1: digital input / output;
	- 2: analog output;
	- 3: analog input; data written into the subdevice 2 can be
          read here.
```
