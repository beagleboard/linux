## drivers/xenomai/can/mscan/Kconfig
```kconfig
config XENO_DRIVERS_CAN_MSCAN
	depends on XENO_DRIVERS_CAN && (PPC_MPC52xx || PPC_MPC512x)
	tristate "MSCAN driver for MPC52xx and MPC512x"
	default n
	help

	This driver is for the MSCAN on the MPC5200 and MPC512x processor
	from Freescale.
```

## drivers/xenomai/can/sja1000/Kconfig
```kconfig
config XENO_DRIVERS_CAN_SJA1000
	depends on XENO_DRIVERS_CAN
	tristate "Philips SJA1000 CAN controller"
	select XENO_DRIVERS_CAN_BUS_ERR

config XENO_DRIVERS_CAN_SJA1000_ISA
	depends on XENO_DRIVERS_CAN_SJA1000
	tristate "Standard ISA controllers"
	help

	This driver is for CAN devices connected to the ISA bus of a PC
	or a PC/104 system. The I/O port, interrupt number and a few other
	hardware specific parameters can be defined via module parameters.

config XENO_DRIVERS_CAN_SJA1000_MEM
	depends on XENO_DRIVERS_CAN_SJA1000
	tristate "Memory mapped controllers"
	help

	This driver is for memory mapped CAN devices. The memory address,
	interrupt number and a few other hardware specific parameters can
	be defined via module parameters.

config XENO_DRIVERS_CAN_SJA1000_PEAK_PCI
	depends on XENO_DRIVERS_CAN_SJA1000 && PCI
	tristate "PEAK PCI Card"
	help

	This driver is for the PCAN PCI, the PC-PCI CAN plug-in card (1 or
	2 channel) from PEAK Systems (http://www.peak-system.com). To get
	the second channel working, Xenomai's shared interrupt support
	must be enabled.

config XENO_DRIVERS_CAN_SJA1000_IXXAT_PCI
	depends on XENO_DRIVERS_CAN_SJA1000 && PCI
	tristate "IXXAT PCI Card"
	help

	This driver is for the IXXAT PC-I 04/PCI card (1 or 2 channel)
	from the IXXAT Automation GmbH (http://www.ixxat.de). To get
	the second channel working, Xenomai's shared interrupt support
	must be enabled.

config XENO_DRIVERS_CAN_SJA1000_ADV_PCI
	depends on XENO_DRIVERS_CAN_SJA1000 && PCI
	tristate "ADVANTECH PCI Cards"
	help

	This driver is for the ADVANTECH PCI cards (1 or more channels)
	It supports the 1680U and some other ones.


config XENO_DRIVERS_CAN_SJA1000_PLX_PCI
	depends on XENO_DRIVERS_CAN_SJA1000 && PCI
	tristate "PLX90xx PCI-bridge based Cards"
	help

	This driver is for CAN interface cards based on
	the PLX90xx PCI bridge.
	Driver supports now:
	 - Adlink PCI-7841/cPCI-7841 card (http://www.adlinktech.com/)
	 - Adlink PCI-7841/cPCI-7841 SE card
	 - esd CAN-PCI/CPCI/PCI104/200 (http://www.esd.eu/)
	 - esd CAN-PCI/PMC/266
	 - esd CAN-PCIe/2000
	 - Marathon CAN-bus-PCI card (http://www.marathon.ru/)
	 - TEWS TECHNOLOGIES TPMC810 card (http://www.tews.com/)

config XENO_DRIVERS_CAN_SJA1000_EMS_PCI
	depends on XENO_DRIVERS_CAN_SJA1000 && PCI
	tristate "EMS CPC PCI Card"
	help

	This driver is for the 2 channel CPC PCI card from EMS Dr. Thomas
	Wünsche (http://www.ems-wuensche.de). To get the second channel
	working, Xenomai's shared interrupt support must be enabled.

config XENO_DRIVERS_CAN_SJA1000_ESD_PCI
	depends on XENO_DRIVERS_CAN_SJA1000 && PCI
	tristate "ESD PCI Cards (DEPRECATED)"
	help

	This driver supports the esd PCI CAN cards CAN-PCI/200,
	CAN-PCI/266, CAN-PMC/266 (PMC), CAN-CPCI/200 (CompactPCI),
	CAN-PCIe2000 (PCI Express) and CAN-PCI104/200 (PCI104)
	from the esd electronic system design gmbh (http://www.esd.eu).

	This driver is deprecated. It's functionality is now provided by
	"PLX90xx PCI-bridge based Cards" driver.

config XENO_DRIVERS_CAN_SJA1000_PEAK_DNG
	depends on XENO_DRIVERS_CAN_SJA1000 && !PARPORT
	tristate "PEAK Parallel Port Dongle"
	help

	This driver is for the PCAN Dongle, the PC parallel port to CAN
	converter from PEAK Systems (http://www.peak-system.com). You need
	to disable parallel port support in the kernel (CONFIG_PARPORT) for
	proper operation. The interface type (sp or epp), I/O port and
	interrupt number should be defined via module parameters.
```

## drivers/xenomai/gpio/Kconfig
```kconfig
menu "Real-time GPIO drivers"

config XENO_DRIVERS_GPIO
       bool "GPIO controller"
       depends on GPIOLIB
       help

       Real-time capable GPIO module.

if XENO_DRIVERS_GPIO

config XENO_DRIVERS_GPIO_BCM2835
	depends on MACH_BCM2708 || ARCH_BCM2835
	tristate "Support for BCM2835 GPIOs"
	help

	Enables support for the GPIO controller available from
	Broadcom's BCM2835 SoC.

config XENO_DRIVERS_GPIO_MXC
	depends on GPIO_MXC
	tristate "Support for MXC GPIOs"
	help

	Suitable for the GPIO controller available from
	Freescale/NXP's MXC architecture.

config XENO_DRIVERS_GPIO_SUN8I_H3
	depends on MACH_SUN8I && PINCTRL_SUN8I_H3
	tristate "Support for SUN8I H3 GPIOs"
	help

	Suitable for the GPIO controller available from Allwinner's H3
	SoC, as found on the NanoPI boards.

config XENO_DRIVERS_GPIO_ZYNQ7000
	depends on ARCH_ZYNQ || ARCH_ZYNQMP
	tristate "Support for Zynq7000 GPIOs"
	help

	Enables support for the GPIO controller available from
	Xilinx's Zynq7000 SoC.

config XENO_DRIVERS_GPIO_XILINX
	depends on ARCH_ZYNQ || ARCH_ZYNQMP
	tristate "Support for Xilinx GPIOs"
	help

	Enables support for the GPIO controller available from
	Xilinx's softcore IP.

config XENO_DRIVERS_GPIO_OMAP
	depends on ARCH_OMAP2PLUS || ARCH_OMAP
	tristate "Support for OMAP GPIOs"
	help

	Enables support for the GPIO controller available from
	OMAP family SOC.

config XENO_DRIVERS_GPIO_DEBUG
       bool "Enable GPIO core debugging features"

endif

endmenu
```

## drivers/xenomai/gpiopwm/Kconfig
```kconfig
menu "GPIOPWM support"

config XENO_DRIVERS_GPIOPWM
	tristate "GPIOPWM driver"
	help

	An RTDM-based GPIO PWM generator driver

endmenu
```

## drivers/xenomai/ipc/Kconfig
```kconfig
menu "Real-time IPC drivers"

config XENO_DRIVERS_RTIPC
	tristate "RTIPC protocol family"
	help

	This driver provides the real-time IPC protocol family
	(PF_RTIPC) over RTDM.

config XENO_DRIVERS_RTIPC_XDDP
	depends on XENO_DRIVERS_RTIPC
	select XENO_OPT_PIPE
	default y
	bool "XDDP cross-domain datagram protocol"
	help

	Xenomai's XDDP protocol enables threads to exchange datagrams
	across the Xenomai/Linux domain boundary, using "message
	pipes".

	Message pipes are bi-directional FIFO communication channels
	allowing data exchange between real-time Xenomai threads and
	regular (i.e. non real-time) user-space processes. Message
	pipes are datagram-based and thus natively preserve message
	boundaries, but they can also be used in byte stream mode when
	sending from the real-time to the non real-time domain.

	The maximum number of communication ports available in the
	system can be configured using the XENO_OPT_PIPE_NRDEV option
	from the Nucleus menu.

config XENO_DRIVERS_RTIPC_IDDP
	depends on XENO_DRIVERS_RTIPC
	select XENO_OPT_MAP
	default y
	bool "IDDP intra-domain datagram protocol"
	help

	Xenomai's IDDP protocol enables real-time threads to exchange
	datagrams within the Xenomai domain.

config XENO_OPT_IDDP_NRPORT
	depends on XENO_DRIVERS_RTIPC_IDDP
	int "Number of IDDP communication ports"
	default 32
	help

	This parameter defines the number of IDDP ports available in
	the system for creating receiver endpoints. Port numbers range
	from 0 to CONFIG_XENO_OPT_IDDP_NRPORT - 1.

config XENO_DRIVERS_RTIPC_BUFP
	depends on XENO_DRIVERS_RTIPC
	select XENO_OPT_MAP
	default y
	bool "Buffer protocol"
	help

	The buffer protocol implements a byte-oriented, one-way
	Producer-Consumer data path, which makes it a bit faster than
	datagram-oriented protocols. All messages written are buffered
	into a single memory area in strict FIFO order, until read by
	the consumer.

	This protocol prevents short writes, and only allows short
	reads when a potential deadlock situation arises (i.e. readers
	and writers waiting for each other indefinitely), which
	usually means that the buffer size does not fit the use peer
	threads are making from the protocol.

config XENO_OPT_BUFP_NRPORT
	depends on XENO_DRIVERS_RTIPC_BUFP
	int "Number of BUFP communication ports"
	default 32
	help

	This parameter defines the number of BUFP ports available in
	the system for creating receiver endpoints. Port numbers range
	from 0 to CONFIG_XENO_OPT_BUFP_NRPORT - 1.

endmenu
```

## drivers/xenomai/net/Kconfig
```kconfig
menu "RTnet"

config XENO_DRIVERS_NET
    depends on m
    select NET
    tristate "RTnet, TCP/IP socket interface"

if XENO_DRIVERS_NET

config XENO_DRIVERS_RTNET_CHECKED
    bool "Internal Bug Checks"
    default n
    ---help---
    Switch on if you face crashes when RTnet is running or if you suspect
    any other RTnet-related issues. This feature will add a few sanity
    checks at critical points that will produce warnings on the kernel
    console in case certain internal bugs are detected.

source "drivers/xenomai/net/stack/Kconfig"
source "drivers/xenomai/net/drivers/Kconfig"
source "drivers/xenomai/net/addons/Kconfig"

endif

endmenu
```

## drivers/xenomai/net/addons/Kconfig
```kconfig
menu "Add-Ons"
    depends on XENO_DRIVERS_NET

config XENO_DRIVERS_NET_ADDON_RTCAP
    depends on XENO_DRIVERS_NET && m
    select ETHERNET
    tristate "Real-Time Capturing Support"
    default n
    ---help---
    This feature allows to capture real-time packets traversing the RTnet
    stack. It can both be used to sniff passively on a network (in this
    case you may want to enable the promisc mode of your real-time NIC via
    rtifconfig) and to log the traffic the node receives and transmits
    during normal operation. RTcap consists of additional hooks in the
    RTnet stack and a separate module as interface to standard network
    analysis tools like Ethereal.

    For further information see Documentation/README.rtcap.

config XENO_DRIVERS_NET_ADDON_PROXY
    depends on XENO_DRIVERS_NET_RTIPV4 && m
    select ETHERNET
    tristate "IP protocol proxy for Linux"
    default n
    ---help---
    Enables a forward-to-Linux module for all IP protocols that are not
    handled by the IPv4 implemenation of RTnet (TCP, UDP, etc.). Only use
    when you know what you are doing - it can easily break your real-time
    requirements!

    See Documentation/README.rtnetproxy for further information.

config XENO_DRIVERS_NET_ADDON_PROXY_ARP
    depends on XENO_DRIVERS_NET_ADDON_PROXY
    bool "Enable ARP handling via protocol proxy"
    default n
    ---help---
    Enables ARP support for the IP protocol proxy. Incoming ARP replies
    are then delivered to both, the RTnet and the Linux network stack,
    but only answered by Linux. The IP protocol proxy gets attached to
    the RTnet device specified by the module parameter "rtdev_attach",
    rteth0 by default.

endmenu
```

## drivers/xenomai/net/drivers/Kconfig
```kconfig
menu "Drivers"
    depends on XENO_DRIVERS_NET

comment "Common PCI Drivers"
    depends on PCI

config XENO_DRIVERS_NET_DRV_PCNET32
    depends on XENO_DRIVERS_NET && PCI
    tristate "AMD PCnet32"


config XENO_DRIVERS_NET_DRV_TULIP
    depends on XENO_DRIVERS_NET && PCI
    tristate "DEC Tulip"


config XENO_DRIVERS_NET_DRV_EEPRO100
    depends on XENO_DRIVERS_NET && PCI
    tristate "Intel EtherExpress PRO/100"
    default y

config XENO_DRIVERS_NET_DRV_EEPRO100_CMDTIMEOUT
    depends on XENO_DRIVERS_NET && PCI
    int "Command Timeout"
    depends on XENO_DRIVERS_NET_DRV_EEPRO100
    default 20
    ---help---
    Timeout in microseconds of transmission or configuration commands that
    are issued in real-time contexts.

config XENO_DRIVERS_NET_DRV_EEPRO100_DBG
    depends on XENO_DRIVERS_NET && PCI
    bool "Enable debugging and instrumentation"
    depends on XENO_DRIVERS_NET_DRV_EEPRO100
    ---help---
    This option switches on internal debugging code of the EEPRO/100 driver.
    It also enables the collection of worst-case command delays in real-time
    contexts in order to reduce the command timeout (which, effectively, will
    also reduce the worst-case transmission latency).


config XENO_DRIVERS_NET_DRV_E1000
    depends on XENO_DRIVERS_NET && PCI
    tristate "Intel(R) PRO/1000 (Gigabit)"
    default y

config XENO_DRIVERS_NET_DRV_E1000E
    depends on XENO_DRIVERS_NET && PCI
    tristate "New Intel(R) PRO/1000 PCIe (Gigabit)"


config XENO_DRIVERS_NET_DRV_NATSEMI
    depends on XENO_DRIVERS_NET && PCI
    tristate "NatSemi"


config XENO_DRIVERS_NET_DRV_8139
    depends on XENO_DRIVERS_NET && PCI
    tristate "Realtek 8139"
    default y


config XENO_DRIVERS_NET_DRV_VIA_RHINE
    depends on XENO_DRIVERS_NET && PCI
    tristate "VIA Rhine"


config XENO_DRIVERS_NET_DRV_IGB
    select I2C
    select I2C_ALGOBIT
    depends on XENO_DRIVERS_NET && PCI
    tristate "Intel(R) 82575 (Gigabit)"


config XENO_DRIVERS_NET_DRV_R8169
    depends on XENO_DRIVERS_NET && PCI
    tristate "Realtek 8169 (Gigabit)"


if ARCH = ppc

comment "Embedded MPC Drivers"
    depends on XENO_DRIVERS_NET

config XENO_DRIVERS_NET_DRV_FCC_ENET
    depends on XENO_DRIVERS_NET
    tristate "MPC8260 FCC Ethernet"


config XENO_DRIVERS_NET_DRV_FEC_ENET
    depends on XENO_DRIVERS_NET
    tristate "MPC8xx FEC Ethernet"


config XENO_DRIVERS_NET_DRV_SCC_ENET
    depends on XENO_DRIVERS_NET
    tristate "MPC8xx SCC Ethernet"


config XENO_DRIVERS_NET_DRV_MPC52XX_FEC
    depends on XENO_DRIVERS_NET
    tristate "MPC52xx FEC Ethernet"

endif


comment "Misc Drivers"

config XENO_DRIVERS_NET_DRV_LOOPBACK
    depends on XENO_DRIVERS_NET
    tristate "Loopback"
    default y


config XENO_DRIVERS_NET_DRV_SMC91111
    depends on XENO_DRIVERS_NET
    tristate "SMSC LAN91C111"

if ARCH = arm

config XENO_DRIVERS_NET_DRV_AT91_ETHER
    depends on XENO_DRIVERS_NET && SOC_AT91RM9200
    select XENO_DRIVERS_NET_DRV_MACB
    tristate "AT91RM9200 Board Ethernet Driver"

config XENO_DRIVERS_NET_DRV_MACB
    depends on XENO_DRIVERS_NET && ARCH_AT91
    select AT91_PROGRAMMABLE_CLOCKS
    tristate "MACB AT91SAM926x devices"
    ---help---
    Driver for internal MAC-controller on AT91SAM926x microcontrollers.
    Porting by Cristiano Mantovani and Stefano Banzi (Marposs SpA).

endif

source "drivers/xenomai/net/drivers/experimental/Kconfig"

endmenu
```

## drivers/xenomai/net/drivers/experimental/Kconfig
```kconfig
config XENO_DRIVERS_NET_EXP_DRIVERS
    depends on XENO_DRIVERS_NET && PCI
    bool "Experimental Drivers"

if XENO_DRIVERS_NET_EXP_DRIVERS

config XENO_DRIVERS_NET_DRV_3C59X
    depends on PCI
    tristate "3Com 59x"

config XENO_DRIVERS_NET_DRV_E1000_NEW
    depends on PCI
    tristate "New Intel(R) PRO/1000 (Gigabit)"

source "drivers/xenomai/net/drivers/experimental/rt2500/Kconfig"

endif
```

## drivers/xenomai/net/drivers/experimental/rt2500/Kconfig
```kconfig
config XENO_DRIVERS_NET_DRV_RT2500
    depends on XENO_DRIVERS_NET && PCI
    tristate "Ralink 2500 WLAN"
    select XENO_DRIVERS_NET_RTWLAN
```

## drivers/xenomai/net/stack/Kconfig
```kconfig
menu "Protocol Stack"
    depends on XENO_DRIVERS_NET

comment "Stack parameters"

config XENO_DRIVERS_NET_RX_FIFO_SIZE
    int "Size of central RX-FIFO"
    depends on XENO_DRIVERS_NET
    default 32
    ---help---
    Size of FIFO between NICs and stack manager task. Must be power
    of two! Effectively, only CONFIG_RTNET_RX_FIFO_SIZE-1 slots will
    be usable.

config XENO_DRIVERS_NET_ETH_P_ALL
    depends on XENO_DRIVERS_NET
    bool "Support for ETH_P_ALL"
    ---help---
    Enables core support for registering listeners on all layer 3
    protocols (ETH_P_ALL). Internally this is currently realised by
    clone-copying incoming frames for those listners, future versions
    will implement buffer sharing for efficiency reasons. Use with
    care, every ETH_P_ALL-listener adds noticable overhead to the
    reception path.

config XENO_DRIVERS_NET_RTWLAN
    depends on XENO_DRIVERS_NET
    bool "Real-Time WLAN"
    ---help---
    Enables core support for real-time wireless LAN. RT-WLAN is based
    on low-level access to 802.11-compliant adapters and is currently
    in an experimental stage.

comment "Protocols"

source "drivers/xenomai/net/stack/ipv4/Kconfig"
source "drivers/xenomai/net/stack/packet/Kconfig"
source "drivers/xenomai/net/stack/rtmac/Kconfig"
source "drivers/xenomai/net/stack/rtcfg/Kconfig"

endmenu
```
