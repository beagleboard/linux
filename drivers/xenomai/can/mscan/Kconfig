## drivers/xenomai/net/stack/ipv4/Kconfig
```kconfig
config XENO_DRIVERS_NET_RTIPV4
    depends on XENO_DRIVERS_NET
    tristate "Real-Time IPv4"
    default y
    ---help---
    Enables the real-time capable IPv4 support of RTnet. The protocol is
    implemented as a separate module. Supplementing tools (rtroute,
    rtping) and examples are provided as well. Moreover, RTcfg will
    include IPv4 support when this option is switched on.

    For further information see also Documentation/README.routing and
    Documentation/README.ipfragmentation.

config XENO_DRIVERS_NET_RTIPV4_ICMP
    bool "ICMP support"
    depends on XENO_DRIVERS_NET_RTIPV4
    default y
    ---help---
    Enables ICMP support of the RTnet Real-Time IPv4 protocol.

    When the RTnet-Proxy is enabled while this feature is disabled, ICMP
    will be forwarded to the Linux network stack.

config XENO_DRIVERS_NET_RTIPV4_HOST_ROUTES
    int "Maximum host routing table entries"
    depends on XENO_DRIVERS_NET_RTIPV4
    default 32
    ---help---
    Each IPv4 supporting interface and each remote host that is directly
    reachable via via some output interface requires a host routing table
    entry. If you run larger networks with may hosts per subnet, you may
    have to increase this limit. Must be power of 2!

config XENO_DRIVERS_NET_RTIPV4_NETROUTING
    bool "IP Network Routing"
    depends on XENO_DRIVERS_NET_RTIPV4
    ---help---
    Enables routing across IPv4 real-time networks. You will only require
    this feature in complex networks, while switching it off for flat,
    single-segment networks improves code size and the worst-case routing
    decision delay.

    See Documentation/README.routing for further information.

config XENO_DRIVERS_NET_RTIPV4_NET_ROUTES
    int "Maximum network routing table entries"
    depends on XENO_DRIVERS_NET_RTIPV4_NETROUTING
    default 16
    ---help---
    Each route describing a target network reachable via a router
    requires an entry in the network routing table. If you run very
    complex realtime networks, you may have to increase this limit. Must
    be power of 2!

config XENO_DRIVERS_NET_RTIPV4_ROUTER
    bool "IP Router"
    depends on XENO_DRIVERS_NET_RTIPV4
    ---help---
    When switched on, the RTnet station will be able to forward IPv4
    packets that are not directed to the station itself. Typically used in
    combination with CONFIG_RTNET_RTIPV4_NETROUTING.

    See Documentation/README.routing for further information.

config XENO_DRIVERS_NET_RTIPV4_DEBUG
    bool "RTipv4 Debugging"
    depends on XENO_DRIVERS_NET_RTIPV4
    default n
    
    ---help---
    Enables debug message output of the RTipv4 layer. Typically, you
    may want to turn this on for tracing issues in packet delivery.

source "drivers/xenomai/net/stack/ipv4/udp/Kconfig"
source "drivers/xenomai/net/stack/ipv4/tcp/Kconfig"
```

## drivers/xenomai/net/stack/ipv4/tcp/Kconfig
```kconfig
config XENO_DRIVERS_NET_RTIPV4_TCP
    tristate "TCP support"
    depends on XENO_DRIVERS_NET_RTIPV4
    ---help---
    Enables TCP support of the RTnet Real-Time IPv4 protocol.

    When the RTnet IPv4 is enabled while this feature is disabled, TCP
    will be forwarded to the Linux network stack.

config XENO_DRIVERS_NET_RTIPV4_TCP_ERROR_INJECTION
    bool "TCP error injection"
    depends on XENO_DRIVERS_NET_RTIPV4_TCP
    ---help---
    Enables error injection for incoming TCP packets. This can be used
    to test both protocol as well as application behavior under error
    conditions. The per-socket error rate is 0 by default and can be
    tuned during runtime via the error_rate and multi_error module
    parameters.
```

## drivers/xenomai/net/stack/ipv4/udp/Kconfig
```kconfig
config XENO_DRIVERS_NET_RTIPV4_UDP
    tristate "UDP support"
    depends on XENO_DRIVERS_NET_RTIPV4
    default y
    ---help---
    Enables UDP support of the RTnet Real-Time IPv4 protocol.
```

## drivers/xenomai/net/stack/packet/Kconfig
```kconfig
config XENO_DRIVERS_NET_RTPACKET
    depends on XENO_DRIVERS_NET
    tristate "Real-Time Packet Socket Support"
    default y
    ---help---
    Enables real-time packet sockets for RTnet. This support is
    implemented in a separate module. When loaded, application programs
    can send and received so-called "cooked" packets directly at OSI layer
    2 (device layer). This means that RTnet will still maintain the
    device-dependent packet header but leave the full data segment to the
    user.

    Examples like raw-ethernet or netshm make use of this support. See
    also Linux man page packet(7).
```

## drivers/xenomai/net/stack/rtcfg/Kconfig
```kconfig
config XENO_DRIVERS_NET_RTCFG
    depends on XENO_DRIVERS_NET
    tristate "RTcfg Service"
    default y
    ---help---
    The Real-Time Configuration service configures and monitors nodes in
    a RTnet network. It works both with plain MAC as well as with IPv4
    addresses (in case CONFIG_RTNET_RTIPV4 has been switched on). RTcfg
    consists of a configuration server, which can run on the same station
    as the TDMA master e.g., and one or more clients. Clients can join and
    leave the network during runtime without interfering with other
    stations. Besides network configuration, the RTcfg server can also
    distribute custom data.

    See Documentation/README.rtcfg for further information.

config XENO_DRIVERS_NET_RTCFG_DEBUG
    bool "RTcfg Debugging"
    depends on XENO_DRIVERS_NET_RTCFG
    default n
    ---help---
    Enables debug message output of the RTcfg state machines. Switch on if
    you have to trace some problem related to RTcfg.
```

## drivers/xenomai/net/stack/rtmac/Kconfig
```kconfig
menuconfig XENO_DRIVERS_NET_RTMAC
    depends on XENO_DRIVERS_NET
    tristate "RTmac Layer"
    default y
    ---help---
    The Real-Time Media Access Control layer allows to extend the RTnet
    stack with software-based access control mechanisms (also called
    disciplines) for nondeterministic transport media. Disciplines can be
    attached and detached per real-time device. RTmac also provides a
    framework for tunnelling non-time-critical packets through real-time
    networks by installing virtual NICs (VNIC) in the Linux domain.

    See Documentation/README.rtmac for further information.

source "drivers/xenomai/net/stack/rtmac/tdma/Kconfig"
source "drivers/xenomai/net/stack/rtmac/nomac/Kconfig"
```

## drivers/xenomai/net/stack/rtmac/nomac/Kconfig
```kconfig
config XENO_DRIVERS_NET_NOMAC
    tristate "NoMAC discipline for RTmac"
    depends on XENO_DRIVERS_NET_RTMAC
    default n
    ---help---
    This no-operation RTmac discipline is intended to act as a template
    for new implementations. However, it can be compiled and used (see
    nomaccfg management tool), but don't expect any improved determinism
    of your network. ;)
```

## drivers/xenomai/net/stack/rtmac/tdma/Kconfig
```kconfig
config XENO_DRIVERS_NET_TDMA
    tristate "TDMA discipline for RTmac"
    depends on XENO_DRIVERS_NET_RTMAC
    default y
    ---help---
    The Time Division Multiple Access discipline is the default RTmac
    protocol for Ethernet networks. It consists of a master synchronising
    the access of the slaves to the media by periodically issuing frames.
    Backup masters can be set up to take over if the primary master fails.
    TDMA also provides a global clock across all participants. The tdmacfg
    tool can be used to configure a real-time NIC to use TDMA.

    See Documenatation/README.rtmac for further details.

config XENO_DRIVERS_NET_TDMA_MASTER
    bool "TDMA master support"
    depends on XENO_DRIVERS_NET_TDMA
    default y
    ---help---
    Enables TDMA master and backup master support for the node. This can
    be switched of to reduce the memory footprint of pure slave nodes.
```

## drivers/xenomai/serial/Kconfig
```kconfig
menu "Serial drivers"

config XENO_DRIVERS_16550A
	tristate "16550A UART driver"
	help
	Real-time UART driver for 16550A compatible controllers. See
	doc/txt/16550A-driver.txt for more details.

choice
	prompt "Hardware access mode"
	depends on XENO_DRIVERS_16550A
	default XENO_DRIVERS_16550A_PIO

config XENO_DRIVERS_16550A_PIO
	bool "Port-based I/O"
	help
	Hardware access only via I/O ports. Use module parameter
	"io=<port>[,<port>[,...]]" to specify the base port of a device.

config XENO_DRIVERS_16550A_MMIO
	bool "Memory-mapped I/O"
	help
	Hardware access only via memory mapping. Use module paramter
	"mem=<addr>[,<addr>[,...]]" to specify the physical base address of
	a device.

config XENO_DRIVERS_16550A_ANY
	bool "Any access mode"
	help
	Decide at module load-time (or via kernel parameter) which access
	mode to use for which device. This mode is useful when devices of
	both types can be present in a system, also at the same time.

	Both "io" and "mem" module parameters are available, but always only
	one of them can be applied on a particular device. Use, e.g.,
	"io=0x3f8,0 mem=0,0xe0000000" to address device 1 via IO base port
	0x3f8 and device 2 via physical base address 0xe0000000.

endchoice

config XENO_DRIVERS_16550A_PCI
	depends on PCI && (XENO_DRIVERS_16550A_PIO || XENO_DRIVERS_16550A_ANY)
	bool "PCI board support"
	default n
	help

	This option activates support for PCI serial boards.

config XENO_DRIVERS_16550A_PCI_MOXA
	depends on XENO_DRIVERS_16550A_PCI
	bool "Moxa PCI boards"
	default n
	help

	This option activates support for the following Moxa boards:
	PCI Serial Boards:
	  C104H/PCI, C168H/PCI
	  CP-114, CP-132
	Universal PCI Serial Boards:
	  CP-102U, CP-102UL, CP-104U
	  CP-112UL, CP-114UL, CP-118U
	  CP-132U, CP-134U, CP-138U
	  CP-168U

config XENO_DRIVERS_MPC52XX_UART
	depends on PPC_MPC52xx
	tristate "MPC52xx PSC UART driver"
	help
	Real-time UART driver for the PSC on the MPC5200 processor.

config XENO_DRIVERS_IMX_UART
	depends on ARCH_IMX || ARCH_MXC
	tristate "RT IMX UART driver"
	select RATIONAL
	help
	Real-time UART driver for the Freescale Semiconductor MXC Internal
	UART compatible controllers.

endmenu
```

## drivers/xenomai/spi/Kconfig
```kconfig
menu "Real-time SPI master drivers"

config XENO_DRIVERS_SPI
       depends on SPI
       tristate

config XENO_DRIVERS_SPI_BCM2835
	depends on ARCH_BCM2708 || ARCH_BCM2835
	select XENO_DRIVERS_SPI
	tristate "Support for BCM2835 SPI"
	help

	Enables support for the SPI0 controller available from
	Broadcom's BCM2835 SoC.

config XENO_DRIVERS_SPI_SUN6I
	depends on MACH_SUN6I || MACH_SUN8I
	select XENO_DRIVERS_SPI
	tristate "Support for A31/H3 SoC SPI"
	help

	Enables support for the SPI controller available from
	Allwinner's A31, H3 SoCs.

config XENO_DRIVERS_SPI_OMAP2_MCSPI_RT
	tristate "McSPI rt-driver for OMAP"
	depends on HAS_DMA
	depends on ARCH_OMAP2PLUS || COMPILE_TEST
	select XENO_DRIVERS_SPI
	help

	SPI real-time master controller for OMAP24XX and later Multichannel SPI
	(McSPI) modules.

config XENO_DRIVERS_SPI_DEBUG
       depends on XENO_DRIVERS_SPI
       bool "Enable SPI core debugging features"
       
endmenu
```

## drivers/xenomai/testing/Kconfig
```kconfig
menu "Testing drivers"

config XENO_DRIVERS_TIMERBENCH
	tristate "Timer benchmark driver"
	default y
	help
	Kernel-based benchmark driver for timer latency evaluation.
	See testsuite/latency for a possible front-end.

config XENO_DRIVERS_SWITCHTEST
	tristate "Context switch unit testing driver"
	default y
	help
	Kernel-based driver for unit testing context switches and
	FPU switches.

config XENO_DRIVERS_HEAPCHECK
	tristate "Memory allocator test driver"
	default y
	help
	Kernel-based driver for testing Cobalt's memory allocator.

config XENO_DRIVERS_RTDMTEST
	depends on m
	tristate "RTDM unit tests driver"
	help
	Kernel driver for performing RTDM unit tests.

endmenu
```

## drivers/xenomai/udd/Kconfig
```kconfig
menu "UDD support"

config XENO_DRIVERS_UDD
	tristate "User-space device driver framework"
	help

	A RTDM-based driver for enabling interrupt control and I/O
	memory access interfaces to user-space device drivers.

endmenu
```

## kernel/ipipe/Kconfig
```kconfig
config HAVE_IPIPE_SUPPORT
       depends on GENERIC_CLOCKEVENTS
       bool

config IPIPE
	bool "Interrupt pipeline"
	depends on HAVE_IPIPE_SUPPORT
	default n
	---help---
	  Activate this option if you want the interrupt pipeline to be
	  compiled in.

config IPIPE_CORE
	def_bool y if IPIPE

config IPIPE_WANT_PTE_PINNING
       bool

config IPIPE_CORE_APIREV
       int
       depends on IPIPE
       default 2
	---help---
	  The API revision level we implement.

config IPIPE_WANT_APIREV_2
       bool

config IPIPE_TARGET_APIREV
       int
       depends on IPIPE
       default IPIPE_CORE_APIREV
	---help---
	  The API revision level the we want (must be <=
	  IPIPE_CORE_APIREV).

config IPIPE_HAVE_HOSTRT
       bool

config IPIPE_HAVE_EAGER_FPU
	bool

if IPIPE && ARM && RAW_PRINTK && !DEBUG_LL
comment "CAUTION: DEBUG_LL must be selected, and properly configured for"
comment "RAW_PRINTK to work. Otherwise, you will get no output on raw_printk()"
endif
```
