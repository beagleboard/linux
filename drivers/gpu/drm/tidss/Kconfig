## drivers/mmc/Kconfig
```kconfig
#
# MMC subsystem configuration
#

menu "MMC/SD Card support"

config MMC
	tristate "MMC support"
	help
	  MMC is the "multi-media card" bus protocol.

	  If you want MMC support, you should say Y here and also
	  to the specific driver for your MMC interface.

config MMC_DEBUG
	bool "MMC debugging"
	depends on MMC != n
	help
	  This is an option for use by developers; most people should
	  say N here.  This enables MMC core and driver debugging.

config MMC_BLOCK
	tristate "MMC block device driver"
	depends on MMC
	default y
	help
	  Say Y here to enable the MMC block device driver support.
	  This provides a block device driver, which you can use to
	  mount the filesystem. Almost everyone wishing MMC support
	  should say Y or M here.

config MMC_BLOCK_BROKEN_RFD
	boolean "Write work-around for incompatible cards"
	depends on MMC_BLOCK
	default n
	help
	  Say y here if your MMC card fails write operations. Some cards
	  lie about being ready to receive data while they actually are not.

config MMC_BULKTRANSFER
	bool "Multi-block writes (EXPERIMENTAL)"
	depends on MMC_BLOCK != n && EXPERIMENTAL
	default n
	help
	  By default all writes are done one sector at a time. Enable
	  this option to transfer as large blocks as the host supports.
	  The transfer speed is in most cases doubled.

config MMC_ARMMMCI
	tristate "ARM AMBA Multimedia Card Interface support"
	depends on ARM_AMBA && MMC
	help
	  This selects the ARM(R) AMBA(R) PrimeCell Multimedia Card
	  Interface (PL180 and PL181) support.  If you have an ARM(R)
	  platform with a Multimedia Card slot, say Y or M here.

	  If unsure, say N.

config MMC_PXA
	tristate "Intel PXA255 Multimedia Card Interface support"
	depends on ARCH_PXA && MMC
	help
	  This selects the Intel(R) PXA(R) Multimedia card Interface.
	  If you have a PXA(R) platform with a Multimedia Card slot,
	  say Y or M here.

	  If unsure, say N.

config MMC_OMAP
	tristate "TI OMAP Multimedia Card Interface support"
	depends on ARCH_OMAP && MMC
	select TPS65010 if MACH_OMAP_H2
	help
	  This selects the TI OMAP Multimedia card Interface.
	  If you have an OMAP board with a Multimedia Card slot,
	  say Y or M here.

	  If unsure, say N.

config MMC_OMAP16XX_BLOCK1
	boolean "First MMC block on OMAP16XX"
	depends on ARCH_OMAP16XX && MMC_OMAP
	default y if MACH_OMAP_H2 || MACH_OMAP_H3
	help
	  This enables the first of two MMC blocks on OMAP1610 multimedia
	  processor. You need to enable the correct block to activate your
	  MMC slot.

config MMC_OMAP16XX_BLOCK2
	boolean "Second MMC block on OMAP16XX"
	depends on ARCH_OMAP16XX && MMC_OMAP
	default n if MACH_OMAP_H2 || MACH_OMAP_H3
	default y
	help
	  This enables the second of two MMC blocks on OMAP1610 multimedia
	  processor. You need to enable the correct block to activate your
	  MMC slot.

config MMC_WBSD
	tristate "Winbond W83L51xD SD/MMC Card Interface support"
	depends on MMC && ISA && ISA_DMA_API
	help
	  This selects the Winbond(R) W83L51xD Secure digital and
          Multimedia card Interface.
	  If you have a machine with a integrated W83L518D or W83L519D
	  SD/MMC card reader, say Y or M here.

	  If unsure, say N.

endmenu
```

## drivers/net/can/d_can/Kconfig
```kconfig
menuconfig CAN_D_CAN
	tristate "Bosch D_CAN devices"
	depends on CAN_DEV && HAS_IOMEM

if CAN_D_CAN

config CAN_D_CAN_PLATFORM
	tristate "Generic Platform Bus based D_CAN driver"
	---help---
	  This driver adds support for the D_CAN chips connected to
	  the "platform bus" (Linux abstraction for directly to the
	  processor attached devices) which can be found on am335x
	  and dm814x boards from TI (http://www.ti.com).
endif
```

## drivers/net/wireless/acc1340/Kconfig
```kconfig
config ACC1340
	tristate "ACC1340 WLAN support"
	depends on MAC80211 && CFG80211
	help
	  This is a driver for the Amp'ed RF ACC1340 WLAN chipsets.
	  This option just enables the driver core, see below for
	  specific bus support.

if ACC1340

config ACC1340_WLAN_SDIO
	tristate "Support SDIO platforms"
	depends on ACC1340 && MMC
	help
	  Enable support for the ACC1340 connected via an SDIO bus.
	  By default this driver only supports the Sagrad SG901-1091/1098 EVK
	  and similar designs that utilize a hardware reset circuit. To
	  support different ACC1340 SDIO designs you will need to override
	  the default platform data by calling cw1200_sdio_set_platform_data()
	  in your board setup file.

config ACC1340_WLAN_SPI
	tristate "Support SPI platforms"
	depends on ACC1340 && SPI
	help
	  Enables support for the ACC1340 connected via a SPI bus.  You will
	  need to add appropriate platform data glue in your board setup
	  file.

endif
```

## drivers/net/wireless/rtl8723ds/Kconfig
```kconfig
config RTL8723DS
	tristate "Realtek 8723D SDIO or SPI WiFi"
	default n
	help
	  Help message of RTL8723DS
```

## drivers/net/wireless/ti/cc33xx/Kconfig
```kconfig
# SPDX-License-Identifier: GPL-2.0-only
config CC33XX
	tristate "TI CC33XX support"
	depends on MAC80211
	select FW_LOADER
	help
	  This module contains the main code for TI CC33XX WLAN chips. It abstracts
	  hardware-specific differences among different chipset families.
	  Each chipset family needs to implement its own lower-level module
	  that will depend on this module for the common code.

	  If you choose to build a module, it will be called cc33xx. Say N if
	  unsure.

config CC33XX_SPI
	tristate "TI CC33XX SPI support"
	depends on CC33XX && SPI_MASTER && OF
	select CRC7
	help
	  This module adds support for the SPI interface of adapters using
	  TI CC33XX chipsets.  Select this if your platform is using
	  the SPI bus.

	  If you choose to build a module, it'll be called cc33xx_spi.
	  Say N if unsure.

config CC33XX_SDIO
	tristate "TI CC33XX SDIO support"
	depends on CC33XX && MMC
	help
	  This module adds support for the SDIO interface of adapters using
	  TI CC33XX WLAN chipsets.  Select this if your platform is using
	  the SDIO bus.

	  If you choose to build a module, it'll be called cc33xx_sdio.
	  Say N if unsure.
```

## drivers/nvmem/Kconfig
```kconfig
menuconfig NVMEM
	tristate "NVMEM Support"
	select REGMAP
	help
	  Support for NVMEM devices.

	  This framework is designed to provide a generic interface to NVMEM
	  from both the Linux Kernel and the userspace.

	  If unsure, say no.

if NVMEM

config QCOM_QFPROM
	tristate "QCOM QFPROM Support"
	depends on ARCH_QCOM
	select REGMAP_MMIO
	help
	  Say y here to enable QFPROM support. The QFPROM provides access
	  functions for QFPROM data to rest of the drivers via nvmem interface.

	  This driver can also be built as a module. If so, the module
	  will be called nvmem-qfprom.

endif
```

## drivers/pci/controller/Kconfig
```kconfig
menu "PCI controller drivers"

config PCI_DRA7XX
	bool "TI DRA7xx PCIe controller"
	depends on OF && HAS_IOMEM && TI_PIPE3
	help
	 Enables support for the PCIe controller in the DRA7xx SoC. There
	 are two instances of PCIe controller in DRA7xx. This controller can
	 work either as EP or RC. In order to enable host specific features
	 PCI_DRA7XX_HOST must be selected. This reuses the Designware core.

if PCI_DRA7XX

choice
	bool "PCIe Mode"
	default PCI_DRA7XX_HOST if PCI

config PCI_DRA7XX_HOST
	bool "Host Only Mode"
	depends on PCI
	select PCIE_DW_HOST
	help
	 Enables support for the PCIe controller in the DRA7xx SoC to work in
	 host mode.

config PCI_DRA7XX_EP
	bool "Endpoint Only Mode"
	depends on PCI_ENDPOINT
	select PCIE_DW_EP
	help
	 Enables support for the PCIe controller in the DRA7xx SoC to work in
	 endpoint mode.

config PCI_DRA7XX_HOST_EP
	bool "Both Host and Endpoint Mode"
	depends on PCI
	depends on PCI_ENDPOINT
	select PCIE_DW_HOST
	select PCIE_DW_EP
	help
	 Enables support for the PCIe controller in the DRA7xx SoC to work in
	 both endpoint mode and host mode. If the board has 2 PCIe ports and
	 one of them has to work in host mode and the other has to work in
	 EP mode then this option has to be enabled.

endchoice

endif

config PCI_MVEBU
	bool "Marvell EBU PCIe controller"
	depends on PCI
	depends on ARCH_MVEBU || ARCH_DOVE
	depends on OF

config PCIE_DW
	bool

config PCIE_DW_HOST
	bool
	depends on PCI
	select PCIE_DW

config PCIE_DW_EP
	bool
	depends on PCI_ENDPOINT
	select PCIE_DW

config PCI_EXYNOS
	bool "Samsung Exynos PCIe controller"
	depends on PCI
	depends on (SOC_EXYNOS5440 || COMPILE_TEST)
	select PCIEPORTBUS
	select PCIE_DW_HOST

config PCI_IMX6
	bool "Freescale i.MX6 PCIe controller"
	depends on PCI
	depends on SOC_IMX6Q || COMPILE_TEST
	select PCIEPORTBUS
	select PCIE_DW_HOST

config PCI_TEGRA
	bool "NVIDIA Tegra PCIe controller"
	depends on PCI
	depends on ARCH_TEGRA && !ARM64
	help
	  Say Y here if you want support for the PCIe host controller found
	  on NVIDIA Tegra SoCs.

config PCI_RCAR_GEN2
	bool "Renesas R-Car Gen2 Internal PCI controller"
	depends on PCI
	depends on ARM
	depends on ARCH_SHMOBILE || COMPILE_TEST
	help
	  Say Y here if you want internal PCI support on R-Car Gen2 SoC.
	  There are 3 internal PCI controllers available with a single
	  built-in EHCI/OHCI host controller present on each one.

config PCI_RCAR_GEN2_PCIE
	bool "Renesas R-Car PCIe controller"
	depends on PCI
	depends on ARM
	depends on ARCH_SHMOBILE || COMPILE_TEST
	help
	  Say Y here if you want PCIe controller support on R-Car Gen2 SoCs.

config PCI_HOST_GENERIC
	bool "Generic PCI host controller"
	depends on PCI
	depends on (ARM || ARM64) && OF
	help
	  Say Y here if you want to support a simple generic PCI host
	  controller, such as the one emulated by kvmtool.

config PCIE_SPEAR13XX
	bool "STMicroelectronics SPEAr PCIe controller"
	depends on PCI
	depends on ARCH_SPEAR13XX || COMPILE_TEST
	select PCIEPORTBUS
	select PCIE_DW_HOST
	help
	  Say Y here if you want PCIe support on SPEAr13XX SoCs.

config PCI_KEYSTONE
	bool "TI Keystone PCIe controller"
	depends on PCI
	depends on ARCH_KEYSTONE
	select PCIE_DW_HOST
	select PCIEPORTBUS
	help
	  Say Y here if you want to enable PCI controller support on Keystone
	  SoCs. The PCI controller on Keystone is based on Designware hardware
	  and therefore the driver re-uses the Designware core functions to
	  implement the driver.

config PCIE_XILINX
	bool "Xilinx AXI PCIe host bridge support"
	depends on PCI
	depends on ARCH_ZYNQ
	help
	  Say 'Y' here if you want kernel to support the Xilinx AXI PCIe
	  Host Bridge driver.

config PCI_XGENE
	bool "X-Gene PCIe controller"
	depends on PCI
	depends on ARCH_XGENE
	depends on OF
	select PCIEPORTBUS
	select PCI_MSI_IRQ_DOMAIN if PCI_MSI
	help
	  Say Y here if you want internal PCI support on APM X-Gene SoC.
	  There are 5 internal PCIe ports available. Each port is GEN3 capable
	  and have varied lanes from x1 to x8.

config PCI_XGENE_MSI
	bool "X-Gene v1 PCIe MSI feature"
	depends on PCI
	depends on PCI_XGENE && PCI_MSI
	default y
	help
	  Say Y here if you want PCIe MSI support for the APM X-Gene v1 SoC.
	  This MSI driver supports 5 PCIe ports on the APM X-Gene v1 SoC.

config PCI_LAYERSCAPE
	bool "Freescale Layerscape PCIe controller"
	depends on PCI
	depends on OF && (ARM || ARCH_LAYERSCAPE || COMPILE_TEST)
	select PCIE_DW_HOST
	select MFD_SYSCON
	help
	  Say Y here if you want PCIe controller support on Layerscape SoCs.

config PCI_VERSATILE
	bool "ARM Versatile PB PCI controller"
	depends on PCI
	depends on ARCH_VERSATILE

config PCIE_IPROC
	tristate "Broadcom iProc PCIe controller"
	depends on PCI
	depends on OF && (ARM || ARM64)
	default n
	help
	  This enables the iProc PCIe core controller support for Broadcom's
	  iProc family of SoCs. An appropriate bus interface driver also needs
	  to be enabled

config PCIE_IPROC_PLATFORM
	tristate "Broadcom iProc PCIe platform bus driver"
	depends on PCI
	depends on ARCH_BCM_IPROC || (ARM && COMPILE_TEST)
	depends on OF
	select PCIE_IPROC
	default ARCH_BCM_IPROC
	help
	  Say Y here if you want to use the Broadcom iProc PCIe controller
	  through the generic platform bus interface

config PCIE_IPROC_BCMA
	tristate "Broadcom iProc PCIe BCMA bus driver"
	depends on PCI
	depends on ARM && (ARCH_BCM_IPROC || COMPILE_TEST)
	select PCIE_IPROC
	select BCMA
	select PCI_DOMAINS
	default ARCH_BCM_5301X
	help
	  Say Y here if you want to use the Broadcom iProc PCIe controller
	  through the BCMA bus interface

config PCIE_ALTERA
	bool "Altera PCIe controller"
	depends on PCI
	depends on ARM || NIOS2
	depends on OF_PCI
	select PCI_DOMAINS
	help
	  Say Y here if you want to enable PCIe controller support on Altera
	  FPGA.

config PCIE_ALTERA_MSI
	bool "Altera PCIe MSI feature"
	depends on PCI
	depends on PCIE_ALTERA && PCI_MSI
	select PCI_MSI_IRQ_DOMAIN
	help
	  Say Y here if you want PCIe MSI support for the Altera FPGA.
	  This MSI driver supports Altera MSI to GIC controller IP.

config PCI_HISI
	depends on OF && (ARM64 || COMPILE_TEST)
	bool "HiSilicon SoC HIP05 PCIe controller"
	depends on PCI
	select PCIEPORTBUS
	select PCIE_DW_HOST
	help
	  Say Y here if you want PCIe controller support on HiSilicon HIP05 SoC

endmenu
```
