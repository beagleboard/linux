## drivers/gpu/drm/tidss/Kconfig
```kconfig
config DRM_TIDSS
	tristate "DRM Support for TI Keystone"
	depends on DRM && OF
	depends on ARM || ARM64 || COMPILE_TEST
	select DRM_KMS_HELPER
	select DRM_KMS_CMA_HELPER
	select DRM_GEM_CMA_HELPER
	help
	  The TI Keystone family SoCs introduced a new generation of
	  Display SubSystem. There is currently three Keystone family
	  SoCs released with DSS. Each with somewhat different version
	  of it. The SoCs are 66AK2Gx, AM65x, and J721E. Set this to Y
	  or M to add display support for TI Keystone family
	  platforms.

if DRM_TIDSS

config DRM_TIDSS_WB
	bool "Enable writeback support for TIDSS DRM driver"
	depends on DRM_TIDSS
	depends on (VIDEO_V4L2 = y) || (VIDEO_V4L2 = m && DRM_TIDSS = m)
	depends on VIDEO_DEV && HAS_DMA
	select VIDEOBUF2_DMA_CONTIG
	select V4L2_MEM2MEM_DEV
	default y
	help
		Select this to enable memory-to-memory writeback support.

endif
```

## drivers/gpu/drm/tinydrm/Kconfig
```kconfig
menuconfig DRM_TINYDRM
	tristate "Support for small TFT LCD display modules"
	depends on DRM
	select DRM_KMS_HELPER
	select DRM_KMS_CMA_HELPER
	select VIDEOMODE_HELPERS
	help
	  Choose this option if you have a tinydrm supported display.
	  If M is selected the module will be called tinydrm.

config TINYDRM_MIPI_DBI
	tristate
	select REGMAP

config TINYDRM_MI0283QT
	tristate "DRM support for MI0283QT"
	depends on DRM_TINYDRM && SPI
	select TINYDRM_MIPI_DBI
	help
	  DRM driver for the following Multi-Inno MI0283QT display panels:
	    MI0283QT-8, MI0283QT-9, MI0283QT-9A, MI0283QT-11, MI0283QT-13

config TINYDRM_ADAFRUIT_TFT
	tristate "DRM driver for Adafruit SPI TFT displays"
	depends on DRM_TINYDRM && SPI
	select TINYDRM_MIPI_DBI
	help
	  DRM driver for the following Adafruit displays:
	    2.2" Color TFT LCD display - HX8340BN, 9-bit mode (#797)
	    1.8" Color TFT LCD display - ST7735R (#358)

config TINYDRM_USER
	tristate "Userspace tinydrm driver"
	depends on DRM_TINYDRM
	help
	  This option enables support for userspace tinydrm. Say 'y' to enable
	  this support in kernel. To compile this driver as a module,
	  choose 'm' here: the module will be called utinydrm.
```

## drivers/gpu/drm/verisilicon/Kconfig
```kconfig
# SPDX-License-Identifier: GPL-2.0

config DRM_VERISILICON
	tristate "DRM Support for VeriSilicon"
	depends on DRM
	select DRM_KMS_HELPER
	select VERISILICON_DW_MIPI_DSI
	select VERISILICON_DW_HDMI_LIGHT
	help
	  Choose this option if you have a VeriSilicon soc chipset.
	  This driver provides VeriSilicon kernel mode
	  setting and buffer management. It does not
	  provide 2D or 3D acceleration.

config VERISILICON_VIRTUAL_DISPLAY
	bool "display content output to debugfs file"
	depends on DRM_VERISILICON
	select DEBUG_FS
	help
	  This is a debug feature which capture video content output
	  from display controller. Output path is debugfs/dri/connector/.
	  The content format is ARGB which Alpha is 0 for 8bits.
	  Disabled in default.

config VERISILICON_DW_MIPI_DSI
	bool "VeriSilicon specific driver for Synopsys DW MIPI DSI"
	depends on DRM_VERISILICON
	select DRM_MIPI_DSI
	select GENERIC_PHY
	select GENERIC_PHY_MIPI_DPHY
	select PHY_DW_DPHY
	help
	  This driver supports Synopsys DW MIPI DSI controller.
	  MIPI DSI controller is a bridge between encoder
	  and panel. Also it is a MIPI DSI host and can work
	  in dual mode.

config VERISILICON_DW_HDMI_LIGHT
	bool "THEAD sepcific driver for Synopsys DW HDMI on Light"
	depends on DRM_VERISILICON
	select DRM_DW_HDMI
	help
	  This driver supports Synopsys DW HDMI controller on Light
	  platform from THEAD Corp.

config VERISILICON_MMU
	bool "MMU support for VeriSilicon display controller"
	depends on DRM_VERISILICON
	help
	  This is a memory management function which translate virtual address
	  to physical address. DPU MMU only do address translate, doesn't
	  support shareable.

config VERISILICON_DEC
	bool "DEC support for VeriSilicon display controller"
	depends on DRM_VERISILICON
	help
	  This is a decompression function which reads compressed pixels from
	  external memory (DDR or SRAM) under DPU's control, then it decompress
	  comprssed pixels before returing these pixels to DPU.
```

## drivers/i2c/chips/Kconfig
```kconfig
#
# Miscellaneous I2C chip drivers configuration
#
# *** DEPRECATED! Do not add new entries! See Makefile ***
#

menu "Miscellaneous I2C Chip support"

config DS1682
	tristate "Dallas DS1682 Total Elapsed Time Recorder with Alarm"
	depends on EXPERIMENTAL
	help
	  If you say yes here you get support for Dallas Semiconductor
	  DS1682 Total Elapsed Time Recorder.

	  This driver can also be built as a module.  If so, the module
	  will be called ds1682.

config SENSORS_PCF8574
	tristate "Philips PCF8574 and PCF8574A (DEPRECATED)"
	depends on EXPERIMENTAL && GPIO_PCF857X = "n"
	default n
	help
	  If you say yes here you get support for Philips PCF8574 and 
	  PCF8574A chips. These chips are 8-bit I/O expanders for the I2C bus.

	  This driver can also be built as a module.  If so, the module
	  will be called pcf8574.

	  This driver is deprecated and will be dropped soon. Use
	  drivers/gpio/pcf857x.c instead.

	  These devices are hard to detect and rarely found on mainstream
	  hardware.  If unsure, say N.

config PCF8575
	tristate "Philips PCF8575 (DEPRECATED)"
	default n
	depends on GPIO_PCF857X = "n"
	help
	  If you say yes here you get support for Philips PCF8575 chip.
	  This chip is a 16-bit I/O expander for the I2C bus.  Several other
	  chip manufacturers sell equivalent chips, e.g. Texas Instruments.

	  This driver can also be built as a module.  If so, the module
	  will be called pcf8575.

	  This driver is deprecated and will be dropped soon. Use
	  drivers/gpio/pcf857x.c instead.

	  This device is hard to detect and is rarely found on mainstream
	  hardware.  If unsure, say N.

config SENSORS_PCA9539
	tristate "Philips PCA9539 16-bit I/O port (DEPRECATED)"
	depends on EXPERIMENTAL && GPIO_PCA953X = "n"
	help
	  If you say yes here you get support for the Philips PCA9539
	  16-bit I/O port.

	  This driver can also be built as a module.  If so, the module
	  will be called pca9539.

	  This driver is deprecated and will be dropped soon. Use
	  drivers/gpio/pca953x.c instead.

config SENSORS_PCF8591
	tristate "Philips PCF8591"
	depends on EXPERIMENTAL
	default n
	help
	  If you say yes here you get support for Philips PCF8591 chips.

	  This driver can also be built as a module.  If so, the module
	  will be called pcf8591.

	  These devices are hard to detect and rarely found on mainstream
	  hardware.  If unsure, say N.

config TWL4030_MADC
	tristate "TWL4030 MADC Driver"
	depends on TWL4030_CORE
	help
	  The TWL4030 Monitoring ADC driver enables the host
	  processor to monitor analog signals using analog-to-digital
	  conversions on the input source. TWL4030 MADC provides the
	  following features:
	   - Single 10-bit ADC with successive approximation register (SAR) conversion;
	   - Analog multiplexer for 16 inputs;
	   - Seven (of the 16) inputs are freely available;
	   - Battery voltage monitoring;
	   - Concurrent conversion request management;
	   - Interrupt signal to Primary Interrupt Handler;
	   - Averaging feature;
	   - Selective enable/disable of the averaging feature.

	  Say 'y' here to statically link this module into the kernel or 'm'
	  to build it as a dinamically loadable module. The module will be
	  called twl4030-madc.ko

config TWL4030_PWRBUTTON
	tristate "TWL4030 Power button Driver"
	depends on TWL4030_CORE

config TWL4030_POWEROFF
	tristate "TWL4030 device poweroff"
	depends on TWL4030_CORE

config SENSORS_MAX6875
	tristate "Maxim MAX6875 Power supply supervisor"
	depends on EXPERIMENTAL
	help
	  If you say yes here you get support for the Maxim MAX6875
	  EEPROM-programmable, quad power-supply sequencer/supervisor.

	  This provides an interface to program the EEPROM and reset the chip.

	  This driver also supports the Maxim MAX6874 hex power-supply
	  sequencer/supervisor if found at a compatible address.

	  This driver can also be built as a module.  If so, the module
	  will be called max6875.

config SENSORS_TSL2550
	tristate "Taos TSL2550 ambient light sensor"
	depends on EXPERIMENTAL
	help
	  If you say yes here you get support for the Taos TSL2550
	  ambient light sensor.

	  This driver can also be built as a module.  If so, the module
	  will be called tsl2550.

config SENSORS_TSL2563
       tristate "Taos TSL2563 ambient light sensor"
       depends on I2C && HWMON
       help
         If you say yes here you get support for the Taos TSL2563
         ambient light sensor.

         This driver can also be built as a module.  If so, the module
         will be called tsl2563.

config LP5521
	tristate "LP5521 LED driver chip"
	depends on I2C
	help
	  If you say yes here you get support for the National Semiconductor
	  LP5521 LED driver.

config MENELAUS
	bool "TWL92330/Menelaus PM chip"
	depends on I2C=y && ARCH_OMAP24XX
	help
	  If you say yes here you get support for the Texas Instruments
	  TWL92330/Menelaus Power Management chip. This include voltage
	  regulators, Dual slot memory card tranceivers, real-time clock
	  and other features that are often used in portable devices like
	  cell phones and PDAs.

endmenu
```

## drivers/iio/pulse/Kconfig
```kconfig
#
# Pulse Capture Devices
#
# When adding new entries keep the list in alphabetical order

menu "Pulse Capture Devices"

config IIO_TIECAP
	tristate "TI ECAP Pulse Capture"
	depends on SOC_AM33XX
	select IIO_BUFFER
	select IIO_TRIGGERED_BUFFER
	help
	 If you say yes here you get support for the TI ECAP peripheral
	 in pulse capture mode.

	 This driver can also be built as a module.  If so, the module
	 will be called tiecap

endmenu
```

## drivers/light/Kconfig
```kconfig
# SPDX-License-Identifier: GPL-2.0-only
#
# Light backend drivers
#

menu "Light backend drivers"

source "drivers/light/light_mailbox/Kconfig"
source "drivers/light/light_blk/Kconfig"
source "drivers/light/light_net/Kconfig"
endmenu
```

## drivers/light/light_blk/Kconfig
```kconfig
# SPDX-License-Identifier: GPL-2.0-only
#

config LIGHT_BLK
        tristate "light_blk backend driver"
        select VIRTIO
        select VHOST_RING
	depends on KVM
        default y
        help
          This driver provides support for light virtio_blk backend.
```

## drivers/light/light_mailbox/Kconfig
```kconfig
# SPDX-License-Identifier: GPL-2.0-only
#

config LIGHT_MAILBOX
        tristate "light_mailbox backend driver"
        select VIRTIO
        select VHOST_RING
	depends on MAILBOX
        default y
        help
          This driver provides support for light virtio_mailbox backend.
```

## drivers/light/light_net/Kconfig
```kconfig
# SPDX-License-Identifier: GPL-2.0-only
#

config LIGHT_NET
        tristate "light_net backend driver"
        select NET
        select VIRTIO
        select VHOST_RING
	depends on KVM
        default y
        help
          This driver provides support for light virtio_net backend.
```

## drivers/media/platform/imagination/Kconfig
```kconfig
# SPDX-License-Identifier: GPL-2.0-only

comment "IMG media platform drivers"

config VIDEO_IMG_VXD_DEC
  tristate "IMG VXD DEC (Video Decoder) driver"
	depends on V4L_MEM2MEM_DRIVERS
  depends on VIDEO_DEV
  depends on ARCH_K3 || COMPILE_TEST
  depends on V4L_PLATFORM_DRIVERS
  select VIDEOBUF2_CORE
  select VIDEOBUF2_DMA_CONTIG
  select VIDEOBUF2_DMA_SG
  select V4L2_MEM2MEM_DEV
  help
    This is an IMG VXD DEC V4L2 driver that adds support for the
    Imagination D5520 (Video Decoder) hardware as used on the Texas
    Instruments Jacinto and Sitara devices.
    The module name when built is vxd-dec.

config VIDEO_IMG_VXE_ENC
  tristate "IMG VXE ENC (Video Encoder) driver"
	depends on V4L_MEM2MEM_DRIVERS
  depends on VIDEO_DEV
  depends on ARCH_K3 || COMPILE_TEST
  depends on V4L_PLATFORM_DRIVERS
  select VIDEOBUF2_CORE
  select VIDEOBUF2_DMA_CONTIG
  select VIDEOBUF2_DMA_SG
  select V4L2_MEM2MEM_DEV
  help
    This is an IMG VXE ENC V4L2 driver that adds support for the
    Imagination VXE384 (Video Encoder) hardware as used on the Texas
    Instruments Jacinto and Sitara devices.
    The module name when built is vxe-enc.

source "drivers/media/platform/imagination/e5010/Kconfig"
```

## drivers/media/platform/omap/Kconfig
```kconfig
config VIDEO_OMAP2_VOUT_VRFB
	bool

config VIDEO_OMAP2_VOUT
	tristate "OMAP2/OMAP3 V4L2-Display driver"
	depends on MMU
	depends on ARCH_OMAP2 || ARCH_OMAP3
	depends on OMAP2_DSS
	select VIDEOBUF_GEN
	select VIDEOBUF_DMA_CONTIG
	select OMAP2_VRFB if ARCH_OMAP2 || ARCH_OMAP3
	select VIDEO_OMAP2_VOUT_VRFB if VIDEO_OMAP2_VOUT && OMAP2_VRFB
	select OMAP2_DSS_COMPAT_SUPPORT
	default n
	---help---
	  V4L2 Display driver support for OMAP2/3 based boards.
```

## drivers/media/platform/ti-vpfe/Kconfig
```kconfig
config VIDEO_AM437X_VPFE
	tristate "TI AM437x VPFE video capture driver"
	depends on VIDEO_V4L2 && VIDEO_V4L2_SUBDEV_API && SOC_AM43XX
	select VIDEOBUF2_DMA_CONTIG
	help
	   Support for AM437x Video Processing Front End based Video
	   Capture Driver.

	   To compile this driver as a module, choose M here. The module
	   will be called ti_vpfe.
```

## drivers/media/video/omap/Kconfig
```kconfig
config VIDEO_OMAP_CAMERA
	tristate "OMAP Camera support (EXPERIMENTAL)"
	select VIDEOBUF_GEN
	select VIDEOBUF_DMA_SG
	depends on VIDEO_DEV && (ARCH_OMAP16XX || ARCH_OMAP24XX)
	help
	  V4L2 camera driver support for OMAP1/2 based boards.
```

## drivers/misc/cape/beaglebone/Kconfig
```kconfig
#
# Beaglebone capes
#

config CAPE_BEAGLEBONE
	tristate "Beaglebone cape support"
	depends on ARCH_OMAP2PLUS && OF && I2C
	default n
	select OF_PLUGIN
	help
	  Say Y here to include support for beaglebone capes

config CAPE_BEAGLEBONE_GEIGER
	tristate "Beaglebone Geiger Cape"
	depends on CAPE_BEAGLEBONE
	default n
	help
	  Say Y here to include support for the Geiger Cape
```

## drivers/misc/cape/beaglebone/logibone/Kconfig
```kconfig
config CAPE_LOGIBONE_R1
	tristate "Beaglebone Logibone Cape"
	depends on CAPE_BEAGLEBONE
	default n
	help
	  Say Y here to include support for the Nixie Cape
```

## drivers/misc/cape_bone_argus/Kconfig
```kconfig
comment "Argus cape driver for beaglebone black"

config CAPE_BONE_ARGUS
	tristate "Argus Cape Driver"
	default M
	help
	    Argus Cape Driver
```

## drivers/misc/mikrobus/Kconfig
```kconfig
menuconfig MIKROBUS
	tristate "Module for instantiating devices on mikroBUS ports"
	depends on GPIOLIB
	depends on W1
	help
	  This option enables the mikroBUS driver. mikroBUS is an add-on
	  board socket standard that offers maximum expandability with
	  the smallest number of pins. The mikroBUS driver instantiates
	  devices on a mikroBUS port described by identifying data present
	  in an add-on board resident EEPROM, more details on the mikroBUS
	  driver support and discussion can be found in this eLinux wiki :
	  elinux.org/Mikrobus


	  Say Y here to enable support for this driver.

	  To compile this code as a module, chose M here: the module
	  will be called mikrobus.ko
```
