## Documentation/devicetree/bindings/net/wireless/ti,cc33xx.yaml
```yaml
# SPDX-License-Identifier: (GPL-2.0-only OR BSD-2-Clause)
%YAML 1.2
---
$id: http://devicetree.org/schemas/net/wireless/ti,cc33xx.yaml#
$schema: http://devicetree.org/meta-schemas/core.yaml#

title: Texas Instruments CC33xx Wireless LAN Controller

maintainers:
  - Michael Nemanov <michael.nemanov@ti.com>

description:
  These are dt entries for the IEEE 802.11ax chips CC33xx from Texas Instruments.
  Currently, these chips must be connected via SDIO.

properties:
  compatible:
    enum:
      - ti,cc3300
      - ti,cc3301
      - ti,cc3350
      - ti,cc3351

  reg:
    description:
      For WLAN communication, <reg> must be set to 2.
    maxItems: 1

  interrupts:
    description: The interrupt line. Can be IRQ_TYPE_EDGE_RISING or IRQ_TYPE_LEVEL_HIGH.
      When SDIO is used, the "in-band" interrupt provided by the SDIO bus is used
      unless an interrupt is defined in the Device Tree.
    maxItems: 1

required:
  - compatible
  - reg

unevaluatedProperties: false

examples:
  - |
    #include <dt-bindings/interrupt-controller/irq.h>

    // SDIO example:
    mmc3 {
        vmmc-supply = <&wlan_en_reg>;
        bus-width = <4>;
        cap-power-off-card;
        keep-power-in-suspend;

        #address-cells = <1>;
        #size-cells = <0>;

        cc33xx: cc33xx@0 {
            compatible = "ti,cc3300";
            reg = <2>;
            interrupts = <19 IRQ_TYPE_EDGE_RISING>;
        };
    };
```

## Documentation/devicetree/bindings/net/wireless/ti,wlcore.txt
```
TI Wilink (wlcore) SDIO devices

This node provides properties for controlling the wilink wireless device. The
node is expected to be specified as a child node to the SDIO controller that
connects the device to the system.

Required properties:

 - compatible : Should be "ti,wlcore".
 - interrupt-parent : the phandle for the interrupt controller to which the
	device interrupts are connected.
 - interrupts : specifies attributes for the out-of-band interrupt.

Example:

&mmc3 {
	status = "okay";
	vmmc-supply = <&wlan_en_reg>;
	bus-width = <4>;
	cap-power-off-card;
	keep-power-in-suspend;

	#address-cells = <1>;
	#size-cells = <0>;
	wlcore: wlcore@0 {
		compatible = "ti,wlcore";
		reg = <2>;
		interrupt-parent = <&gpio0>;
		interrupts = <19 IRQ_TYPE_NONE>;
	};
};
```

## Documentation/devicetree/bindings/nvmem/nvmem.txt
```
= NVMEM Data Device Tree Bindings =

This binding is intended to represent the location of hardware
configuration data stored in NVMEMs.

On a significant proportion of boards, the manufacturer has stored
some data on NVMEM, for the OS to be able to retrieve these information
and act upon it. Obviously, the OS has to know about where to retrieve
these data from, and where they are stored on the storage device.

This document is here to document this.

= Data providers =
Contains bindings specific to provider drivers and data cells as children
to this node.

Optional properties:
 read-only: Mark the provider as read only.

= Data cells =
These are the child nodes of the provider which contain data cell
information like offset and size in nvmem provider.

Required properties:
reg:	specifies the offset in byte within that storage device, start bit
	in the byte and the length in bits of the data we care about.
	There could be more then one offset-length pairs in this property.

Optional properties:

bit-offset: specifies the offset in bit within the address range specified
	by reg property. Can take values from 0-7.
nbits: specifies number of bits this cell occupies starting from bit-offset.

For example:

	/* Provider */
	qfprom: qfprom@00700000 {
		...

		/* Data cells */
		tsens_calibration: calib@404 {
			reg = <0x404 0x10>;
		};

		tsens_calibration_bckp: calib_bckp@504 {
			reg = <0x504 0x11>;
			bit-offset = 6;
			nbits = 128;
		};

		pvs_version: pvs-version@6 {
			reg = <0x6 0x2>
			bit-offset = 7;
			nbits = 2;
		};

		speed_bin: speed-bin@c{
			reg = <0xc 0x1>;
			bit-offset = 2;
			nbits	= 3;

		};
		...
	};

= Data consumers =
Are device nodes which consume nvmem data cells/providers.

Required-properties:
nvmem-cell: list of phandle to the nvmem data cells.
nvmem-cell-names: names for the each nvmem-cell specified

Optional-properties:
nvmem	: list of phandles to nvmem providers.
nvmem-names: names for the each nvmem provider.

For example:

	tsens {
		...
		nvmem-cell = <&tsens_calibration>;
		nvmem-cell-names = "calibration";
	};
```

## Documentation/devicetree/bindings/nvmem/thead,light-efuse.txt
```
= Thead LIGHT-EFUSE device tree bindings =

This binding is intended to represent LIGHT-EFUSE which is found in Thead SoCs

Required properties:
- compatible:	should be
		"thead,light-fm-efuse": for light fullmask
- reg:	should contain registers location and length
- thead,teesys:	the syscon phandle to read and write tee system registers

Example:

	nvmem_controller: efuse@ffff210000 {
		compatible = "thead,light-fm-efuse";
		reg = <0xff 0xff210000 0x0 0x10000>;
		thead,teesys = <&teesys_syscon>;
	};
```

## Documentation/devicetree/bindings/opp/ti-omap5-opp-domain.txt
```
Texas Instruments OMAP compatible OPP domain description

This binding uses the "<supply-name>-opp-domain" binding documented at [1]
and describes the OPP domain devices typically used on Texas Instruments
OMAP compatible SoC family of processors.

OMAP5, DRA7, and AM57 family of SoCs have Class0 AVS eFuse registers which
contain data that can be used to adjust voltages programmed for some of their
supplies for more efficient operation. These are provided to the OPP domain
driver so that when a voltage transition is requested by the OPP core, we can
make an adjustment to the voltage before setting the supply.

Also, some supplies may have an associated vbb-supply which is an Adaptive Body
Bias regulator which much be transitioned in a specific sequence with regards
to the vdd-supply and clk when making an OPP transition, and this driver handles
that sequencing.

[1] Documentation/devicetree/bindings/opp/opp.txt

Required Properties:
- compatible: Should be one of:
	"ti,omap-oppdm" - basic OPP domain controlling VDD and VBB
	"ti,omap5-oppdm" - OMAP5+ optimized voltages in efuse(class0)VDD
			    along with VBB
	"ti,omap5-core-oppdm" - OMAP5+ optimized voltages in efuse(class0) VDD
			    but no VBB.
- vdd-supply: phandle to regulator controlling VDD supply
- vbb-supply: phandle to regulator controlling Body Bias supply (optional if
  "ti,omap5-core-oppdm")
  (Usually Adaptive Body Bias regulator)
- #oppdm-cells: shall be <0>
- reg: Address and length of the efuse register set for the device (mandatory
	only for "ti,omap5-oppdm")
- ti,efuse-settings: An array of u32 tuple items providing information about
	optimized efuse configuration. Each item consists of the following:
	volt: voltage in uV - reference voltage (OPP voltage)
	efuse_offseet: efuse offset from reg where the optimized voltage is stored.
- ti,absolute-max-voltage-uv: absolute maximum voltage for the OPP domain.

Example:

/* Basic OMAP OPP Domain with no Class0 support */
oppdm_mpu: oppdm@1 {
	compatible = "ti,omap-oppdm";
	#oppdm-cells = <0>;

	vdd-supply = <&vcc>;
	vbb-supply = <&abb_mpu>;
};

/* OMAP OPP Domain with Class0 registers */
oppdm_mpu: oppdm@4a003b20 {
	compatible = "ti,omap5-oppdm";
	#oppdm-cells = <0>;
	vdd-supply = <&vcc>;
	vbb-supply = <&abb_mpu>;
	reg = <0x4a003b20 0x8>;
	ti,efuse-settings = <
	/* uV   offset */
	1060000 0x0
	1160000 0x4
	1210000 0x8
	>;
	ti,absolute-max-voltage-uv = <1500000>;
};

oppdm_core: oppdm@4a003d20 {
	compatible = "ti,omap5-core-oppdm";
	#oppdm-cells = <0>;
	vdd-supply = <&smps4>;
	reg = <0x4a003b20 0x4>;
	ti,efuse-settings = <
	/* uV   offset */
	1060000 0x0
	>;
};
```

## Documentation/devicetree/bindings/pci/cdns-pcie-ep.yaml
```yaml
# SPDX-License-Identifier: (GPL-2.0-only OR BSD-2-Clause)
# Copyright (C) 2020 Texas Instruments Incorporated - http://www.ti.com/
%YAML 1.2
--
$id: "http://devicetree.org/schemas/pci/cdns-pcie-ep.yaml#"
$schema: "http://devicetree.org/meta-schemas/core.yaml#"

title: Cadence PCIe Endpoint

maintainers:
  - Tom Joseph <tjoseph@cadence.com>

allOf:
  - $ref: "cdns-pcie.yaml#"

properties:
  max-functions:
    description: Maximum number of functions that can be configured (default 1)
    allOf:
      - $ref: /schemas/types.yaml#/definitions/uint8
```

## Documentation/devicetree/bindings/pci/cdns-pcie-host.yaml
```yaml
# SPDX-License-Identifier: (GPL-2.0-only OR BSD-2-Clause)
# Copyright (C) 2020 Texas Instruments Incorporated - http://www.ti.com/
%YAML 1.2
---
$id: "http://devicetree.org/schemas/pci/cdns-pcie-host.yaml#"
$schema: "http://devicetree.org/meta-schemas/core.yaml#"

title: Cadence PCIe Host

maintainers:
  - Tom Joseph <tjoseph@cadence.com>

allOf:
  - $ref: "/schemas/pci/pci-bus.yaml#"
  - $ref: "cdns-pcie.yaml#"

properties:
  vendor-id:
    description: The PCI vendor ID (16 bits, default is design dependent)

  device-id:
    description: The PCI device ID (16 bits, default is design dependent)

  cdns,no-bar-match-nbits:
    description: Set into the no BAR match register to configure the number
      of least significant bits kept during inbound (PCIe -> AXI) address
      translations (default 32)
    allOf:
      - $ref: /schemas/types.yaml#/definitions/uint32
```

## Documentation/devicetree/bindings/pci/cdns-pcie.yaml
```yaml
# SPDX-License-Identifier: (GPL-2.0-only OR BSD-2-Clause)
# Copyright (C) 2020 Texas Instruments Incorporated - http://www.ti.com/
%YAML 1.2
---
$id: "http://devicetree.org/schemas/pci/cdns-pcie.yaml#"
$schema: "http://devicetree.org/meta-schemas/core.yaml#"

title: Cadence PCIe Core

maintainers:
  - Tom Joseph <tjoseph@cadence.com>

properties:
  max-link-speed:
    minimum: 1
    maximum: 3

  num-lanes:
    minimum: 1
    maximum: 2

  cdns,max-outbound-regions:
    description: Set to maximum number of outbound regions.
    allOf:
      - $ref: /schemas/types.yaml#/definitions/uint32

  phys:
    description: List of Generic PHY phandles. One per lane if more than one in
      the list. If only one PHY listed it must manage all lanes.

  phy-names:
    description: List of names to identify the PHY.
```

## Documentation/devicetree/bindings/pci/designware-pcie.txt
```
* Synopsys Designware PCIe interface

Required properties:
- compatible: should contain "snps,dw-pcie" to identify the core.
- reg: Should contain the configuration address space.
- reg-names: Must be "config" for the PCIe configuration space.
    (The old way of getting the configuration address space from "ranges"
    is deprecated and should be avoided.)
- #address-cells (only for host mode): set to <3>
- #size-cells (only for host mode): set to <2>
- device_type (only for host mode): set to "pci"
- ranges (only for host mode): ranges for the PCI memory and I/O regions
- num-ib-windows (only for EP mode): number of inbound address translation
	windows
- num-ob-windows (only for EP mode): number of outbound address translation
	windows
- #interrupt-cells (only for host mode): set to <1>
- interrupt-map-mask and interrupt-map (only for host mode): standard PCI
	properties to define the mapping of the PCIe interface to interrupt
	numbers.
- num-lanes: number of lanes to use

Optional properties:
- num-lanes: number of lanes to use (this property should be specified unless
  the link is brought already up in BIOS)
- reset-gpio (only for host mode): gpio pin number of power good signal
- bus-range (only for host mode): PCI bus numbers covered (it is recommended
  for new devicetrees to specify this property, to keep backwards compatibility
  a range of 0x00-0xff is assumed if not present)
- clocks: Must contain an entry for each entry in clock-names.
	See ../clocks/clock-bindings.txt for details.
- clock-names: Must include the following entries:
	- "pcie"
	- "pcie_bus"
```

## Documentation/devicetree/bindings/pci/endpoint/pci-epf-bus.txt
```
PCI Endpoint Function Bus

This describes the bindings for endpoint function bus to which endpoint
function devices should be attached.

Required Properties:
 - compatible: Should be "pci-epf-bus"

One or more subnodes representing PCIe endpoint function device exposed
to the remote host.

Example:
Following is an example of NTB device exposed to the remote host.

epf_bus {
	compatible = "pci-epf-bus";

	ntb {
		compatible = "pci-epf-ntb";
		epcs = <&pcie0_ep>, <&pcie1_ep>;
		epc-names = "primary", "secondary";
		vendor-id = /bits/ 16 <0x104c>;
		device-id = /bits/ 16 <0xb00d>;
		num-mws = <4>;
		mws-size = <0x100000>, <0x100000>, <0x100000>, <0x100000>;
	};
};
```

## Documentation/devicetree/bindings/pci/endpoint/pci-epf-ntb.txt
```
PCI Endpoint NTB Function Device

This describes the bindings to be used when a NTB device has to be
exposed to the remote host over PCIe.

Required Properties:
 - compatible: Should be "pci-epf-ntb"
 - epcs: As defined in generic pci-epf bindings defined in pci-epf.txt
 - epc-names: As defined in generic pci-epf bindings defined in pci-epf.txt
 - vendor-id: As defined in generic pci-epf bindings defined in pci-epf.txt
 - device-id: As defined in generic pci-epf bindings defined in pci-epf.txt
 - num-mws: Specify the number of memory windows. Should not be more than 4.
 - mws-size: List of 'num-mws' entries containing size of each memory window.

Optional Properties:
 - spad-count: Specify the number of scratchpad registers to be supported
 - db-count: Specify the number of doorbell interrupts to be supported. Must
	     not be greater than 32.

Example:
Following is an example of NTB device exposed to the remote host.

ntb {
	compatible = "pci-epf-ntb";
	epcs = <&pcie0_ep>, <&pcie1_ep>;
	epc-names = "primary", "secondary";
	vendor-id = /bits/ 16 <0x104c>;
	device-id = /bits/ 16 <0xb00d>;
	num-mws = <4>;
	mws-size = <0x100000>, <0x100000>, <0x100000>, <0x100000>;
};
```

## Documentation/devicetree/bindings/pci/endpoint/pci-epf.txt
```
PCI Endpoint Function Device

This describes the generic bindings to be used when a device has to be
exposed to the remote host over PCIe. The device could be an actual
peripheral in the platform or a virtual device created by the software.

epcs : phandle to the endpoint controller device
epc-names : the names of the endpoint controller device corresponding
	    to the EPCs present in the *epcs* phandle
vendor-id: used to identify device manufacturer
device-id: used to identify a particular device
baseclass-code: used to classify the type of function the device performs
subclass-code: used to identify more specifically the function of the device
subsys-vendor-id: used to identify vendor of the add-in card or subsystem
subsys-id: used to specify an id that is specific to a vendor

Example:
Following is an example of NTB device exposed to the remote host.

ntb {
	compatible = "pci-epf-ntb";
	epcs = <&pcie0_ep>, <&pcie1_ep>;
	epc-names = "primary", "secondary";
	vendor-id = /bits/ 16 <0x104c>;
	device-id = /bits/ 16 <0xb00d>;
	num-mws = <4>;
	mws-size = <0x100000>, <0x100000>, <0x100000>, <0x100000>;
};
```
