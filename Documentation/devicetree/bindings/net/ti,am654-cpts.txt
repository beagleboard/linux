## Documentation/devicetree/bindings/pci/pci-keystone.txt
```
TI Keystone PCIe interface

Keystone PCI host Controller is based on the Synopsys DesignWare PCI
hardware version 3.65.  It shares common functions with the PCIe DesignWare
core driver and inherits common properties defined in
Documentation/devicetree/bindings/pci/designware-pci.txt

Please refer to Documentation/devicetree/bindings/pci/designware-pci.txt
for the details of DesignWare DT bindings.  Additional properties are
described here as well as properties that are not applicable.

Required Properties:-

compatibility: Should be "ti,keystone-pcie" for RC
	       Should be "ti,keystone-pcie-ep" for EP
	       Should be "ti,am654-pcie-rc" for RC on AM654x SoC
	       Should be "ti,am654-pcie-ep" for EP on AM654x SoC

reg: Three register ranges as listed in the reg-names property
reg-names: "dbics" for the DesignWare PCIe registers, "app" for the
	   TI specific application registers, "config" for the
	   configuration space address for a device (used only in
	   RC mode) and "addr_space" used to map remote RC address space
	   (used only in EP mode).
interrupts: platform interrupt for error interrupts.
ti,syscon-pcie-id : phandle to the device control module required to set device
		    id and vendor id.
ti,syscon-pcie-mode : phandle to the device control module required to configure
		      PCI in either RC mode or EP mode.
num-ob-windows : number of outbound address translation window

HOST MODE
=========
pcie_msi_intc : Interrupt controller device node for MSI IRQ chip
	interrupt-cells: should be set to 1
	interrupt-parent: Parent interrupt controller phandle
	interrupts: GIC interrupt lines connected to PCI MSI interrupt lines
	(required if the compatible is "ti,keystone-pcie")
msi-map: As specified in Documentation/devicetree/bindings/pci/pci-msi.txt
	 (required if the compatible is "ti,am654-pcie-rc".

num-ob-windows : number of outbound address translation window

 Example:
	pcie_msi_intc: msi-interrupt-controller {
			interrupt-controller;
			#interrupt-cells = <1>;
			interrupt-parent = <&gic>;
			interrupts = <GIC_SPI 30 IRQ_TYPE_EDGE_RISING>,
					<GIC_SPI 31 IRQ_TYPE_EDGE_RISING>,
					<GIC_SPI 32 IRQ_TYPE_EDGE_RISING>,
					<GIC_SPI 33 IRQ_TYPE_EDGE_RISING>,
					<GIC_SPI 34 IRQ_TYPE_EDGE_RISING>,
					<GIC_SPI 35 IRQ_TYPE_EDGE_RISING>,
					<GIC_SPI 36 IRQ_TYPE_EDGE_RISING>,
					<GIC_SPI 37 IRQ_TYPE_EDGE_RISING>;
	};

pcie_intc: Interrupt controller device node for Legacy IRQ chip
	interrupt-cells: should be set to 1
	interrupt-parent: Parent interrupt controller phandle
	interrupts: GIC interrupt lines connected to PCI Legacy interrupt lines

 Example:
	pcie_intc: legacy-interrupt-controller {
		interrupt-controller;
		#interrupt-cells = <1>;
		interrupt-parent = <&gic>;
		interrupts = <GIC_SPI 26 IRQ_TYPE_EDGE_RISING>,
			<GIC_SPI 27 IRQ_TYPE_EDGE_RISING>,
			<GIC_SPI 28 IRQ_TYPE_EDGE_RISING>,
			<GIC_SPI 29 IRQ_TYPE_EDGE_RISING>;
	};

DesignWare DT Properties not applicable for Keystone PCI

1. pcie_bus clock-names not used.  Instead, a phandle to phys is used.

DEVICE MODE
===========
num-ib-windows : number of inbound address translation windows

Optional Properties:
max-link-speed: As defined in Documentation/devicetree/bindings/pci/pci.txt
reset-gpios: GPIO spec for the PERST# signal (only host mode)
```

## Documentation/devicetree/bindings/pci/ti,am65-pci-ep.yaml
```yaml
# SPDX-License-Identifier: (GPL-2.0-only OR BSD-2-Clause)
# Copyright (C) 2021 Texas Instruments Incorporated - http://www.ti.com/
%YAML 1.2
---
$id: http://devicetree.org/schemas/pci/ti,am65-pci-ep.yaml#
$schema: http://devicetree.org/meta-schemas/core.yaml#

title: TI AM65 PCI Endpoint

maintainers:
  - Kishon Vijay Abraham I <kishon@ti.com>

allOf:
  - $ref: pci-ep.yaml#

properties:
  compatible:
    enum:
      - ti,am654-pcie-ep

  reg:
    maxItems: 4

  reg-names:
    items:
      - const: app
      - const: dbics
      - const: addr_space
      - const: atu

  power-domains:
    maxItems: 1

  ti,syscon-pcie-mode:
    $ref: /schemas/types.yaml#/definitions/phandle-array
    items:
      - items:
          - description: Phandle to the SYSCON entry
          - description: pcie_ctrl register offset within SYSCON
    description: Phandle to the SYSCON entry required for configuring PCIe in RC or EP mode.

  interrupts:
    minItems: 1

  dma-coherent: true

required:
  - compatible
  - reg
  - reg-names
  - max-link-speed
  - num-lanes
  - power-domains
  - ti,syscon-pcie-mode
  - phys
  - phy-names
  - dma-coherent

unevaluatedProperties: false

examples:
  - |
    #include <dt-bindings/soc/ti,sci_pm_domain.h>
    #include <dt-bindings/gpio/gpio.h>
    #include <dt-bindings/interrupt-controller/arm-gic.h>
    #include <dt-bindings/interrupt-controller/irq.h>


    bus {
        #address-cells = <2>;
        #size-cells = <2>;

        pcie0_ep: pcie-ep@5500000 {
                compatible = "ti,am654-pcie-ep";
                reg =  <0x0 0x5500000 0x0 0x1000>,
                       <0x0 0x5501000 0x0 0x1000>,
                       <0x0 0x10000000 0x0 0x8000000>,
                       <0x0 0x5506000 0x0 0x1000>;
                reg-names = "app", "dbics", "addr_space", "atu";
                power-domains = <&k3_pds 120 TI_SCI_PD_EXCLUSIVE>;
                ti,syscon-pcie-mode = <&pcie0_mode>;
                num-ib-windows = <16>;
                num-ob-windows = <16>;
                max-link-speed = <2>;
                dma-coherent;
                interrupts = <GIC_SPI 340 IRQ_TYPE_EDGE_RISING>;
        };
    };
```

## Documentation/devicetree/bindings/pci/ti,am65-pci-host.yaml
```yaml
# SPDX-License-Identifier: (GPL-2.0-only OR BSD-2-Clause)
# Copyright (C) 2021 Texas Instruments Incorporated - http://www.ti.com/
%YAML 1.2
---
$id: "http://devicetree.org/schemas/pci/ti,am65-pci-host.yaml#"
$schema: "http://devicetree.org/meta-schemas/core.yaml#"

title: TI AM65 PCI Host

maintainers:
  - Kishon Vijay Abraham I <kishon@ti.com>

allOf:
  - $ref: /schemas/pci/pci-bus.yaml#

properties:
  compatible:
    enum:
      - ti,am654-pcie-rc

  reg:
    maxItems: 4

  reg-names:
    items:
      - const: app
      - const: dbics
      - const: config
      - const: atu

  power-domains:
    maxItems: 1

  ti,syscon-pcie-id:
    description: Phandle to the SYSCON entry required for getting PCIe device/vendor ID
    $ref: /schemas/types.yaml#/definitions/phandle

  ti,syscon-pcie-mode:
    description: Phandle to the SYSCON entry required for configuring PCIe in RC or EP mode.
    $ref: /schemas/types.yaml#/definitions/phandle

  phys:
    description:
      One per lane if more than one in the list. If only one PHY listed it must
      manage all lanes.
    minItems: 1
    maxItems: 16

  phy-names:
    items:
      - const: pcie-phy0

  msi-map: true

  dma-coherent: true

patternProperties:
  interrupt-controller:
    type: object
    description: interrupt controller to handle legacy interrupts.

required:
  - compatible
  - reg
  - reg-names
  - max-link-speed
  - num-lanes
  - power-domains
  - ti,syscon-pcie-id
  - ti,syscon-pcie-mode
  - msi-map
  - ranges
  - reset-gpios
  - phys
  - phy-names
  - dma-coherent

unevaluatedProperties: false

examples:
  - |
    #include <dt-bindings/interrupt-controller/arm-gic.h>
    #include <dt-bindings/interrupt-controller/irq.h>
    #include <dt-bindings/soc/ti,sci_pm_domain.h>
    #include <dt-bindings/gpio/gpio.h>
    #include <dt-bindings/phy/phy.h>

    bus {
        #address-cells = <2>;
        #size-cells = <2>;

        pcie0_rc: pcie@5500000 {
                compatible = "ti,am654-pcie-rc";
                reg =  <0x0 0x5500000 0x0 0x1000>,
                       <0x0 0x5501000 0x0 0x1000>,
                       <0x0 0x10000000 0x0 0x2000>,
                       <0x0 0x5506000 0x0 0x1000>;
                reg-names = "app", "dbics", "config", "atu";
                power-domains = <&k3_pds 120 TI_SCI_PD_EXCLUSIVE>;
                #address-cells = <3>;
                #size-cells = <2>;
                ranges = <0x81000000 0 0          0x0 0x10020000 0 0x00010000>,
                         <0x82000000 0 0x10030000 0x0 0x10030000 0 0x07FD0000>;
                ti,syscon-pcie-id = <&pcie_devid>;
                ti,syscon-pcie-mode = <&pcie0_mode>;
                bus-range = <0x0 0xff>;
                num-viewport = <16>;
                max-link-speed = <2>;
                dma-coherent;
                device_type = "pci";
                num-lanes = <1>;
                phys = <&serdes1 PHY_TYPE_PCIE 0>;
                phy-names = "pcie-phy0";
                reset-gpios = <&pca9555 5 GPIO_ACTIVE_HIGH>;
                interrupts = <GIC_SPI 340 IRQ_TYPE_EDGE_RISING>;
                msi-map = <0x0 &gic_its 0x0 0x10000>;
                #interrupt-cells = <1>;
                interrupt-map-mask = <0 0 0 7>;
                interrupt-map = <0 0 0 1 &pcie0_intc 0>, /* INT A */
                                <0 0 0 2 &pcie0_intc 0>, /* INT B */
                                <0 0 0 3 &pcie0_intc 0>, /* INT C */
                                <0 0 0 4 &pcie0_intc 0>; /* INT D */

                pcie0_intc: interrupt-controller {
                        interrupt-controller;
                        #interrupt-cells = <1>;
                        interrupt-parent = <&gic500>;
                        interrupts = <GIC_SPI 328 IRQ_TYPE_EDGE_RISING>;
                };
        };
    };
```

## Documentation/devicetree/bindings/pci/ti,j721e-pci-ep.yaml
```yaml
# SPDX-License-Identifier: (GPL-2.0-only OR BSD-2-Clause)
# Copyright (C) 2019 Texas Instruments Incorporated - http://www.ti.com/
%YAML 1.2
---
$id: "http://devicetree.org/schemas/pci/ti,j721e-pci-ep.yaml#"
$schema: "http://devicetree.org/meta-schemas/core.yaml#"

title: TI J721E PCI EP (PCIe Wrapper)

maintainers:
  - Kishon Vijay Abraham I <kishon@ti.com>

allOf:
  - $ref: "cdns-pcie-ep.yaml#"

properties:
  compatible:
      enum:
          - ti,j721e-pcie-ep
          - ti,j7200-pcie-ep

  reg:
    maxItems: 4

  reg-names:
    items:
      - const: intd_cfg
      - const: user_cfg
      - const: reg
      - const: mem

  ti,syscon-pcie-ctrl:
    description: Phandle to the SYSCON entry required for configuring PCIe mode
                 and link speed.
    allOf:
      - $ref: /schemas/types.yaml#/definitions/phandle

  power-domains:
    maxItems: 1

  clocks:
    maxItems: 1
    description: clock-specifier to represent input to the PCIe

  clock-names:
    items:
      - const: fck

  max-functions:
    minimum: 1
    maximum: 6

  max-virtual-functions:
    minItems: 1
    maxItems: 6
    description: As defined in
                 Documentation/devicetree/bindings/pci/cdns,cdns-pcie-ep.txt

  dma-coherent:
    description: Indicates that the PCIe IP block can ensure the coherency

required:
  - compatible
  - reg
  - reg-names
  - ti,syscon-pcie-ctrl
  - max-link-speed
  - num-lanes
  - power-domains
  - clocks
  - clock-names
  - cdns,max-outbound-regions
  - dma-coherent
  - max-functions
  - max-virtual-functions
  - phys
  - phy-names

examples:
  - |
    #include <dt-bindings/soc/ti,sci_pm_domain.h>

     pcie0_ep: pcie-ep@d000000 {
            compatible = "ti,j721e-pcie-ep";
            reg = <0x00 0x02900000 0x00 0x1000>,
                  <0x00 0x02907000 0x00 0x400>,
                  <0x00 0x0d000000 0x00 0x00800000>,
                  <0x00 0x10000000 0x00 0x08000000>;
            reg-names = "intd_cfg", "user_cfg", "reg", "mem";
            ti,syscon-pcie-ctrl = <&pcie0_ctrl>;
            max-link-speed = <3>;
            num-lanes = <2>;
            power-domains = <&k3_pds 239 TI_SCI_PD_EXCLUSIVE>;
            clocks = <&k3_clks 239 1>;
            clock-names = "fck";
            cdns,max-outbound-regions = <16>;
            max-functions = /bits/ 8 <6>;
            max-virtual-functions = /bits/ 16 <4 4 4 4 0 0>;
            dma-coherent;
            phys = <&serdes0_pcie_link>;
            phy-names = "pcie_phy";
    };
```
