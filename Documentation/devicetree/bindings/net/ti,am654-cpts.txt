## Documentation/devicetree/bindings/pci/ti,j721e-pci-host.yaml
```yaml
# SPDX-License-Identifier: (GPL-2.0-only OR BSD-2-Clause)
# Copyright (C) 2019 Texas Instruments Incorporated - http://www.ti.com/
%YAML 1.2
---
$id: "http://devicetree.org/schemas/pci/ti,j721e-pci-host.yaml#"
$schema: "http://devicetree.org/meta-schemas/core.yaml#"

title: TI J721E PCI Host (PCIe Wrapper)

maintainers:
  - Kishon Vijay Abraham I <kishon@ti.com>

properties:
  compatible:
    oneOf:
      - const: ti,j721e-pcie-host
      - const: ti,j784s4-pcie-host
      - description: PCIe controller in AM64
        items:
          - const: ti,am64-pcie-host
          - const: ti,j721e-pcie-host
      - description: PCIe controller in J7200
        items:
          - const: ti,j7200-pcie-host
          - const: ti,j721e-pcie-host
      - description: PCIe controller in J722S
        items:
          - const: ti,j722s-pcie-host
          - const: ti,j721e-pcie-host

  reg:
    maxItems: 4

  reg-names:
    items:
      - const: intd_cfg
      - const: user_cfg
      - const: reg
      - const: cfg

  ti,syscon-pcie-ctrl:
    $ref: /schemas/types.yaml#/definitions/phandle-array
    items:
      - items:
          - description: Phandle to the SYSCON entry
          - description: pcie_ctrl register offset within SYSCON
    description: Specifier for configuring PCIe mode and link speed.

  ti,syscon-pcie-refclk-out:
    $ref: /schemas/types.yaml#/definitions/phandle-array
    items:
      - items:
          - description: Phandle to the SYSCON entry
          - description: lock2_kick0 register offset within SYSCON
          - description: lock2_kick1 register offset within SYSCON
          - description: acspcie_ctrl register offset within SYSCON
          - description: pcie_refclk_clksel register offset within SYSCON
          - description: clock source index to source ref clock
    description: Specifier for enabling ACSPCIe clock buffer for reference clock output.

  power-domains:
    maxItems: 1

  clocks:
    minItems: 1
    maxItems: 2
    description: |+
      clock-specifier to represent input to the PCIe for 1 item.
      2nd item if present represents reference clock to the connector.

  clock-names:
    minItems: 1
    items:
      - const: fck
      - const: pcie_refclk

  dma-coherent: true

  vendor-id:
    const: 0x104c

  device-id:
    oneOf:
      - items:
          - const: 0xb00d
      - items:
          - const: 0xb00f
      - items:
          - const: 0xb010
      - items:
          - const: 0xb012
      - items:
          - const: 0xb013

  msi-map: true

  interrupts:
    maxItems: 1

  interrupt-names:
    items:
      - const: link_state

  interrupt-controller:
    type: object
    additionalProperties: false

    properties:
      interrupt-controller: true

      '#interrupt-cells':
        const: 1

      interrupts:
        maxItems: 1

allOf:
  - $ref: cdns-pcie-host.yaml#
  - if:
      properties:
        compatible:
          enum:
            - ti,am64-pcie-host
    then:
      properties:
        num-lanes:
          const: 1

  - if:
      properties:
        compatible:
          enum:
            - ti,j7200-pcie-host
            - ti,j721e-pcie-host
    then:
      properties:
        num-lanes:
          minimum: 1
          maximum: 2

  - if:
      properties:
        compatible:
          enum:
            - ti,j784s4-pcie-host
    then:
      properties:
        num-lanes:
          minimum: 1
          maximum: 4

required:
  - compatible
  - reg
  - reg-names
  - ti,syscon-pcie-ctrl
  - ti,syscon-pcie-refclk-out
  - max-link-speed
  - num-lanes
  - power-domains
  - clocks
  - clock-names
  - vendor-id
  - device-id
  - msi-map
  - dma-ranges
  - ranges
  - reset-gpios
  - phys
  - phy-names

unevaluatedProperties: false

examples:
  - |
    #include <dt-bindings/soc/ti,sci_pm_domain.h>
    #include <dt-bindings/gpio/gpio.h>
    #include <dt-bindings/interrupt-controller/arm-gic.h>
    #include <dt-bindings/interrupt-controller/irq.h>

    bus {
        #address-cells = <2>;
        #size-cells = <2>;

        pcie0_rc: pcie@2900000 {
            compatible = "ti,j721e-pcie-host";
            reg = <0x00 0x02900000 0x00 0x1000>,
                  <0x00 0x02907000 0x00 0x400>,
                  <0x00 0x0d000000 0x00 0x00800000>,
                  <0x00 0x10000000 0x00 0x00001000>;
            reg-names = "intd_cfg", "user_cfg", "reg", "cfg";
            ti,syscon-pcie-ctrl = <&pcie0_ctrl 0x4070>;
            max-link-speed = <3>;
            num-lanes = <2>;
            power-domains = <&k3_pds 239 TI_SCI_PD_EXCLUSIVE>;
            clocks = <&k3_clks 239 1>;
            clock-names = "fck";
            device_type = "pci";
            #address-cells = <3>;
            #size-cells = <2>;
            bus-range = <0x0 0xf>;
            vendor-id = <0x104c>;
            device-id = <0xb00d>;
            msi-map = <0x0 &gic_its 0x0 0x10000>;
            dma-coherent;
            reset-gpios = <&exp1 6 GPIO_ACTIVE_HIGH>;
            phys = <&serdes0_pcie_link>;
            phy-names = "pcie-phy";
            ranges = <0x01000000 0x0 0x10001000  0x00 0x10001000  0x0 0x0010000>,
                     <0x02000000 0x0 0x10011000  0x00 0x10011000  0x0 0x7fef000>;
            dma-ranges = <0x02000000 0x0 0x0 0x0 0x0 0x10000 0x0>;
            #interrupt-cells = <1>;
            interrupt-map-mask = <0 0 0 7>;
            interrupt-map = <0 0 0 1 &pcie1_intc 0>, /* INT A */
                            <0 0 0 2 &pcie1_intc 0>, /* INT B */
                            <0 0 0 3 &pcie1_intc 0>, /* INT C */
                            <0 0 0 4 &pcie1_intc 0>; /* INT D */

            pcie1_intc: interrupt-controller {
                    interrupt-controller;
                    #interrupt-cells = <1>;
                    interrupt-parent = <&gic500>;
                    interrupts = <GIC_SPI 324 IRQ_TYPE_EDGE_RISING>;
            };

        };
    };

  - |
    #include <dt-bindings/mux/mux.h>
    #include <dt-bindings/mux/ti-serdes.h>
    #include <dt-bindings/phy/phy.h>
    #include <dt-bindings/phy/phy-ti.h>
    #include <dt-bindings/interrupt-controller/arm-gic.h>
    #include <dt-bindings/interrupt-controller/irq.h>

    bus {
        #address-cells = <2>;
        #size-cells = <2>;

        pcie1_rc: pcie@2910000 {
                compatible = "ti,j784s4-pcie-host";
                reg = <0x00 0x02910000 0x00 0x1000>,
                      <0x00 0x02917000 0x00 0x400>,
                      <0x00 0x0d800000 0x00 0x00800000>,
                      <0x00 0x18000000 0x00 0x00001000>;
                reg-names = "intd_cfg", "user_cfg", "reg", "cfg";
                interrupt-names = "link_state";
                interrupts = <GIC_SPI 330 IRQ_TYPE_EDGE_RISING>;
                device_type = "pci";
                ti,syscon-pcie-ctrl = <&scm_conf 0x4074>;
                ti,syscon-pcie-refclk-out = <&scm_conf 0x9008 0x900c 0x18090 0x8074 0x1>;
                max-link-speed = <3>;
                num-lanes = <4>;
                power-domains = <&k3_pds 333 TI_SCI_PD_EXCLUSIVE>;
                clocks = <&k3_clks 333 0>;
                clock-names = "fck";
                #address-cells = <3>;
                #size-cells = <2>;
                bus-range = <0x0 0xff>;
                vendor-id = <0x104c>;
                device-id = <0xb013>;
                msi-map = <0x0 &gic_its 0x10000 0x10000>;
                dma-coherent;
                ranges = <0x01000000 0x0 0x18001000  0x00 0x18001000  0x0 0x0010000>,
                         <0x02000000 0x0 0x18011000  0x00 0x18011000  0x0 0x7fef000>;
                dma-ranges = <0x02000000 0x0 0x0 0x0 0x0 0x10000 0x0>;
                #interrupt-cells = <1>;
                interrupt-map-mask = <0 0 0 7>;
                interrupt-map = <0 0 0 1 &pcie0_intc 0>,
                                <0 0 0 2 &pcie0_intc 0>,
                                <0 0 0 3 &pcie0_intc 0>,
                                <0 0 0 4 &pcie0_intc 0>;
                status = "disabled";

                pcie0_intc: interrupt-controller {
                        interrupt-controller;
                        #interrupt-cells = <1>;
                        interrupt-parent = <&gic500>;
                        interrupts = <GIC_SPI 312 IRQ_TYPE_EDGE_RISING>;
                };
        };
    };
```

## Documentation/devicetree/bindings/pci/ti,j721e-pci.txt
```
PCI Controller in J721E:
Required Properties:
 - compatible: Should be "ti,j721e-pcie"
 - reg : Two register ranges as listed in the reg-names property
 - reg-names : The first entry must be "intd_cfg" used for handling legacy
     interrupts. The second entry must be "user_cfg" and it has registers
     for enabling the LTSSM. The third entry must be "vmap" and it has
     registers for programming the requestor ID to VIRTID mapping and ATYPE.
 - #address-cells : should be 1 to indicate the child node should use 1 cell
     for address
 - #size-cells : should be 1 to indicate the child node should use 1 cell for
     size
 - mode : should be <PCI_MODE_RC> for RC mode and should be <PCI_MODE_EP> for
     EP mode

Optional Properties:
 - max-link-speed: As defined in Documentation/devicetree/bindings/pci/pci.txt
     Default is GEN3
 - num-lanes: number of lanes to use. Default is '1' lane
It should have two child nodes, one for RC mode (pcie) and the other for EP
mode (pcie-ep). The child node for RC should follow the binding in
cdns,cdns-pcie-host.txt. The child node for the EP should follow the binding
in cdns,cdns-pcie-ep.txt

Example:
	pcie0: pcie@2900000 {
		compatible = "ti,j721e-pcie";
		reg = <0x02900000 0x1000>,
		      <0x02907000 0x400>;
		reg-names = "intd_cfg", "user_cfg";
		#address-cells = <1>;
		#size-cells = <1>;
		ranges;

		pcie0_rc: pcie@d000000 {
			compatible = "cdns,cdns-pcie-host";
			reg = <0x0d000000 0x00800000>,
			      <0x10000000 0x00001000>,
			      <0x10000000 0x08000000>;
			reg-names = "reg", "cfg", "mem";
			device_type = "pci";
			#address-cells = <3>;
			#size-cells = <2>;
			bus-range = <0x0 0xff>;
			linux,pci-domain = <0>;
			cdns,max-outbound-regions = <16>;
			cdns,no-bar-match-nbits = <32>;
			vendor-id = /bits/ 16 <0x17cd>;
			device-id = /bits/ 16 <0x0200>;
			msi-map = <0x0 &gic_its 0x0 0x1000>;
			ranges = <0x01000000 0x0 0x10001000  0x10001000  0x0 0x0010000>,
				 <0x02000000 0x0 0x10011000  0x10011000  0x0 0x7fef000>;
		};

		pcie0_ep: pcie-ep@d000000 {
			compatible = "cdns,cdns-pcie-ep";
			reg = <0x0d000000 0x00800000>,
			      <0x10000000 0x08000000>;
			reg-names = "reg", "mem";
			cdns,max-outbound-regions = <16>;
			max-functions = /bits/ 8 <2>;
		};
	};
```
