## Documentation/devicetree/bindings/net/ti,cpsw-virt-mac.txt
```
TI J721E VIRT CPSWxg Ethernet mac
======================================

Required properties:
- compatible       : Should be "ti,j721e-cpsw-virt-mac" for J721E Family SoCs
- dma-coherent	: indicates that device operates with coherent memory.
- dmas		: list of UDMA controller channel specifiers [2]
- dma-names	: should be "tx0", "tx1", "tx2", "tx3", "tx4", "tx5", "tx6",
		"tx7", "rx";
- ti,psil-base : CPSWxg NUSS PSI-L endpoint thread ID base of the UDMA-P
		channels. The PSI-L endpoint node thread configuration
		subnodes must be present present with ti,psil-configX naming
		convention, where X is the thread ID offset [2].
- ti,remote-name: Name of the connected rpmsg-kdrv device represented
		by Eth switch FW running on the on of R5F cores.
		Should be "mpu_1_0_ethswitch-device-0" for J721E Family SoCs.

Required Sub-nodes:
- virt_emac_port: contains VIRT CPSWxg Ethernet mac port descriptions
	Optional properties - all ports:
	- ti,label : Describes the label associated with this port
	- local-mac-address: array of 6 bytes, the assigned MAC address [3].

The MAC address provided by Eth switch FW will be used if neither of
"mac-address" and "local-mac-address" is defined.

References:
 [2] Documentation/devicetree/bindings/dma/ti/k3-udma.yaml
 [3] Documentation/devicetree/bindings/net/ethernet-controller.yaml

Examples:
	cpsw9g_virt_mac: main_r5fss_cpsw9g_virt_mac0 {
		compatible = "ti,j721e-cpsw-virt-mac";
		dma-coherent;
		ti,psil-base = <0x4a00>;
		ti,remote-name = "mpu_1_0_ethswitch-device-0";

		dmas = <&main_udmap 0xca00>,
		       <&main_udmap 0xca01>,
		       <&main_udmap 0xca02>,
		       <&main_udmap 0xca03>,
		       <&main_udmap 0xca04>,
		       <&main_udmap 0xca05>,
		       <&main_udmap 0xca06>,
		       <&main_udmap 0xca07>,
		       <&main_udmap 0x4a00>;
		dma-names = "tx0", "tx1", "tx2", "tx3",
			    "tx4", "tx5", "tx6", "tx7",
			    "rx";

		virt_emac_port {
			ti,label = "virt-port";
			/* local-mac-address = [0 0 0 0 0 0]; */
		};
	};
```

## Documentation/devicetree/bindings/net/ti,cpsw-virt-mac.yaml
```yaml
# SPDX-License-Identifier: (GPL-2.0-only OR BSD-2-Clause)
%YAML 1.2
---
$id: http://devicetree.org/schemas/net/ti,cpsw-virt-mac.yaml#
$schema: http://devicetree.org/meta-schemas/core.yaml#

title: TI J721E VIRT CPSWxg Ethernet mac

maintainers:
  - Siddharth Vadapalli <s-vadapalli@ti.com>

description: |
  This document defines the bindings for the Virtual Mac thin client Linux
  driver that utilizes Remoteproc Framework to communicate and exchange
  network data with the EthSwitch Firmware running on the R-Core.

properties:
  compatible:
    const: ti,j721e-cpsw-virt-mac

  dma-coherent: true

  dmas:
    maxItems: 9

  dma-names:
    items:
      - const: tx0
      - const: tx1
      - const: tx2
      - const: tx3
      - const: tx4
      - const: tx5
      - const: tx6
      - const: tx7
      - const: rx

  ti,psil-base:
    $ref: /schemas/types.yaml#/definitions/uint32
    description: |
      CPSWxg NUSS PSI-L endpoint thread ID base of the UDMA-P
      channels. The PSI-L endpoint node thread configuration
      subnodes must be present with ti,psil-configX naming
      convention, where X is the thread ID offset.

  ti,remote-name:
    $ref: /schemas/types.yaml#/definitions/string
    description: |
      Name of the connected rpmsg-kdrv device represented
      by Eth switch FW running on one of the R5F cores.
    items:
      - enum:
          - mpu_1_0_ethswitch-device-0
          - mpu_1_0_ethmac-device-1

  virt-emac-port:
    type: object
    properties:

      ti,label:
        $ref: /schemas/types.yaml#/definitions/string
        description: |
          Describes the label associated with this port.
        items:
          - const: virt-port

      local-mac-address: true

required:
  - compatible
  - dmas
  - dma-names
  - ti,psil-base
  - ti,remote-name
  - virt-emac-port

additionalProperties: false

examples:
  - |
    cpsw9g_virt_mac: main-r5fss-cpsw9g-virt-mac0 {
            compatible = "ti,j721e-cpsw-virt-mac";
            dma-coherent;
            ti,psil-base = <0x4a00>;
            ti,remote-name = "mpu_1_0_ethswitch-device-0";

            dmas = <&main_udmap 0xca00>,
                   <&main_udmap 0xca01>,
                   <&main_udmap 0xca02>,
                   <&main_udmap 0xca03>,
                   <&main_udmap 0xca04>,
                   <&main_udmap 0xca05>,
                   <&main_udmap 0xca06>,
                   <&main_udmap 0xca07>,
                   <&main_udmap 0x4a00>;
            dma-names = "tx0", "tx1", "tx2", "tx3",
                        "tx4", "tx5", "tx6", "tx7",
                        "rx";

            virt-emac-port {
                    ti,label = "virt-port";
                    /* local-mac-address = [0 0 0 0 0 0]; */
            };
    };
```

## Documentation/devicetree/bindings/net/ti,icss-iep.yaml
```yaml
# SPDX-License-Identifier: (GPL-2.0-only OR BSD-2-Clause)
%YAML 1.2
---
$id: http://devicetree.org/schemas/net/ti,icss-iep.yaml#
$schema: http://devicetree.org/meta-schemas/core.yaml#

title: Texas Instruments ICSS Industrial Ethernet Peripheral (IEP) module

maintainers:
  - Lokesh Vutla <lokeshvutla@ti.com>

properties:
  compatible:
    enum:
      - ti,am654-icss-iep   # for K3 AM65x, J721E and AM64x SoCs

  reg:
    maxItems: 1

  clocks:
    maxItems: 1
    description: phandle to the IEP source clock

required:
  - compatible
  - reg
  - clocks

additionalProperties: false

examples:
  - |
    icssg0_iep0: iep@2e000 {
        compatible = "ti,am654-icss-iep";
        reg = <0x2e000 0x1000>;
        clocks = <&icssg0_iepclk_mux>;
    };
```

## Documentation/devicetree/bindings/net/ti,icssg-prueth.txt
```
Texas Instruments ICSSG PRUSS Ethernet
======================================

Required properties:
- compatible       : Should be "ti,am654-icssg-prueth" for AM65x Family SoCs
		     "ti,am654-icssg-prueth-sr1" for SR1.0
- prus             : list of pHandles to the PRU, RTU and TX_PRU nodes
- firmware-name    : should contain the name of the firmware image
			file located in the firmware search path
- sram	           : phandle to MSMC SRAM node
- dmas		   : list of phandles and specifiers to UDMA as specified in
			bindings/dma/ti/k3-udma.txt.
- dma-names	   : Names for the DMA channels.
			Should be "tx0-0", "tx0-1", "tx0-2", "0-3",
			    "tx1-0", "tx1-1", "tx1-2", "tx1-3",
			    "rx0", "rx1", "rxmgm0", "rxmgm1"
- mii-g-rt	   : phandle to MII_G_RT module's syscon regmap.
- mii-rt	   : phandle to MII_RT module's syscon regmap.

Must contain children, one for each of the MAC ports.
Children must be named ethernet-mii0 and ethernet-mii1.
Either one or both children can be present. If only one
child is present driver operates in single EMAC mode.

For single mode operation with the 2nd SLICE, you still need
to provide both PRUs and RTUs and firmware-names but the firmware-name
for the first PRU & RTU can be NULL.

Required properties for children:
- phy-handle       : See ethernet.txt file in the same directory.
- phy-mode         : See ethernet.txt file in the same directory.
- syscon-rgmii-delay : phandle to system controller node and register offset
			to ICSSG control register for RGMII transmit delay.

Required properties for children: (SR2.0 only)
- interrupts-extended	: Interrupt specifier to TX timestamp IRQ.

Optional properties for children:
- local-mac-address	: mac address for the port.
- iep			: phandle to IEP module's syscon regmap.
- ti,pruss-gp-mux-sel	: GP-MUX value required for both ports.

Example (k3-am654 base board SR2.0, dual-emac):
==============================================

	/* Dual Ethernet application node on PRU-ICSSG2 */
	pruss2_eth: pruss2_eth {
		compatible = "ti,am654-icssg-prueth";
		pinctrl-names = "default";
		pinctrl-0 = <&icssg2_rgmii_pins_default>;
		sram = <&msmc_ram>;

		prus = <&pru2_0>, <&rtu2_0>, <&tx_pru2_0>, <&pru2_1>, <&rtu2_1>, <&tx_pru2_1>;
		firmware-name = "ti-pruss/am65x-sr2-pru0-prueth-fw.elf",
				"ti-pruss/am65x-sr2-rtu0-prueth-fw.elf",
				"ti-pruss/am65x-sr2-txpru0-prueth-fw.elf",
				"ti-pruss/am65x-sr2-pru1-prueth-fw.elf",
				"ti-pruss/am65x-sr2-rtu1-prueth-fw.elf",
				"ti-pruss/am65x-sr2-txpru1-prueth-fw.elf";
		ti,pruss-gp-mux-sel = <2>,      /* MII mode */
				      <2>,
				      <2>,
				      <2>,	/* MII mode */
				      <2>,
				      <2>;
		mii-g-rt = <&icssg2_mii_g_rt>;
		dma-coherent;
		dmas = <&main_udmap 0xc300>, /* egress slice 0 */
		       <&main_udmap 0xc301>, /* egress slice 0 */
		       <&main_udmap 0xc302>, /* egress slice 0 */
		       <&main_udmap 0xc303>, /* egress slice 0 */
		       <&main_udmap 0xc304>, /* egress slice 1 */
		       <&main_udmap 0xc305>, /* egress slice 1 */
		       <&main_udmap 0xc306>, /* egress slice 1 */
		       <&main_udmap 0xc307>, /* egress slice 1 */

		       <&main_udmap 0x4300>, /* ingress slice 0 */
		       <&main_udmap 0x4301>, /* ingress slice 1 */
		       <&main_udmap 0x4302>, /* mgmnt rsp slice 0 */
		       <&main_udmap 0x4303>; /* mgmnt rsp slice 1 */
		dma-names = "tx0-0", "tx0-1", "tx0-2", "tx0-3",
			    "tx1-0", "tx1-1", "tx1-2", "tx1-3",
			    "rx0", "rx1",
			    "rxmgm0", "rxmgm1";

		pruss2_emac0: ethernet-mii0 {
			phy-handle = <&pruss2_eth0_phy>;
			phy-mode = "rgmii-rxid";
			interrupts-extended = <&icssg2_intc 24>;
			syscon-rgmii-delay = <&scm_conf 0x4120>;
			iep = <&icssg2_iep0>;
			/* Filled in by bootloader */
			local-mac-address = [00 00 00 00 00 00];
		};

		pruss2_emac1: ethernet-mii1 {
			phy-handle = <&pruss2_eth1_phy>;
			phy-mode = "rgmii-rxid";
			interrupts-extended = <&icssg2_intc 25>;
			syscon-rgmii-delay = <&scm_conf 0x4124>;
			/* Filled in by bootloader */
			local-mac-address = [00 00 00 00 00 00];
		};
	};

	&icssg2_mdio {
		status = "okay";
		pinctrl-names = "default";
		pinctrl-0 = <&icssg2_mdio_pins_default>;

		pruss2_eth0_phy: ethernet-phy@0 {
			reg = <0>;
			ti,rx-internal-delay = <DP83867_RGMIIDCTL_2_00_NS>;
			ti,fifo-depth = <DP83867_PHYCR_FIFO_DEPTH_4_B_NIB>;
		};

		pruss2_eth1_phy: ethernet-phy@3 {
			reg = <3>;
			ti,rx-internal-delay = <DP83867_RGMIIDCTL_2_00_NS>;
			ti,fifo-depth = <DP83867_PHYCR_FIFO_DEPTH_4_B_NIB>;
		};
	};
```

## Documentation/devicetree/bindings/net/ti,pruss-ecap.yaml
```yaml
# SPDX-License-Identifier: (GPL-2.0-only OR BSD-2-Clause)
%YAML 1.2
---
$id: http://devicetree.org/schemas/net/ti,pruss-ecap.yaml#
$schema: http://devicetree.org/meta-schemas/core.yaml#

title: Texas Instruments PRU-ICSS Enhanced Capture (eCAP) event module

description: |
  Each PRUSS includes an Enhanced Capture (eCAP) module that can provide some
  time-stamp features using its capture input. The eCAP module used within the
  PRU-ICSS is similar to other instances used within the PWM subsystems. This
  is typically used for providing interrupt pacing for host traffic on various
  PRU Ethernet usecases such as Dual-EMAC, HSR or PRP.

maintainers:
  - Lokesh Vutla <lokeshvutla@ti.com>

properties:
  compatible:
    const: ti,pruss-ecap

  reg:
    maxItems: 1

required:
  - compatible
  - reg

additionalProperties: false

examples:
  - |
    pruss0_ecap: ecap@30000 {
        compatible = "ti,pruss-ecap";
        reg = <0x30000 0x60>;
    };
```

## Documentation/devicetree/bindings/net/ti-prueth.txt
```
Texas Instruments PRUSS Ethernet MAC
====================================

Required properties:
- compatible       : Should be one of the following,
                        "ti,am3359-prueth" for AM335x SoCs
                        "ti,am4376-prueth" for AM437x SoCs
                        "ti,am57-prueth" for AM57xx SoCs
                        "ti,k2g-prueth" for 66AK2G SoCs

- prus             : list of pHandles to the PRU nodes
- sram	           : pHandle to OCMC SRAM node
- interrupt-parent : pHandle to the PRUSS INTC node
- mii-rt	   : pHandle to MII_RT module's syscon regmap
- iep		   : pHandle to IEP module's syscon regmap

Optional properties:

Following required if HSR and PRP driver offload is supported
on the platform:-

- interrupt-names  : should contain "rx_lre_hp", "rx_lre_lp"
- interrupts       : should contain an array of PRUSS system event
		     numbers used as the interrupt sources for
		     rx_lre_hp and rx_lre_lp interrupts respectively
- ecap		   : pHandle to the eCAP module's node

Must contain children, one for each of the MAC ports.
Children must be named ethernet-mii0 and ethernet-mii1.
Either one or both children can be present. If only one
child is present driver operates in single EMAC mode.

For single mode operation with the 2nd PRU, you still need
to provide both PRUs. See 2nd example.

Required properties for children:
- phy-handle       : See ethernet.txt file in the same directory.
- phy-mode         : See ethernet.txt file in the same directory.
- interrupt-names  : should be "rx"
- interrupts       : should contain an array of PRUSS system event
                     numbers used as the interrupt sources for Rx.

Optional properties for children:
- local-mac-address	: mac address for the port.
- ti,no-half-duplex	: disable half-duplex.
- interrupt-names	: add "tx" when using Dual EMAC firmware to
			  get a better egress performance at MTU size.
			  Note that this reduces the performance
			  for small size frames. So use it only if
			  specific application uses mostly MTU or near
			  MTU size frames.
			  add "emac_ptp_tx" when ptp is needed with Dual EMAC
			  add "hsr_ptp_tx" when ptp is needed with hsr/prp.
- interrupts		: should contain an array of PRUSS system event
			  numbers for each entry in interrupt-names.

Example (am572x-idk board, dual-emac):
======================================
	pruss2_eth {
		compatible = "ti,am57-prueth";
		prus = <&pru2_0>, <&pru2_1>;
		sram = <&ocmcram1>;
		interrupt-parent = <&pruss2_intc>;
		mii-rt = <&pruss2_mii_rt>;
		iep = <&pruss2_iep>;
		ecap = <&pruss2_ecap>;

		pruss2_emac0: ethernet-mii0 {
			phy-handle = <&pruss2_eth0_phy>;
			phy-mode = "mii";
			interrupts = <20>, <22>, <26>, <23>;
			interrupt-names = "rx", "tx", "emac_ptp_tx", "hsr_ptp_tx";
			/* Filled in by bootloader */
			local-mac-address = [00 00 00 00 00 00];
		};

		pruss2_emac1: ethernet-mii1 {
			phy-handle = <&pruss2_eth1_phy>;
			phy-mode = "mii";
			interrupts = <21>, <23>, <27>, <24>;
			interrupt-names = "rx", "tx", "emac_ptp_tx", "hsr_ptp_tx";
			/* Filled in by bootloader */
			local-mac-address = [00 00 00 00 00 00];
		};
	};

Example (am572x-idk board, single-emac):
=======================================
	pruss2_eth {
		compatible = "ti,am57-prueth";
		prus = <&pru2_0>, <&pru2_1>;
		sram = <&ocmcram1>;
		interrupt-parent = <&pruss2_intc>;
		mii-rt = <&pruss2_mii_rt>;
		iep = <&pruss2_iep>;
		ecap = <&pruss2_ecap>;

		pruss2_emac1: ethernet-mii1 {
			phy-handle = <&pruss2_eth1_phy>;
			phy-mode = "mii";
			interrupts = <21>, <23>, <27>, <24>;
			interrupt-names = "rx", "tx", "emac_ptp_tx", "hsr_ptp_tx";
			/* Filled in by bootloader */
			local-mac-address = [00 00 00 00 00 00];
		};
	};
```
