## Documentation/devicetree/bindings/video/backlight/pwm-backlight.txt
```
pwm-backlight bindings

Required properties:
  - compatible: "pwm-backlight"
  - pwms: OF device-tree PWM specification (see PWM binding[0])
  - brightness-levels: Array of distinct brightness levels. Typically these
      are in the range from 0 to 255, but any range starting at 0 will do.
      The actual brightness level (PWM duty cycle) will be interpolated
      from these values. 0 means a 0% duty cycle (darkest/off), while the
      last value in the array represents a 100% duty cycle (brightest).
  - default-brightness-level: the default brightness level (index into the
      array defined by the "brightness-levels" property)

Optional properties:
  - pwm-names: a list of names for the PWM devices specified in the
               "pwms" property (see PWM binding[0])
  - low_threshold_brightness: brightness threshold low level. (get linear
		 scales in brightness in low end of brightness levels)

[0]: Documentation/devicetree/bindings/pwm/pwm.txt

Example:

	backlight {
		compatible = "pwm-backlight";
		pwms = <&pwm 0 5000000>;

		brightness-levels = <0 4 8 16 32 64 128 255>;
		default-brightness-level = <6>;
	};

Example for brightness_threshold_level:

	backlight {
		compatible	= "pwm-backlight";
		pwms = <&pwm 0 50000>;

		brightness-levels = <0 4 8 16 32 64 128 255>;
		default-brightness-level = <6>;
		low_threshold_brightness = <50>;
	};
};
Note:
Low threshold support is required to have linear brightness scale from
0 to max. For some panels, backlight absent on low end of brightness
scale. So support for Low Threshold been required. So that the scale of
brightness changed from Low Threshold to Max in scales defined in
brightness-levels. In this example 20% maximum brightness scale should
be required to turn on panel backlight.
```

## Documentation/devicetree/bindings/video/fb-da8xx.txt
```
TI LCD Controller on DA830/DA850/AM335x SoC's

Required properties:
- compatible:
	DA830 - "ti,da830-lcdc"
	AM335x SoC's - "ti,am3352-lcdc", "ti,da830-lcdc"
- reg: Address range of lcdc register set
- interrupts: lcdc interrupt
- display-timings: typical videomode of lcd panel, represented as child.
  Refer Documentation/devicetree/bindings/video/display-timing.txt for
  display timing binding details. If multiple videomodes are mentioned
  in display timings node, typical videomode has to be mentioned as the
  native mode or it has to be first child (driver cares only for native
  videomode).

Example:

lcdc@4830e000 {
	compatible = "ti,am3352-lcdc", "ti,da830-lcdc";
	reg =  <0x4830e000 0x1000>;
	interrupts = <36>;
	display-timings {
		800x480p62 {
			clock-frequency = <30000000>;
			hactive = <800>;
			vactive = <480>;
			hfront-porch = <39>;
			hback-porch = <39>;
			hsync-len = <47>;
			vback-porch = <29>;
			vfront-porch = <13>;
			vsync-len = <2>;
			hsync-active = <1>;
			vsync-active = <1>;
		};
	};
};
```

## Documentation/devicetree/bindings/video/sil,sii9022.txt
```
Silicon Image SiI9022 HDMI Encoder
==================================

Silicon Image SiI9022 is an HDMI encoder that encodes parallel RGB
signal to HDMI signal. The SiI9022 is controlled with i2c command, and
it has a single reset pin and single interrupt pin.

Required properties:
- compatible: "sil,sii9022"

Optional properties:
- reset-gpio: reset gpio
- interrupts: interrupt line

Required for HDMI audio:
- i2s-fifo-routing:
  - Array of exactly 4 integers indicating i2s pins to audio fifo routing
  - First integer defines routing to fifo 0 and second to fifo 1, etc.
  - Integers can be filled with definitions from:
    include/dt-bindings/sound/sii9022-audio.h

Required nodes:
- Video port 0 for parallel video input
- Video port 1 for HDMI output

Example
-------

&i2c2 {
	sii9022: sii9022@3b {
		compatible = "sil,sii9022";
		reg = <0x3b>;

		i2s-fifo-routing = <
			(ENABLE_BIT|CONNECT_SD0)
			0
			0
			0
		>;

		reset-gpio = <&gpio2 1 GPIO_ACTIVE_LOW>;

		interrupt-parent = <&gpio1>;
		interrupts = <18 IRQ_TYPE_LEVEL_LOW>;

		ports {
			#address-cells = <1>;
			#size-cells = <0>;

			port@0 {
				reg = <0>;

				sii9022_in: endpoint {
					remote-endpoint = <&dpi_out>;
				};
			};

			port@1 {
				reg = <1>;

				sii9022_out: endpoint {
					remote-endpoint = <&hdmi_connector_in>;
				};
			};
		};
	};
};
```

## Documentation/devicetree/bindings/video/ti,dra7-dss.txt
```
Texas Instruments DRA7x Display Subsystem
=========================================

See Documentation/devicetree/bindings/video/ti,omap-dss.txt for generic
description about OMAP Display Subsystem bindings.

DSS Core
--------

Required properties:
- compatible: "ti,dra7-dss"
- reg: address and length of the register spaces for 'dss', 'pll1_clkctrl',
  'pll1', 'pll2_clkctrl', 'pll2'
- ti,hwmods: "dss_core"
- clocks: handle to fclk, video1 pll clock, and video2 pll clock
- clock-names: "fck", "video1_clk", "video2_clk"
- syscon: phandle to control module core syscon node

Required nodes:
- DISPC

Optional nodes:
- DSS Submodules: HDMI
- Video port for DPI output

DPI Endpoint required properties:
- data-lines: number of lines used


DISPC
-----

Required properties:
- compatible: "ti,dra7-dispc"
- reg: address and length of the register space
- ti,hwmods: "dss_dispc"
- interrupts: the DISPC interrupt
- clocks: handle to fclk
- clock-names: "fck"

HDMI
----

Required properties:
- compatible: "ti,dra7-hdmi"
- reg: addresses and lengths of the register spaces for 'wp', 'pll', 'phy',
       'core'
- reg-names: "wp", "pll", "phy", "core"
- interrupts: the HDMI interrupt line
- ti,hwmods: "dss_hdmi"
- vdda-supply: vdda power supply
- clocks: handles to fclk and pll clock
- clock-names: "fck", "sys_clk"

Optional nodes:
- Video port for HDMI output

HDMI Endpoint optional properties:
- lanes: list of 8 pin numbers for the HDMI lanes: CLK+, CLK-, D0+, D0-,
  D1+, D1-, D2+, D2-. (default: 0,1,2,3,4,5,6,7)
```

## Documentation/devicetree/bindings/video/ti,k2g-dss.txt
```
Texas Instruments K2G Display Subsystem
=========================================

See Documentation/devicetree/bindings/display/ti/ti,omap-dss.txt for generic
description about OMAP Display Subsystem bindings.

DSS Core
--------

Required properties:
- compatible: "ti,k2g-dss"
- reg: address and length of the register space for 'dss'
- clocks: handle to fclk
- clock-names: "fck"

Required nodes:
- DISPC

Optional nodes:
- Video port for DPI output

DPI Endpoint required properties:
- data-lines: number of lines used

DISPC
-----

Required properties:
- compatible: "ti,k2g-dispc"
- reg: addresses and lengths of the register spaces
- reg-names: "common", "vid1", "ovr1", "vp1"
- interrupts: the DISPC interrupt
- clocks: handles to fclk and vp clock
- clock-names: "fck", "vp"
```

## Documentation/devicetree/bindings/video/ti,tlc59108.txt
```
TLC59108 based DPI panel
========================

Required properties
- compatible: "ti,tlc59108-lp101"; /* For 1280x800 Panel on DRA7/DRA72 EVM */

- reg: i2c slave address of the chip on the board
- enable-gpio: Enable GPIO for the DPI panel

Required nodes:
- Video port for DPI input

Example:
-------

tlc59108: tlc59108@40 {
	ompatible = "ti,tlc59108-lp101";
	reg = <0x40>;
	enable_gpio = <gpio7 11 0>;

	port {
		lcd_in: endpoint {
			remote-endpoint = <&dpi_out>;
		};
	};
};
```

## Documentation/devicetree/bindings/watchdog/ti,rti-wdt.txt
```
Texas Instruments RTI (Real Time Interrupt) module. RTI is used for
implementing a watchdog on TI SoCs.

Required properties:
	compatible	= "ti,rti-wdt";
	reg		= Physical IO space for RTI
	clocks		= Functional clock for the RTI

Example:

main_rti0: watchdog@2200000 {
	compatible = "ti,rti-wdt";
	reg = <0x0 0x2200000 0x0 0x100>;
	clocks = <&k3_clks 252 1>;
	power-domains = <&k3_pds 252 TI_SCI_PD_EXCLUSIVE>;
	assigned-clocks = <&k3_clks 252 1>;
	assigned-clock-parents = <&k3_clks 252 5>;
};
```

## arch/arm/boot/dts/ti/am57xx-evm.its
```
/dts-v1/;

/ {
	description = "AM57xx-evm";
	#address-cells = <1>;

	images {
		kernel@1 {
			description = "LCPD kernel";
			data = /incbin/("../../zImage");
			type = "kernel";
			arch = "arm";
			os = "linux";
			compression = "none";
			load = <0x82000000>;
			entry = <0x82000000>;
		};
		fdt@1 {
			description = "AM57xx-beagle-x15";
			data = /incbin/("am57xx-beagle-x15.dtb");
			type = "flat_dt";
			arch = "arm";
			compression = "none";
			load = <0x83000000>;
		};
		fdt@2 {
			description = "AM57xx-beagle-x15-revc";
			data = /incbin/("am57xx-beagle-x15-revc.dtb");
			type = "flat_dt";
			arch = "arm";
			compression = "none";
			load = <0x83000000>;
		};
		fdt@3 {
			description = "AM57xx-evm-common overlay";
			data = /incbin/("am57xx-evm-common.dtbo");
			type = "flat_dt";
			arch = "arm";
			compression = "none";
			load = <0x83080000>;
		};
		fdt@4 {
			description = "MT9T111 camera support";
			data = /incbin/("mt9t111.dtbo");
			type = "flat_dt";
			arch = "arm";
			compression = "none";
			load = <0x83100000>;
		};
		fdt@5 {
			description = "OV10635 camera support";
			data = /incbin/("ov10635.dtbo");
			type = "flat_dt";
			arch = "arm";
			compression = "none";
			load = <0x83100000>;
		};
		fdt@6 {
			description = "AM57xx-evm overlay";
			data = /incbin/("am57xx-evm.dtbo");
			type = "flat_dt";
			arch = "arm";
			compression = "none";
			load = <0x83090000>;
		};
		fdt@7 {
			description = "AM57xx-evm-reva3 overlay";
			data = /incbin/("am57xx-evm-reva3.dtbo");
			type = "flat_dt";
			arch = "arm";
			compression = "none";
			load = <0x83090000>;
		};
	};

	configurations {
		default = "am57xx-evm.dtb";
		am57xx-evm.dtb {
			description = "AM57xx EVM";
			kernel = "kernel@1";
			fdt = "fdt@1", "fdt@3", "fdt@6";
		};
		am57xx-evm-reva3.dtb {
			description = "AM57xx EVM rev A3";
			kernel = "kernel@1";
			fdt = "fdt@2", "fdt@3", "fdt@7";
		};
		am57xx-beagle-x15.dtb {
			description = "AM57xx beagle-x15";
			kernel = "kernel@1";
			fdt = "fdt@1";
		};
		am57xx-beagle-x15-revc.dtb {
			description = "AM57xx beagle-x15 C";
			kernel = "kernel@1";
			fdt = "fdt@2";
		};
		cam-mt9t111 {
			description = "MT9T111 camera";
			fdt = "fdt@4";
		};
		cam-ov10635 {
			description = "OV10635 camera";
			fdt = "fdt@5";
		};
	};
};
```

## arch/arm/boot/dts/ti/am57xx-idk.its
```
/dts-v1/;

/ {
	description = "DRA72-evm";
	#address-cells = <1>;

	images {
		kernel@1 {
			description = "LCPD kernel";
			data = /incbin/("../../zImage");
			type = "kernel";
			arch = "arm";
			os = "linux";
			compression = "none";
			load = <0x82000000>;
			entry = <0x82000000>;
		};
		fdt@1 {
			description = "am571x-idk";
			data = /incbin/("am571x-idk.dtb");
			type = "flat_dt";
			arch = "arm";
			compression = "none";
			load = <0x83000000>;
		};
		fdt@2 {
			description = "am572x-idk";
			data = /incbin/("am572x-idk.dtb");
			type = "flat_dt";
			arch = "arm";
			compression = "none";
			load = <0x83000000>;
		};
		fdt@3 {
			description = "am574x-idk";
			data = /incbin/("am574x-idk.dtb");
			type = "flat_dt";
			arch = "arm";
			compression = "none";
			load = <0x83000000>;
		};
		fdt@4 {
			description = "am57xx-idk OSD LCD common";
			data = /incbin/("am57xx-idk-osd-lcd-common.dtbo");
			type = "flat_dt";
			arch = "arm";
			compression = "none";
			load = <0x83080000>;
		};
		fdt@5 {
			description = "am571x-idk touchscreen";
			data = /incbin/("am571x-idk-touchscreen.dtbo");
			type = "flat_dt";
			arch = "arm";
			compression = "none";
			load = <0x83100000>;
		};
		fdt@6 {
			description = "am572x-idk touchscreen";
			data = /incbin/("am572x-idk-touchscreen.dtbo");
			type = "flat_dt";
			arch = "arm";
			compression = "none";
			load = <0x83100000>;
		};
		fdt@7 {
			description = "osd101t2045 LCD";
			data = /incbin/("lcd-osd101t2045.dtbo");
			type = "flat_dt";
			arch = "arm";
			compression = "none";
			load = <0x83180000>;
		};
		fdt@8 {
			description = "osd101t2587 LCD";
			data = /incbin/("lcd-osd101t2587.dtbo");
			type = "flat_dt";
			arch = "arm";
			compression = "none";
			load = <0x83180000>;
		};
		fdt@9 {
			description = "ICSS1 Ethernet";
			data = /incbin/("am571x-idk-icss1eth.dtbo");
			type = "flat_dt";
			arch = "arm";
			compression = "none";
			load = <0x83080000>;
		};
	};

	configurations {
		default = "dra72-evm.dtb";
		am571x-idk.dtb {
			description = "am571x-idk 6 port Ethernet";
			kernel = "kernel@1";
			fdt = "fdt@1", "fdt@9";
		};
		am572x-idk.dtb {
			description = "am572x-idk";
			kernel = "kernel@1";
			fdt = "fdt@2";
		};
		am574x-idk.dtb {
			description = "am574x-idk";
			kernel = "kernel@1";
			fdt = "fdt@3";
		};
		am571x-idk-lcd-osd101t2045 {
			description = "am571x-idk with osd101t2045 LCD";
			fdt = "fdt@1", "fdt@4", "fdt@5", "fdt@7";
		};
		am571x-idk-lcd-osd101t2587 {
			description = "am571x-idk with osd101t2587 LCD";
			fdt = "fdt@1", "fdt@4", "fdt@5", "fdt@8";
		};
		am572x-idk-lcd-osd101t2045 {
			description = "am572x-idk with osd101t2045 LCD";
			fdt = "fdt@2", "fdt@4", "fdt@6", "fdt@7";
		};
		am572x-idk-lcd-osd101t2587 {
			description = "am572x-idk with osd101t2587 LCD";
			fdt = "fdt@2", "fdt@4", "fdt@6", "fdt@8";
		};
		am574x-idk-lcd-osd101t2587 {
			description = "am574x-idk with osd101t2587 LCD";
			fdt = "fdt@3", "fdt@4", "fdt@6", "fdt@8";
		};
	};
};
```

## arch/arm/boot/dts/ti/dra71-evm.its
```
/dts-v1/;

/ {
	description = "DRA71x-evm";
	#address-cells = <1>;

	images {
		kernel@1 {
			description = "LCPD kernel";
			data = /incbin/("../../zImage");
			type = "kernel";
			arch = "arm";
			os = "linux";
			compression = "none";
			load = <0x82000000>;
			entry = <0x82000000>;
		};
		fdt@1 {
			description = "DRA71x-evm";
			data = /incbin/("dra71-evm.dtb");
			type = "flat_dt";
			arch = "arm";
			compression = "none";
			load = <0x83000000>;
		};
		fdt@2 {
			description = "DRA71x-evm LCD";
			data = /incbin/("dra71-evm-lcd-auo-g101evn01.0.dtbo");
			type = "flat_dt";
			arch = "arm";
			compression = "none";
			load = <0x83100000>;
		};
		fdt@3 {
			description = "DRA71x-evm NAND";
			data = /incbin/("dra71-evm-nand.dtbo");
			type = "flat_dt";
			arch = "arm";
			compression = "none";
			load = <0x83200000>;
		};
	};

	configurations {
		default = "dra71-evm.dtb";
		dra71-evm.dtb {
			description = "DRA71x-evm";
			kernel = "kernel@1";
			fdt = "fdt@1";
		};
		lcd-auo-g101evn01.0 {
			description = "DRA71x-evm with LCD overlay";
			fdt = "fdt@2";
		};
		dra71-evm-nand {
			description = "DRA71x-evm with NAND overlay";
			kernel = "kernel@1";
			fdt = "fdt@1", "fdt@3";
		};
	};
};
```
