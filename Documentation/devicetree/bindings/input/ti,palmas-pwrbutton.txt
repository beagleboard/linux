## Documentation/devicetree/bindings/interrupt-controller/ti,sci-intr.txt
```
Texas Instruments K3 Interrupt Router
=====================================

The Interrupt Router (INTR) module provides a mechanism to mux M
interrupt inputs to N interrupt outputs, where all M inputs are selectable
to be driven per N output. There is one register per output (MUXCNTL_N) that
controls the selection.


                                 Interrupt Router
                             +----------------------+
                             |  Inputs     Outputs  |
        +-------+            | +------+             |
        | GPIO  |----------->| | irq0 |             |       Host IRQ
        +-------+            | +------+             |      controller
                             |    .        +-----+  |      +-------+
        +-------+            |    .        |  0  |  |----->|  IRQ  |
        | INTA  |----------->|    .        +-----+  |      +-------+
        +-------+            |    .          .      |
                             | +------+      .      |
                             | | irqM |    +-----+  |
                             | +------+    |  N  |  |
                             |             +-----+  |
                             +----------------------+

Configuration of these MUXCNTL_N registers is done by a system controller
(like the Device Memory and Security Controller on K3 AM654 SoC). System
controller will keep track of the used and unused registers within the Router.
Driver should request the system controller to get the range of GIC IRQs
assigned to the requesting hosts. It is the drivers responsibility to keep
track of Host IRQs.

Communication between the host processor running an OS and the system
controller happens through a protocol called TI System Control Interface
(TISCI protocol). For more details refer:
Documentation/devicetree/bindings/arm/keystone/ti,sci.txt

TISCI Interrupt Router Node:
----------------------------
- compatible:		Must be "ti,sci-intr".
- interrupt-controller:	Identifies the node as an interrupt controller
- #interrupt-cells:	Specifies the number of cells needed to encode an
			interrupt source. The value should be 3.
			First cell should contain the TISCI device ID of source
			Second cell should contain the interrupt source offset
			within the device
			Third cell specifies the trigger type as defined
			in interrupts.txt in this directory. Only level
			sensitive trigger types are supported.
- interrupt-parent:	phandle of irq parent for TISCI intr.
- ti,sci:		Phandle to TI-SCI compatible System controller node.
- ti,sci-dst-id:	TISCI device ID of the destination IRQ controller.
- ti,sci-rm-range-girq:	TISCI subtype id representing the host irqs assigned
			to this interrupt router.

Example:
--------
The following example demonstrates both interrupt router node and the consumer
node(main gpio) on the AM654 SoC:

main_intr: interrupt-controller@1 {
	compatible = "ti,sci-intr";
	interrupt-controller;
	interrupt-parent = <&gic>;
	#interrupt-cells = <3>;
	ti,sci = <&dmsc>;
	ti,sci-dst-id = <56>;
	ti,sci-rm-range-girq = <0x1>;
};

main_gpio0:  main_gpio0@600000 {
	...
	interrupt-parent = <&main_intr>;
	interrupts = <57 256 IRQ_TYPE_EDGE_RISING>,
			<57 257 IRQ_TYPE_EDGE_RISING>,
			<57 258 IRQ_TYPE_EDGE_RISING>,
			<57 259 IRQ_TYPE_EDGE_RISING>,
			<57 260 IRQ_TYPE_EDGE_RISING>,
			<57 261 IRQ_TYPE_EDGE_RISING>;
	...
};
```

## Documentation/devicetree/bindings/interrupt-controller/ti,sci-irq.txt
```
Texas Instruments System Control Interface (TI-SCI) IRQCHIP
=====================================================================

Some TI SoCs contain a system controller (like the Device Memory and
Security Controller on K3 AM654 SoC) that are responsible for configuring
the SoC IRQ routes between peripherals and host processors and coprocessors.
Communication between the host processor running an OS and the
system controller happens through a protocol called TI System Control
Interface (TI-SCI protocol). For TI SCI details, please refer to the document,
Documentation/devicetree/bindings/arm/keystone/ti,sci.txt

TI-SCI IRQCHIP Node
============================
This irqchip node uses the TI SCI protocol to configure the IRQ routes between
peripherals and host processors and coprocessors. This node must be a child
node of the associated TI-SCI system controller node.

Required properties:
--------------------
 - compatible:		Should be "ti,sci-irq"
 - interrupt-controller:Identifies the node as an interrupt controller
 - #interrupt-cells:	Specifies the number of cells needed to encode an
			interrupt source. The value should be 3.
			First cell should contain the TI-SCI device ID
			Second cell should contain the interrupt source id
			within the device
			Third cell specifies the trigger type as defined
			in interrupts.txt in this directory.
 - interrupt-parent:	phandle of irq parent for TISCI irqchip. The parent must
			use the same interrupt-cells format as GIC.

Optional properties:
--------------------
- reg:		Base address and size of the Interrupt Aggregator if available
		inside SoC.
- ia-ids:	Corresponding device ids of the Interrupt Aggregator mentioned
		in reg property.

Example:
--------
The following example demonstrates both a TI-SCI irqchip node and a
consumer (GPIO) on the AM654 SoC.

dmsc: dmsc {
	...
	compatible = "ti,k2g-sci";
	...

	k3_irq: irqchip@33d00000 {
		compatible = "ti,sci-irq";
		interrupt-controller;
		interrupt-parent = <&gic>;
		#interrupt-cells = <3>;
		reg = <0x0 0x33d00000 0x0 0x100000>,
		      <0x0 0x33c00000 0x0 0x40000>,
		      <0x0 0x33c40000 0x0 0x40000>,
		      <0x0 0x2a700000 0x0 0x100000>;
		ia-ids = <179>, <180>, <181>, <189>;
	};
};

gpio0: gpio@600000 {
	...
	interrupt-parent = <&k3_irq>;
	interrupts = <57 256 IRQ_TYPE_EDGE_RISING>,
			<57 257 IRQ_TYPE_EDGE_RISING>,
			<57 258 IRQ_TYPE_EDGE_RISING>,
			<57 259 IRQ_TYPE_EDGE_RISING>,
			<57 260 IRQ_TYPE_EDGE_RISING>,
			<57 261 IRQ_TYPE_EDGE_RISING>;
	...
};
```

## Documentation/devicetree/bindings/iommu/ti,omap-iommu.txt
```
OMAP2+ IOMMU

Required properties:
- compatible : Should be one of,
		"ti,omap2-iommu" for OMAP2/OMAP3 IOMMU instances
		"ti,omap4-iommu" for OMAP4/OMAP5 IOMMU instances
		"ti,dra7-iommu" for DRA7xx IOMMU instances
- ti,hwmods  : Name of the hwmod associated with the IOMMU instance
- reg        : Address space for the configuration registers for all
               MMUs. This should also contain a DSP_SYSTEM register
               space for DSP IOMMU instances on DRA7xx SoCs
- interrupts : Interrupt specifier for the IOMMU instance

Optional properties:
- ti,#tlb-entries : Number of entries in the translation look-aside buffer.
                    Should be either 8 or 32 (default: 32)
- ti,iommu-bus-err-back : Indicates the IOMMU instance supports throwing
		          back a bus error response on MMU faults.
- reg-names : Names for the address spaces as specified in 'reg' property.
              Should contain only the following strings,
		"mmu_cfg" and/or "dsp_system"
              This property is mandatory for DSP IOMMU instances on DRA7xx
              SoCs, and is optional on other SoCs.

Example:
	/* OMAP3 ISP MMU */
	mmu_isp: mmu@480bd400 {
		compatible = "ti,omap2-iommu";
		reg = <0x480bd400 0x80>;
		interrupts = <24>;
		ti,hwmods = "mmu_isp";
		ti,#tlb-entries = <8>;
	};

	/* DRA74x DSP2 MMUs */
	mmu0_dsp2: mmu@41501000 {
		compatible = "ti,dra7-iommu";
		reg = <0x41501000 0x100>, <0x41500000 0x100>;
		reg-names = "mmu_cfg", "dsp_system";
		interrupts = <GIC_SPI 146 IRQ_TYPE_LEVEL_HIGH>;
		ti,hwmods = "mmu0_dsp2";
	};

	mmu1_dsp2: mmu@41502000 {
		compatible = "ti,dra7-iommu";
		reg = <0x41502000 0x100>, <0x41500000 0x100>;
		reg-names = "mmu_cfg", "dsp_system";
		interrupts = <GIC_SPI 147 IRQ_TYPE_LEVEL_HIGH>;
		ti,hwmods = "mmu1_dsp2";
	};
```

## Documentation/devicetree/bindings/leds/backlight/led-backlight.txt
```
led-backlight bindings

Required properties:
  - compatible: "led-backlight"
  - leds: phandle to a led OF node [0]
  - brightness-levels: Array of distinct LED brightness levels. These
      are in the range from 0 to 255, passed to the LED class driver.
  - default-brightness-level: the default brightness level (index into the
      array defined by the "brightness-levels" property)
  - power-supply: regulator for supply voltage

Optional properties:
  - enable-gpios: contains a single GPIO specifier for the GPIO which enables
                  and disables the backlight (see GPIO binding[1])

[0]: Documentation/devicetree/bindings/leds/common.txt
[1]: Documentation/devicetree/bindings/gpio/gpio.txt

Example:

	backlight {
		compatible = "led-backlight";
		leds = <&backlight_led>;

		brightness-levels = <0 4 8 16 32 64 128 255>;
		default-brightness-level = <6>;

		power-supply = <&vdd_bl_reg>;
		enable-gpios = <&gpio 58 0>;
	};
```

## Documentation/devicetree/bindings/leds/backlight/led-backlight.yaml
```yaml
# SPDX-License-Identifier: (GPL-2.0 OR BSD-2-Clause)
%YAML 1.2
---
$id: http://devicetree.org/schemas/leds/backlight/led-backlight.yaml#
$schema: http://devicetree.org/meta-schemas/core.yaml#

title: LED-based Backlight Device Tree Bindings

maintainers:
  - Jean-Jacques Hiblot <jjhiblot@ti.com>

description: |
  This binding is used to describe a basic backlight device made of LEDs.
  It can also be used to describe a backlight device controlled by the
  output of a LED driver.

properties:
  compatible:
    const: led-backlight

  leds:
    $ref: /schemas/types.yaml#/definitions/phandle-array
    description: List of LEDs constitutive of the backlight.

  default-brightness:
    $ref: /schemas/types.yaml#/definitions/uint32
    description: Default brightness level on boot.
    minimum: 0

  brightness-levels:
    $ref: /schemas/types.yaml#/definitions/uint32-array
    description: Array of distinct brightness levels. The levels must be in
      the range accepted by the underlying LED devices. This is used to
      translate a backlight brightness level into a LED brightness level. If
      it is not provided, the identity mapping is used.

required:
  - compatible
  - backlight-leds

examples:
  - |
    backlight {
      compatible = "led-backlight";
      backlight-leds = <&led1>;
      brightness-levels = <0 4 8 16 32 64 128 255>;
      default-brightness = <6>; /*6th level => brightness of the LEDs is 128*/
    };
  - |
    backlight {
      compatible = "led-backlight";
      backlight-leds = <&led1>, <&led2>;
      default-brightness = <255>;
    };
...
```

## Documentation/devicetree/bindings/leds/leds-tlc591xx.txt
```
LEDs connected to tlc59116 or tlc59108

Required properties
- compatible: should be "ti,tlc59116" or "ti,tlc59108"
- #address-cells: must be 1
- #size-cells: must be 0
- reg: typically 0x68

Each led is represented as a sub-node of the ti,tlc59116.
See Documentation/devicetree/bindings/leds/common.txt

LED sub-node properties:
- reg: number of LED line, 0 to 15 or 0 to 7
- label: (optional) name of LED
- linux,default-trigger : (optional)

Optional properties:
- gpio-controller: Marks the device node as a GPIO controller.
  - If present, all the led outputs are registered as gpio outputs, but
    the gpio outputs configured as leds are reserved by the driver itself
- #gpio-cells: Should be two.
  - first cell is the pin number
  - second cell is used for standard gpio bitfield specifiers [1]
- ngpios: Number of gpio outputs added
  - Should be <= number of leds lines on the chip, if present.

The most other gpio related devicetree bindings - like gpio-hog - apply
to the tlc591xx node if the gpio output functionality is enabled [1]. 

[1] Documentation/devicetree/bindings/gpio/gpio.txt

Examples:

tlc59116@68 {
	#address-cells = <1>;
	#size-cells = <0>;
	compatible = "ti,tlc59116";
	reg = <0x68>;

	wan@0 {
		label = "wrt1900ac:amber:wan";
		reg = <0x0>;
	};

	2g@2 {
		label = "wrt1900ac:white:2g";
		reg = <0x2>;
	};

	alive@9 {
		label = "wrt1900ac:green:alive";
		reg = <0x9>;
		linux,default_trigger = "heartbeat";
	};
};
```

## Documentation/devicetree/bindings/mailbox/light-mailbox.txt
```
T-head LIGHT mailbox controller
--------------------------------------------------------------------

The T-head LIGHT mailbox controller enables two cores within the SoC to
communicate and coordinate by passing messages (e.g. data, status
and control) through the mailbox chan. It also provides the ability
for one core to signal the other processor using interrupts.

LIGHT mailbox Device Node:
=============================

Required properties:
-------------------
- compatible :	Should be "thead,light-mbox".
- reg :		Should contain the registers location and length
- interrupts :	Interrupt number. The interrupt specifier format depends
		on the interrupt controller parent.
- icu_cpu_id :  Shoule be the ICU CPU ID defined in SOC.
- #mbox-cells:  Must be 2.
			  <&phandle type channel>
			    phandle	: Label name of controller
			    channel	: Channel number
			    type	: Channel type

		This LIGHT mailbox support 4 channels and 2 types.
		channel supported:
			support 4 channels: 0,1,2,3
			Client should not request the chan ID the same as "icu_cpu_id".

		types supported:
			0 - TX & RX channel share the same channel with 7 info registers to
			    share data, and with IRQ support.
			1 - TX & RX doorbell channel. Without own info registers and no ACK support.

Optional properties:
-------------------
- clocks :	phandle to the input clock.

Examples:
--------
mbox_910t: mbox@ffffc38000 {
       compatible = "thead,light-mbox";
       reg = <0xff 0xffc38000 0x0 0x4000>,
             <0xff 0xffc44000 0x0 0x1000>,
             <0xff 0xffc4c000 0x0 0x1000>,
             <0xff 0xffc54000 0x0 0x1000>;
       reg-names = "local_base", "remote_icu0", "remote_icu1", "remote_icu2";
       interrupt-parent = <&intc>;
       interrupts = <28>;
       clocks = <&dummy_clock_apb>;
       clock-names = "ipg";
       icu_cpu_id = <0>;
       #mbox-cells = <2>;
};

mbox_910t_client1: mbox_910t_client1 {
       compatible = "thead,light-mbox-client";
       mbox-names = "902";
       mboxes = <&mbox_910t 1 0>;
};


mbox_910t_client2: mbox_910t_client2 {
        compatible = "thead,light-mbox-client";
        mbox-names = "906";
        mboxes = <&mbox_910t 2 0>;
};
```
