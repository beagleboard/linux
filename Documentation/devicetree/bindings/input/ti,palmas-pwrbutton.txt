## Documentation/devicetree/bindings/input/ti,palmas-pwrbutton.txt
```
Texas Instruments Palmas family pwrbutton module

This module is part of the Palmas family of PMICs. For more details
about the whole chip see:
Documentation/devicetree/bindings/mfd/palmas.txt.

This module provides a simple power button event via an Interrupt.

Required properties:
- compatible: should be one of the following
   - "ti,palmas-pwrbutton": For Palmas compatible power on button
- interrupt-parent: Parent interrupt device, must be handle of palmas node.
- interrupts: Interrupt number of power button submodule on device.

Optional Properties:

- ti,palmas-long-press-seconds: Duration in seconds which the power
  button should be kept pressed for Palmas to power off automatically.
  NOTE: This depends on OTP support and POWERHOLD signal configuration
  on platform.

Example:

&palmas {
	palmas_pwr_button: pwrbutton {
		compatible = "ti,palmas-pwrbutton";
		interrupt-parent = <&tps659038>;
		interrupts = <1 IRQ_TYPE_NONE>;
		wakeup-source;
		ti,palmas-long-press-seconds = <12>;
	};
};
```

## Documentation/devicetree/bindings/input/touchscreen/atmel_mxt_ts.txt
```
Atmel MaxTouch Touchscreen
--------------------------
Required properties:
 - compatible: "atmel,mXT244" or "atmel,qt602240_ts"
                or "atmel,atmel_mxt_ts"
 - reg: I2C address of the chip
 - interrupts: interrupt signal to which the chip is connected
 - atmel,x-line: Number of x lines the touch object occupies in pixels
 - atmel,y-line: Number of y lines the touch object occupies in pixels
 - atmel,x-size: Horizontal resolution of touchscreen in pixels
 - atmel,y-size: Vertical resolution of touchscreen in pixels
 - atmel,blen: Sets the gain of the analog circuit in front of ADC
               Gain setting depends on package type. Range: 0-3
 - atmel,threshold: Channel detection threshold value. Range: 0-255
                    Typical: 30-80. Lower the threshold, higher the
                    sensitivity
 - atmel,voltage: Nominal AVdd in uV for analog circuitry, greater than
                  or less than base voltage of 2.7V, used for optimizing
                  capacitive sensing. For example, if you want to
                  program an optimum voltage of 2.8V in your design,
                  specify 2800000 for this parameter
 - atmel,orientation: touchscreen orientation, must be one of following,
     as defined inside include/linux/i2c/atmel_mxt_ts.h
     - 0: MXT_NORMAL - normal
     - 1: MXT_DIAGONAL - diagonal
     - 2: MXT_HORIZONTAL_FLIP - horizonally flipped
     - 3: MXT_ROTATED_90_COUNTER - rotated by 90 degrees
                                  counter-clockwise
     - 4: MXT_VERTICAL_FLIP - vertically flipped
     - 5: MXT_ROTATED_90 - rotated by 90 degress clockwise
     - 6: MXT_ROTATED_180 - rotated by 180 degrees
     - 7: MXT_DIAGONAL_COUNTER - diagonal counter

Optional properties:
 - atmel,config: list of 8-bit register values for controller objects
   in the following order. Number of objects and values depends on the
   particular model of Atmel touch screen you are using. Please check
   with your Atmel representative for helping you tune these values
   GEN_COMMAND, GEN_POWER, GEN_ACQUIRE, TOUCH_MULTI
   TOUCH_KEYARRAY, MXT244_COMMSCONFIG_T18, SPT_GPIOPWM, PROCI_GRIPFACE,
   PROCG_NOISE, TOUCH_PROXIMITY, PROCI_ONETOUCH, SPT_SELFTEST,
   PROCI_TWOTOUCH, SPT_CTECONFIG
   Note: These register values can be specified here according to
   the specific controller and platform configuration desired. The
   driver does not configure these registers by default and leaves it
   to the platform dts file to supply them

Example:

	&i2c1 {
		mXT244:mXT244@4a {
			reg = <0x4a>;
		};
	};

	&mXT244 {
		compatible = "atmel,mXT244";
		interrupts = <0 119 0x4>;

		atmel,config = <
		/* MXT244_GEN_COMMAND(6) */
		0x00 0x00 0x00 0x00 0x00 0x00
		/* MXT244_GEN_POWER(7) */
		0x20 0xff 0x32
		/* MXT244_GEN_ACQUIRE(8) */
		0x0a 0x00 0x05 0x00 0x00 0x00 0x09 0x23
		/* MXT244_TOUCH_MULTI(9) */
		0x00 0x00 0x00 0x13 0x0b 0x00 0x00 0x00 0x02 0x00
		0x00 0x01 0x01 0x0e 0x0a 0x0a 0x0a 0x0a 0x00 0x00
		0x00 0x00 0x00 0x00 0x00 0x00 0x00 0x00 0x00 0x00
		0x00
		/* MXT244_TOUCH_KEYARRAY(15) */
		0x00 0x00 0x00 0x00 0x00 0x00 0x00 0x00 0x00 0x00
		0x00
		/* MXT244_COMMSCONFIG_T18(2) */
		0x00 0x00
		/* MXT244_SPT_GPIOPWM(19) */
		0x00 0x00 0x00 0x00 0x00 0x00 0x00 0x00 0x00 0x00
		0x00 0x00 0x00 0x00 0x00 0x00
		/* MXT244_PROCI_GRIPFACE(20) */
		0x07 0x00 0x00 0x00 0x00 0x00 0x00 0x50 0x28 0x04
		0x0f 0x0a
		/* MXT244_PROCG_NOISE(22) */
		0x05 0x00 0x00 0x00 0x00 0x00 0x00 0x03 0x23 0x00
		0x00 0x05 0x0f 0x19 0x23 0x2d 0x03
		/* MXT244_TOUCH_PROXIMITY(23) */
		0x00 0x00 0x00 0x00 0x00 0x00 0x00 0x00 0x00 0x00
		0x00 0x00 0x00 0x00 0x00
		/* MXT244_PROCI_ONETOUCH(24) */
		0x00 0x00 0x00 0x00 0x00 0x00 0x00 0x00 0x00 0x00
		0x00 0x00 0x00 0x00 0x00 0x00 0x00 0x00 0x00
		/* MXT244_SPT_SELFTEST(25) */
		0x00 0x00 0x00 0x00 0x00 0x00 0x00 0x00 0x00 0x00
		0x00 0x00 0x00 0x00
		/* MXT244_PROCI_TWOTOUCH(27) */
		0x00 0x00 0x00 0x00 0x00 0x00 0x00
		/* MXT244_SPT_CTECONFIG(28) */
		0x00 0x00 0x02 0x08 0x10 0x00 >;

		atmel,x_line = <18>;
		atmel,y_line = <12>;
		atmel,x_size = <800>;
		atmel,y_size = <480>;
		atmel,blen = <0x01>;
		atmel,threshold = <30>;
		atmel,voltage = <2800000>;
		atmel,orient = <0x4>;
	};
```

## Documentation/devicetree/bindings/interrupt-controller/ti,pruss-intc.txt
```
PRU ICSS INTC on TI SoCs
========================

Each PRUSS has a single interrupt controller instance that is common to both
the PRU cores. Most interrupt controllers can route 64 input events which are
then mapped to 10 possible output interrupts through two levels of mapping.
The input events can be triggered by either the PRUs and/or various other PRUSS
internal and external peripherals. The first 2 output interrupts (0 & 1) are
fed exclusively to the internal PRU cores, with the remaining 8 (2 through 9)
connected to external interrupt controllers including the MPU and/or other
PRUSS instances, DSPs or devices.

The K3 family of SoCs can handle 160 input events that can be mapped to 20
different possible output interrupts. The additional output interrupts (10
through 19) are connected to new sub-modules within the ICSSG instances.

This interrupt-controller node should be defined as a child node of the
corresponding PRUSS node. The node should be named "interrupt-controller".
Please see the overall PRUSS bindings document for additional details
including a complete example,
    Documentation/devicetree/bindings/soc/ti/ti,pruss.txt

Required Properties:
--------------------
- compatible           : should be one of the following,
                             "ti,pruss-intc" for OMAP-L13x/AM18x/DA850 SoCs,
                                                 AM335x family of SoCs,
                                                 AM437x family of SoCs,
                                                 AM57xx family of SoCs
                                                 66AK2G family of SoCs
                             "ti,icssg-intc" for K3 AM65x & J721E family of SoCs
- reg                  : base address and size for the PRUSS INTC sub-module
- interrupts           : all the interrupts generated towards the main host
                         processor in the SoC. The format depends on the
                         interrupt specifier for the particular SoC's Arm
                         parent interrupt controller. A shared interrupt can
                         be skipped if the desired destination and usage is by
                         a different processor/device.
- interrupt-names      : should use one of the following names for each valid
                         host event interrupt connected to Arm interrupt
                         controller, the name should match the corresponding
                         host event interrupt number,
                             "host_intr0", "host_intr1", "host_intr2",
                             "host_intr3", "host_intr4", "host_intr5",
                             "host_intr6" or "host_intr7"
- interrupt-controller : mark this node as an interrupt controller
- #interrupt-cells     : should be 1. Client users shall use the PRU System
                         event number (the interrupt source that the client
                         is interested in) as the value of the interrupts
                         property in their node

Optional Properties:
--------------------
The following properties are _required_ only for some SoCs. If none of the below
properties are defined, it implies that all the PRUSS INTC output interrupts 2
through 9 (host_intr0 through host_intr7) are connected exclusively to the
Arm interrupt controller.

- ti,irqs-reserved     : an array of 8-bit elements of host interrupts between
                         0 and 7 (corresponding to PRUSS INTC output interrupts
                         2 through 9) that are not connected to the Arm
                         interrupt controller.
                           Eg: AM437x and 66AK2G SoCs do not have "host_intr5"
                               interrupt connected to MPU
- ti,irqs-shared       : an array of 8-bit elements of host interrupts between
                         0 and 7 (corresponding to PRUSS INTC output interrupts
                         2 through 9) that are also connected to other devices
                         or processors in the SoC.
                           Eg: AM65x and J721E SoCs have "host_intr5",
                               "host_intr6" and "host_intr7" interrupts
                               connected to MPU, and other ICSSG instances


Example:
--------

1.	/* AM33xx PRU-ICSS */
	pruss: pruss@0 {
		compatible = "ti,am3356-pruss";
		reg = <0x0 0x80000>;
		#address-cells = <1>;
		#size-cells = <1>;
		ranges;
		...

		pruss_intc: interrupt-controller@20000 {
			compatible = "ti,pruss-intc";
			reg = <0x20000 0x2000>;
			interrupts = <20 21 22 23 24 25 26 27>;
			interrupt-names = "host_intr0", "host_intr1",
					  "host_intr2", "host_intr3",
					  "host_intr4", "host_intr5",
					  "host_intr6", "host_intr7";
			interrupt-controller;
			#interrupt-cells = <1>;
			ti,irqs-shared = /bits/ 8 <0 6 7>;
		};
	};
```

## Documentation/devicetree/bindings/interrupt-controller/ti,sci-inta.txt
```
Texas Instruments K3 Interrupt Aggregator
=========================================

The Interrupt Aggregator (INTA) provides a centralized machine
which handles the termination of system events to that they can
be coherently processed by the host(s) in the system. A maximum
of 64 events can be mapped to a single interrupt.


                              Interrupt Aggregator
                     +-----------------------------------------+
                     |      Intmap            VINT             |
                     | +--------------+  +------------+        |
            m ------>| | vint  | bit  |  | 0 |.....|63| vint0  |
               .     | +--------------+  +------------+        |       +------+
               .     |         .               .               |       | INTR |
Globalevents  ------>|         .               .               |------>|  or  |
               .     |         .               .               |       | GIC  |
               .     |         .               .               |       +------+
            n ------>| +--------------+  +------------+        |
                     | | vint  | bit  |  | 0 |.....|63| vintx  |
                     | +--------------+  +------------+        |
                     |                                         |
                     +-----------------------------------------+

Configuration of these Intmap registers that maps global events to vint is done
by a system controller (like the Device Memory and Security Controller on K3
AM654 SoC). Driver should request the system controller to get the range
of global events and vints assigned to the requesting host. Management
of these requested resources should be handled by driver and requests
system controller to map specific global event to vint, bit pair.

Communication between the host processor running an OS and the system
controller happens through a protocol called TI System Control Interface
(TISCI protocol). For more details refer:
Documentation/devicetree/bindings/arm/keystone/ti,sci.txt

TISCI Interrupt Aggregator Node:
-------------------------------
- compatible:		Must be "ti,sci-inta".
- reg:			Should contain registers location and length.
- interrupt-controller:	Identifies the node as an interrupt controller
- #interrupt-cells:	Specifies the number of cells needed to encode an
			interrupt source. The value should be 4.
			First cell should contain the TISCI device ID of source
			Second cell should contain the event source offset
			within the device
			Third cell specified the vint number within IA.
			Fourth cell specifies the trigger type as defined
			in interrupts.txt in this directory.
- interrupt-parent:	phandle of irq parent for TISCI intr. The parent must
			use the same interrupt-cells format as GIC or
			Interrupt router as in ti,sci-intr.txt
- ti,sci:		Phandle to TI-SCI compatible System controller node.
- ti,sci-dev-id:	TISCI device ID of the Interrupt Aggregator.
- ti,sci-vint-type:	Tuple corresponding to unique TISCI resource type that
			defines the vint ranges assigned to the requesting
			host context from this Interrupt Aggregator.
			Tuple should be of format <type subtype>.
- ti,sci-global-event-type:	Tuple corresponding to unique TISCI resource
				type that defines the global event ranges
				assigned to the requesting host context from
				this Interrupt Aggregator.
				Tuple should be of format <type subtype>.

Optional Properties:
-------------------
Below properties are required only when interrupt parent is GIC.
- ti,sci-dst-id:	TISCI device ID of the destination IRQ controller.
- ti,sci-dst-irq-type:	Tuple corresponding to unique TISCI resource type that
			defines the dst host irq ranges assigned to this
			interrupt router from this host context.
			Tuple should be of format <type subtype>.


Example:
--------
main_udmass_inta: interrupt-controller@33d00000 {
	compatible = "ti,sci-inta";
	reg = <0x0 0x33d00000 0x0 0x100000>;
	interrupt-controller;
	interrupt-parent = <&main_navss_intr>;
	#interrupt-cells = <3>;
	ti,sci = <&dmsc>;
	ti,sci-dev-id = <179>;
	ti,sci-vint-type = <0x0 0x0>;
	ti,sci-global-event-type = <0x0 0x1>;
};
```
