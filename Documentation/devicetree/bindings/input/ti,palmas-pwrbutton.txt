## Documentation/devicetree/bindings/media/i2c/ovti,ov1063x.yaml
```yaml
# SPDX-License-Identifier: (GPL-2.0-only OR BSD-2-Clause)
%YAML 1.2
---
$id: http://devicetree.org/schemas/media/i2c/ovti,ov1063x.yaml#
$schema: http://devicetree.org/meta-schemas/core.yaml#

title: OmniVision OV10633/OV1035 8/10 bit digital Camera Sensor

maintainers:
  - Benoit Parrot   <bparrot@ti.com>
  - Sukrut Bellary  <sbellary@baylibre.com>
                    <x1125864@ti.com>

description: |-
  The OmniVision OV1063x is a 720p(HD) camera sensor which supports resolutions
  up to 1280x800(WXGA) and 8/10-bit YUV output formats.

  Each camera nodes should contain a 'port' child node with child
  'endpoint' node. Please refer to the bindings defined in
  Documentation/devicetree/bindings/media/video-interfaces.yaml.

properties:
  compatible:
    enum:
      - ovti,ov10633
      - ovti,ov10635

  reg:
    maxItems: 1

  clocks:
    maxItems: 1

  clock-names:
    const: xvclk

  reset-gpios:
    maxItems: 1
    description:
      phandle to the GPIO connected to the RESETB pin, if any.

  powerdown-gpios:
    maxItems: 1
    description:
      phandle for the GPIO connected to the PWDN pin, if any.

  port:
    $ref: /schemas/graph.yaml#/$defs/port-base
    additionalProperties: false

    properties:
      endpoint:
        $ref: /schemas/media/video-interfaces.yaml#
        unevaluatedProperties: false

        properties:
          hsync-active: true
          vsync-active: true
          pclk-sample: true
          bus-width:
            enum: [ 8, 10 ]

required:
  - compatible
  - reg
  - clocks
  - clock-names
  - port

additionalProperties: false

examples:
  - |
    #include <dt-bindings/gpio/gpio.h>

    i2c {
        clock-frequency = <400000>;
        #address-cells = <1>;
        #size-cells = <0>;

        camera@30 {
            compatible = "ovti,ov10635";
            reg = <0x30>;

            clocks = <&fixed_clock>;
            clock-names = "xvclk";

            reset-gpios = <&gpio4 17 GPIO_ACTIVE_HIGH>;
            powerdown-gpios = <&gpio5 11 GPIO_ACTIVE_HIGH>;

            port {
                camera1: endpoint {
                     remote-endpoint = <&vin1a_ep>;
                     hsync-active = <1>;
                     vsync-active = <1>;
                     pclk-sample = <0>;
                     bus-width = <8>;
                };
            };
        };
    };

...
```

## Documentation/devicetree/bindings/media/i2c/ovti,ov2312.yaml
```yaml
# SPDX-License-Identifier: (GPL-2.0-only OR BSD-2-Clause)
%YAML 1.2
---
$id: http://devicetree.org/schemas/media/i2c/ovti,ov2312.yaml#
$schema: http://devicetree.org/meta-schemas/core.yaml#

title: OmniVision OV2312 Camera Sensor

maintainers:
  - Jai Luthra <j-luthra@ti.com>

description: |-
  Omnvision OV2312 is a camera sensor with an active array size of 1600x1300.
  It supports capture of frames with a 4x4 RGB-IR bayer pattern. This provides
  both human (RGB) and machine vision (IR) capabilities in low-light scenarios.

properties:
  compatible:
    enum:
      - ovti,ov2312

  reg:
    maxItems: 1

  clocks:
    maxItems: 1

  clock-names:
    const: xvclk

  reset-gpios:
    maxItems: 1
    description:
      Specifier for the GPIO connected to the RESET pin.

  port:
    $ref: /schemas/graph.yaml#/properties/port
    additionalProperties: false

    properties:
      endpoint:
        $ref: ../video-interfaces.yaml#
        unevaluatedProperties: false

required:
  - compatible
  - reg
  - clocks
  - clock-names
  - port

additionalProperties: false

examples:
  - |
    #include <dt-bindings/gpio/gpio.h>

    i2c {
        #address-cells = <1>;
        #size-cells = <0>;

        camera@60 {
            compatible = "ovti,ov2312";
            reg = <0x60>;

            clocks = <&fixed_clock>;
            clock-names = "xvclk";

            reset-gpios = <&gpio4 17 GPIO_ACTIVE_LOW>;

            port {
                camera1: endpoint {
                    remote-endpoint = <&vin1a_ep>;
                };
            };
        };
    };

...
```

## Documentation/devicetree/bindings/media/i2c/ovti,ox05b.yaml
```yaml
# SPDX-License-Identifier: (GPL-2.0-only OR BSD-2-Clause)
%YAML 1.2
---
$id: http://devicetree.org/schemas/media/i2c/ovti,ox05b.yaml#
$schema: http://devicetree.org/meta-schemas/core.yaml#

title: OmniVision OX05B1S Camera Sensor

maintainers:
  - Abhishek Sharma <abhishek.sharma@ti.com>

description: |-
  Omnivision OX05B1S is an RGBIR camera sensor with an active array size of
  2592x1944. It is programmable through the I2C interface. The i2c client
  address is fixed at 0x36 as per the sensor datasheet. Every alternate frame,
  the sensor changes the exposure/gain registers to stream an -
  A. IR-dominant frame on CSI-2 virtual channel 0
  B. RGB-dominant frame on CSI-2 virtual channel 1

  Both streams are captured at a resolution 2592x1944, 30 fps each
  (60 fps total). The sensor also supports a few v4l2 controls like
  exposure and gain controls.

properties:
  compatible:
    enum:
      - ovti,ox05b

  reg:
    description: I2C address
    maxItems: 1

  clocks:
    maxItems: 1

  clock-names:
    const: inck

  pwdn-gpios:
    maxItems: 1
    description:
      Specifier for the GPIO connected to the PWDN pin.

  port:
    $ref: /schemas/graph.yaml#/properties/port
    additionalProperties: false

    properties:
      endpoint:
        $ref: /schemas/media/video-interfaces.yaml#
        unevaluatedProperties: false

required:
  - compatible
  - reg
  - clocks
  - clock-names
  - port

additionalProperties: false

examples:
  - |
    #include <dt-bindings/gpio/gpio.h>

    i2c {
      #address-cells = <1>;
      #size-cells = <0>;

      ox05b1s: camera@36 {
        compatible = "ovti,ox05b";
        reg = <0x36>;

        clocks = <&clk_ox05b1s_fixed>;
        clock-names = "inck";

        pwdn-gpios = <&exp1 13 GPIO_ACTIVE_LOW>;

        port {
          csi2_cam0: endpoint {
            remote-endpoint = <&csi2rx0_in_sensor>;
          };
        };
      };
    };

...
```

## Documentation/devicetree/bindings/media/i2c/sony,imx390.yaml
```yaml
# SPDX-License-Identifier: (GPL-2.0-only OR BSD-2-Clause)
%YAML 1.2
---
$id: http://devicetree.org/schemas/media/i2c/sony,imx390.yaml#
$schema: http://devicetree.org/meta-schemas/core.yaml#

title: Sony IMX390 Camera Sensor

maintainers:
  - Tomi Valkeinen <tomi.valkeinen@ideasonboard.com>

description: |-
  Sony IMX390 camera sensor.

properties:
  compatible:
    enum:
      - sony,imx390

  reg:
    maxItems: 1

  clocks:
    maxItems: 1

  clock-names:
    const: inck

  xclr-gpios:
    maxItems: 1
    description:
      Specifier for the GPIO connected to the XCLR (System Reset) pin.

  port:
    $ref: /schemas/graph.yaml#/properties/port
    additionalProperties: false

    properties:
      endpoint:
        $ref: ../video-interfaces.yaml#
        unevaluatedProperties: false

required:
  - compatible
  - reg
  - clocks
  - clock-names
  - port

additionalProperties: false

examples:
  - |
    #include <dt-bindings/gpio/gpio.h>

    i2c {
        clock-frequency = <400000>;
        #address-cells = <1>;
        #size-cells = <0>;

        camera@21 {
            compatible = "sony,imx390";
            reg = <0x21>;

            clocks = <&fixed_clock>;
            clock-names = "inck";

            xclr-gpios = <&gpio4 17 GPIO_ACTIVE_LOW>;

            port {
                camera1: endpoint {
                    remote-endpoint = <&vin1a_ep>;
                };
            };
        };
    };

...
```

## Documentation/devicetree/bindings/media/i2c/sony,imx728.yaml
```yaml
# SPDX-License-Identifier: (GPL-2.0-only OR BSD-2-Clause)
%YAML 1.2
---
$id: http://devicetree.org/schemas/media/i2c/sony,imx728.yaml#
$schema: http://devicetree.org/meta-schemas/core.yaml#

title: Sony IMX728 Camera Sensor

maintainers:
  - Stuart Burtner <sburtner@d3embedded.com>

description:
  The Sony IMX728 is a 1/1.72-Inch CMOS Solid-state image sensor with a
  color square pixel array and 8.39M active pixels. It is programmed
  through an I2C interface.

  The sensor can output up to 3840x2160 at a maximum of 45 frames/s over
  a CSI-2 serial interface. It supports RAW24/20/16/12 and 10.

properties:
  compatible:
    enum:
      - sony,imx728

  reg:
    maxItems: 1

  clocks:
    description: Clock frequency from 18 to 30MHz
    maxItems: 1

  clock-names:
    const: inck

  reset-gpios:
    maxItems: 1
    description:
      XCLR (System Reset) pin.

  error0-gpios:
    maxItems: 1
    description:
      XWRN pin.

  error1-gpios:
    maxItems: 1
    description:
      XERR pin.

  port:
    $ref: /schemas/graph.yaml#/properties/port
    additionalProperties: false

    properties:
      endpoint:
        $ref: ../video-interfaces.yaml#
        unevaluatedProperties: false

required:
  - compatible
  - reg
  - clocks
  - clock-names
  - port

additionalProperties: false

examples:
  - |
    #include <dt-bindings/gpio/gpio.h>

    i2c {
        #address-cells = <1>;
        #size-cells = <0>;

        camera@1a {
            compatible = "sony,imx728";
            reg = <0x1a>;

            clocks = <&fixed_clock>;
            clock-names = "inck";

            reset-gpios = <&gpio4 17 GPIO_ACTIVE_LOW>;
            error0-gpios = <&sens_exp 1 GPIO_ACTIVE_HIGH>;
            error1-gpios = <&sens_exp 2 GPIO_ACTIVE_HIGH>;

            port {
                camera1: endpoint {
                    remote-endpoint = <&vin1a_ep>;
                };
            };
        };
    };

...
```

## Documentation/devicetree/bindings/media/i2c/ti,ds90ub953.yaml
```yaml
# SPDX-License-Identifier: (GPL-2.0-only OR BSD-2-Clause)
%YAML 1.2
---
$id: http://devicetree.org/schemas/media/i2c/ti,ds90ub953.yaml#
$schema: http://devicetree.org/meta-schemas/core.yaml#

title: Texas Instruments DS90UB953 FPD-Link 3 Serializer

maintainers:
  - Tomi Valkeinen <tomi.valkeinen@ideasonboard.com>

description: |-
  The TI DS90UB953 is an FPD-Link 3 video serializer for MIPI CSI-2.

properties:
  compatible:
    enum:
      - ti,ds90ub953-q1

  '#gpio-cells':
    const: 2

  gpio-controller: true

  i2c-1_8v:
    type: boolean
    description:
      Use 1.8V for I2C instead of the default 3.3V

  ports:
    $ref: /schemas/graph.yaml#/properties/ports

    properties:
      port@0:
        $ref: /schemas/graph.yaml#/$defs/port-base
        description: CSI-2 Input

        properties:
          endpoint:
            $ref: /schemas/media/video-interfaces.yaml#

            properties:
              data-lanes:
                $ref: /schemas/types.yaml#/definitions/uint32-array
                minItems: 1
                maxItems: 4
                uniqueItems: true
                items:
                  maximum: 4

              clock-noncontinuous:
                type: boolean
                description:
                  Allow MIPI CSI-2 non-continuous clock mode.

          required:
            - data-lanes
            - clock-noncontinuous

      port@1:
        $ref: /schemas/graph.yaml#/$defs/port-base
        description: FPD-Link 3 Output

        properties:
          endpoint:
            $ref: /schemas/media/video-interfaces.yaml#

required:
  - compatible
  - '#gpio-cells'
  - gpio-controller
  - ports

additionalProperties: false

examples:
  - |
      serializer: remote-chip {
        compatible = "ti,ds90ub953-q1";

        gpio-controller;
        #gpio-cells = <2>;

        ports {
          #address-cells = <1>;
          #size-cells = <0>;

          port@0 {
            reg = <0>;
          };

          port@1 {
            reg = <1>;
          };
        };
      };
...
```
