## Documentation/devicetree/bindings/mailbox/ti,message-manager.txt
```
Texas Instruments' Message Manager Driver
========================================

The Texas Instruments' Message Manager is a mailbox controller that has
configurable queues selectable at SoC(System on Chip) integration. The Message
manager is broken up into queues in different address regions that are called
"proxies" - each instance is unidirectional and is instantiated at SoC
integration level to indicate receive or transmit path.

This can also be used to describe Texas Instrument's Secure Proxy
controller that allows for individually configurable "threads" or
"proxies" which allow for independent communication scheme.

Message Manager Device Node:
===========================
Required properties:
--------------------
- compatible:		Shall be one of: "ti,k2g-message-manager",
			"ti,am654-secure-proxy"
- reg-names 		for ti,k2g-message-manager, the following shall exist:
				queue_proxy_region - Map the queue proxy region.
				queue_state_debug_region - Map the queue state
					debug region.
			for ti,am654-secure-proxy, the following shall exist:
				target_data - Map the proxy data region
				rt - Map the realtime status region
				scfg - Map the configuration region
- reg:			Contains the register map per reg-names.
- #mbox-cells		for ti,k2g-message-manager, Shall be 2. Contains the
			queue ID and proxy ID in the following order referring
			to the transfer path:
				queue_proxy_region - Map the queue proxy region.
				queue_state_debug_region - Map the queue state
					debug region.
			for ti,am654-secure-proxy, Shall be 1 and shall refer
		        to the transfer path called thread.
- interrupt-names:	Contains interrupt names matching the rx transfer path
			for a given SoC. Receive interrupts shall be of the
			format:
			For ti,k2g-message-manager, this shall be: "rx_<QID>"
			and shall contain:
				"rx_005", "rx_057"
			for ti,am654-secure-proxy, this shall be: "rx_<PID>".
- interrupts:		Contains the interrupt information corresponding to
			interrupt-names property.

Example(K2G):
------------

	msgmgr: msgmgr@2a00000 {
		compatible = "ti,k2g-message-manager";
		#mbox-cells = <2>;
		reg-names = "queue_proxy_region", "queue_state_debug_region";
		reg = <0x02a00000 0x400000>, <0x028c3400 0x400>;
		interrupt-names = "rx_005", "rx_057";
		interrupts = <GIC_SPI 324 IRQ_TYPE_LEVEL_HIGH>,
			     <GIC_SPI 327 IRQ_TYPE_LEVEL_HIGH>;
	};

	pmmc: pmmc {
		[...]
		mbox-names = "rx", "tx";
		# RX queue ID is 5, proxy ID is 2
		# TX queue ID is 0, proxy ID is 0
		mboxes= <&msgmgr 5 2>,
			<&msgmgr 0 0>;
		[...]
	};

Example(AM654):
------------

	secure_proxy: secure_proxy@32c00000 {
		compatible = "ti,am654-secure-proxy";
		#mbox-cells = <1>;
		reg-names = "target_data", "rt", "scfg";
		reg = <0x0 0x32c00000 0x0 0x100000>,
		      <0x0 0x32400000 0x0 0x100000>,
		      <0x0 0x32800000 0x0 0x100000>;
		interrupt-names = "rx_011";
		interrupts = <GIC_SPI 32 IRQ_TYPE_LEVEL_HIGH>;
	};

	dmsc: dmsc {
		[...]
		mbox-names = "rx", "tx";
		# RX Thread ID is 11
		# TX Thread ID is 13
		mboxes= <&secure_proxy 11>,
			<&secure_proxy 13>;
		[...]
	};
```

## Documentation/devicetree/bindings/media/cdns,csi2rx.yaml
```yaml
# SPDX-License-Identifier: (GPL-2.0-only OR BSD-2-Clause)
%YAML 1.2
---
$id: http://devicetree.org/schemas/media/cdns,csi2rx.yaml#
$schema: http://devicetree.org/meta-schemas/core.yaml#

title: Cadence MIPI-CSI2 RX controller

description: |
  The Cadence MIPI-CSI2 RX controller is a CSI-2 bridge supporting up to 4 CSI
  lanes in input, and 4 different pixel streams in output.

maintainers:
  - Pratyush Yadav <p.yadav@ti.com>

properties:
  compatible:
    contains:
      const: cdns,csi2rx

  reg:
    maxItems: 1

  clocks:
    minItems: 3
    items:
      - description: Main clock
      - description: Register bank clock
      - description: Pixel stream 0 output clock
      - description: Pixel stream 1 output clock
      - description: Pixel stream 2 output clock
      - description: Pixel stream 3 output clock

  clock-names:
    minItems: 3
    items:
      - const: sys_clk
      - const: p_clk
      - const: pixel_if0_clk
      - const: pixel_if1_clk
      - const: pixel_if2_clk
      - const: pixel_if3_clk

  phys:
    maxItems: 1
    description: phandle to the external D-PHY

  phy-names:
    items:
      - const: dphy

  power-domains:
    maxItems: 1

  ports:
    $ref: /schemas/graph.yaml#/properties/ports

    properties:
      port@0:
        $ref: /schemas/graph.yaml#/$defs/port-base
        unevaluatedProperties: false
        description: CSI-2 input

        properties:
          endpoint:
            $ref: video-interfaces.yaml#
            unevaluatedProperties: false

            properties:
              clock-lanes:
                maxItems: 1

              data-lanes:
                minItems: 1
                maxItems: 4
                items:
                  maximum: 4

            required:
              - clock-lanes
              - data-lanes

      port@1:
        $ref: /schemas/graph.yaml#/properties/port
        description: Stream 0 output

      port@2:
        $ref: /schemas/graph.yaml#/properties/port
        description: Stream 1 output

      port@3:
        $ref: /schemas/graph.yaml#/properties/port
        description: Stream 2 output

      port@4:
        $ref: /schemas/graph.yaml#/properties/port
        description: Stream 3 output

    required:
      - port@0


dependencies:
  phys: [ 'phy-names' ]
  phy-names: [ 'phys' ]

required:
  - compatible
  - reg
  - clocks
  - clock-names
  - ports

additionalProperties: false

examples:
  - |
    csi2rx: csi-bridge@d060000 {
      compatible = "cdns,csi2rx";
      reg = <0x0d060000 0x1000>;
      clocks = <&byteclock>, <&byteclock>,
        <&coreclock>, <&coreclock>,
        <&coreclock>, <&coreclock>;
      clock-names = "sys_clk", "p_clk",
              "pixel_if0_clk", "pixel_if1_clk",
              "pixel_if2_clk", "pixel_if3_clk";
      phys = <&dphy0>;
      phy-names = "dphy";

      ports {
        #address-cells = <1>;
        #size-cells = <0>;

        port@0 {
          reg = <0>;

          csi2rx_in_sensor: endpoint {
            remote-endpoint = <&sensor_out_csi2rx>;
            clock-lanes = <0>;
            data-lanes = <1 2>;
          };
        };

        port@1 {
          reg = <1>;

          csi2rx_out_grabber0: endpoint {
            remote-endpoint = <&grabber0_in_csi2rx>;
          };
        };

        port@2 {
          reg = <2>;

          csi2rx_out_grabber1: endpoint {
            remote-endpoint = <&grabber1_in_csi2rx>;
          };
        };

        port@3 {
          reg = <3>;

          csi2rx_out_grabber2: endpoint {
            remote-endpoint = <&grabber2_in_csi2rx>;
          };
        };

        port@4 {
          reg = <4>;

          csi2rx_out_grabber3: endpoint {
            remote-endpoint = <&grabber3_in_csi2rx>;
          };
        };
      };
    };
```

## Documentation/devicetree/bindings/media/i2c/mt9t11x.txt
```
* Aptina 1/4-Inch QXGA CMOS Digital Image Sensor

The Aptina MT9T111 is a 1/4-inch CMOS active pixel digital image sensor with
an active array size of 2048H x 1536V. It is programmable through a simple
two-wire serial interface.

Required Properties:

- compatible: value should be either one among the following
	(a) "aptina,mt9t111" for MT9T111 color sensor
	(b) "aptina,mt9t112" for MT9T112 color sensor

- input-clock-freq: Source clock freqquency (Hz)
- pixel-clock-freq: Target pixel clock freqquency (Hz)

Optional Properties:

- reset-gpios: Toggle when the module is enabled or disabled.
- powerdown-gpios: Toggle when the module is enabled or disabled.
- oscen-gpios: Enabled once at probe time.
- bufen-gpios: Enabled once at probe time.
- camen-gpios: Enabled once at probe time.

For further reading on port node refer to
Documentation/devicetree/bindings/media/video-interfaces.txt.

Example:

	mt9t111@3C {
		compatible = "aptina,mt9t111";
		reg = <0x3C>;

		reset-gpios = <&gpio4 17 GPIO_ACTIVE_LOW>;
		oscen-gpios = <&gpio5 10 GPIO_ACTIVE_HIGH>;
		powerdown-gpios = <&gpio5 11 GPIO_ACTIVE_LOW>;
		bufen-gpios = <&gpio5 12 GPIO_ACTIVE_LOW>;
		camen-gpios = <&gpio6 11 GPIO_ACTIVE_LOW>;

		port {
			cam: endpoint {
				remote-endpoint = <&vin3a>;
				hsync-active = <1>;
				vsync-active = <1>;
				pclk-sample = <1>;
				input-clock-freq = <32000000>;
				pixel-clock-freq = <96000000>;
			};
		};
	};
```

## Documentation/devicetree/bindings/media/i2c/ov1063x.txt
```
* OmniVision 8/10 bit digital camera

The Omnivision digital camera is a 720p camera which is configurable at 8/10bit
YUYV output and can be configured for various resolutions.

Required Properties:
- compatible : Must be one of the following
  - "ovti,ov10633": For OV10633 camera
  - "ovti,ov10635": For OV10635 camera

Optional Properties:
- gpios : A list of gpios with active high/low flags for enabling the sensor.
         This may contain gpios for power, board muxes, etc. Driver would
         set all of them as specified by the active high/low flag

  There are no custom optional properties supported for this device.
  Although all the endpoint properties documented in
  Documentation/devicetree/bindings/media/video-interfaces.txt are supported.

Example:

	&i2c2 {
		...
		...
		ovcamera@30 {
			compatible = "ovti,ov10635";
			reg = <0x30>;

			mux-gpios = <&pcf_hdmi 3    GPIO_ACTIVE_LOW>;

			port {
				onboard_cam: endpoint {
					hsync-active = <1>;
					vsync-active = <1>;
					pclk-sample = <1>;
				};
			};
		};
		...
	};
```

## Documentation/devicetree/bindings/media/i2c/ov1063x.yaml
```yaml
# SPDX-License-Identifier: (GPL-2.0-only OR BSD-2-Clause)
%YAML 1.2
---
$id: http://devicetree.org/schemas/media/i2c/ov1063x.yaml#
$schema: http://devicetree.org/meta-schemas/core.yaml#

title: OmniVision OV10633/OV1035 8/10 bit digital camera Device Tree Bindings

maintainers:
  - Benoit Parrot <bparrot@ti.com>

description: |-
  The Omnivision digital camera is a 720p camera which is configurable at
  8/10bit YUYV output and can be configured for various resolutions.

  Each camera nodes should contain a 'port' child node with child
  'endpoint' node. Please refer to the bindings defined in
  Documentation/devicetree/bindings/media/video-interfaces.txt.

properties:
  compatible:
    enum:
      - ovti,ov10633
      - ovti,ov10635

  reg:
    maxItems: 1

  clocks:
    maxItems: 1

  clocks-names:
    const: xvclk

  reset-gpios:
    maxItems: 1
    description:
      phandle to the GPIO connected to the reset pin, if any.

  powerdown-gpios:
    maxItems: 1
    description:
      phandle to the GPIO connected to the pwdn pin, if any.

  # See ./video-interfaces.txt for details
  port:
    type: object
    additionalProperties: false

    patternProperties:
      endpoint:
        type: object
        additionalProperties: false

        properties:
          hsync-active:
            maxItems: 1

          vsync-active:
            maxItems: 1

          pclk-sample:
            maxItems: 1

          bus-width:
            maxItems: 1

          remote-endpoint: true

required:
  - compatible
  - reg
  - clocks
  - clocks-names
  - port

additionalProperties: false

examples:
  - |
    #include <dt-bindings/gpio/gpio.h>

    i2c5: i2c@4807c000 {
        clock-frequency = <400000>;
        #address-cells = <1>;
        #size-cells = <0>;

         camera@37 {
              compatible = "ovti,ov10633";
              reg = <0x37>;

              clocks = <&fixed_clock>;
              clocks-names = "xvclk";

              reset-gpios = <&gpio4 17 GPIO_ACTIVE_HIGH>;
              powerdown-gpios = <&gpio5 11 GPIO_ACTIVE_HIGH>;

              port {
                   camera1: endpoint {
                           remote-endpoint = <&vin1a_ep>;
                           hsync-active = <1>;
                           vsync-active = <1>;
                           pclk-sample = <0>;
                           bus-width = <8>;
                   };
              };
         };
    };

...
```

## Documentation/devicetree/bindings/media/i2c/ov490.txt
```
* OmniVision OV490 CSI2 Image Signal Processor (ISP)

The Omnivision OV490 is a Image Signal Processor which is a companion
processor for the Raw image sensors. This device can process the raw images
and apply multiple algorithms to correct/transform/enhance the image quality.

It needs programming lot of registers are most of them are written from
a flash memory. The output is a CSI2 MIPI interface which can work with
configurable number of lanes.

Required Properties:
- compatible : "ovti,ov490"

Optional Properties:
- mux-gpios : A list of gpios with active high/low flags for enabling the sensor.
         This may contain gpios for power, board muxes, etc. Driver would
         set all of them as specified by the active high/low flag.

  There are no custom optional properties supported for this device.
  Although all the CSI2 endpoint properties documented in
  Documentation/devicetree/bindings/media/video-interfaces.txt are supported.

Example:

	&i2c2 {
		...
		...
		ov490@cam0 {
			compatible = "ovti,ov490";
			reg = <0x24>;

			mux-gpios = <&gpio_csi2_adap 0  GPIO_ACTIVE_LOW>,
				    <&gpio_csi2_adap 1  GPIO_ACTIVE_HIGH>,
				    <&gpio_csi2_adap 3  GPIO_ACTIVE_HIGH>,
				    <&gpio_csi2_adap 4  GPIO_ACTIVE_LOW>;

			port {
				csi2_cam0: endpoint@0 {
					clock-lanes = <0>;
					data-lanes = <1 2 3 4>;
					remote-endpoint = <&csi2_phy0>;
				};
			};
		};
		...
	};
```
