## Documentation/devicetree/bindings/media/ti-cal.txt
```
Texas Instruments DRA72x CAMERA ADAPTATION LAYER (CAL)
------------------------------------------------------

The Camera Adaptation Layer (CAL) is a key component for image capture
applications. The capture module provides the system interface and the
processing capability to connect CSI2 image-sensor modules to the
DRA72x device.

Required properties:
- compatible:
 Should be "ti,dra72-cal", for DRA72 controllers
 Should be "ti,dra72-pre-es2-cal", for DRA72 controllers pre ES2.0
 Should be "ti,dra76-cal", for DRA76 controllers
 Should be "ti,am654-cal", for AM654 controllers
- reg:	CAL Top level, Receiver Core #0, Receiver Core #1 and Camera RX
	control address space
- reg-names: cal_top, cal_rx_core0, cal_rx_core1 and camerrx_control
	     registers
- interrupts: should contain IRQ line for the CAL;
- syscon-camerrx: phandle to the device control module and offset to the
		  control_camerarx_core register
		  This node is meant to replace the "camerrx_control" reg
		  entry above but "camerrx_control" is still handled
		  for backward compatibility.

CAL supports 2 camera port nodes on MIPI bus. Each CSI2 camera port nodes
should contain a 'port' child node with child 'endpoint' node. Please
refer to the bindings defined in
Documentation/devicetree/bindings/media/video-interfaces.txt.

Example:
	cal: cal@4845b000 {
		compatible = "ti,dra72-cal";
		ti,hwmods = "cal";
		reg = <0x4845B000 0x400>,
		      <0x4845B800 0x40>,
		      <0x4845B900 0x40>;
		reg-names = "cal_top",
			    "cal_rx_core0",
			    "cal_rx_core1";
		interrupts = <GIC_SPI 119 IRQ_TYPE_LEVEL_HIGH>;
		syscon-camerrx = <&scm_conf 0xE94>;
		#address-cells = <1>;
		#size-cells = <0>;

		ports {
			#address-cells = <1>;
			#size-cells = <0>;

			csi2_0: port@0 {
				reg = <0>;
				endpoint {
					slave-mode;
					remote-endpoint = <&ar0330_1>;
				};
			};
			csi2_1: port@1 {
				reg = <1>;
			};
		};
	};

	i2c5: i2c@4807c000 {
		ar0330@10 {
			compatible = "ti,ar0330";
			reg = <0x10>;

			port {
				#address-cells = <1>;
				#size-cells = <0>;

				ar0330_1: endpoint {
					reg = <0>;
					clock-lanes = <1>;
					data-lanes = <0 2 3 4>;
					remote-endpoint = <&csi2_0>;
				};
			};
		};
	};
```

## Documentation/devicetree/bindings/media/ti-vip.txt
```
Texas Instruments DRA7x VIDEO INPUT PORT (VIP)
----------------------------------------------

The Video Input Port (VIP) is a key component for image capture
applications. The capture module provides the system interface and the
processing capability to connect parallel image-sensor as well as
BT.656/1120 capable encoder chip.

Required properties:
- compatible: must be "ti,vip1", "ti,vip2" or "ti,vip3".
- reg:	VIP top level, parser, colorspace converter, scaler for slice 0 and 1
	and vpdma memory address space;
- reg-names: vip, parser0, csc0, sc0, parser1, csc1, sc1 and vpdma registers;
- interrupts: should contain IRQ line for VIP;
- syscon-pol: phandle to the device control module;

VIP supports 2 slices. Each slice can handle up to 2 camera port nodes.
Each port nodes should contain a 'port' child node with child 'endpoint'
node. Please refer to the bindings defined in
Documentation/devicetree/bindings/media/video-interfaces.txt.

Example:
	vip1: vip@0x48970000 {
		compatible = "ti,vip1";
		reg = <0x48970000 0x114>,
		      <0x48975500 0xD8>,
		      <0x48975700 0x18>,
		      <0x48975800 0x80>,
		      <0x48975a00 0xD8>,
		      <0x48975c00 0x18>,
		      <0x48975d00 0x80>,
		      <0x4897d000 0x400>;
		reg-names = "vip",
			    "parser0",
			    "csc0",
			    "sc0",
			    "parser1",
			    "csc1",
			    "sc1",
			    "vpdma";
		ti,hwmods = "vip1";
		interrupts = <GIC_SPI 351 IRQ_TYPE_LEVEL_HIGH>,
			     <GIC_SPI 392 IRQ_TYPE_LEVEL_HIGH>;
		/* CTRL_CORE_SMA_SW_1 */
		syscon-pol = <&scm_conf 0x534>;
		#address-cells = <1>;
		#size-cells = <0>;
		status = "disabled";
		vin1a: port@0 {
			#address-cells = <1>;
			#size-cells = <0>;
			reg = <0>;
			status = "disabled";
			endpoint@0 {
				slave-mode;
				remote-endpoint = <&camera1>;
			};
		};
		vin2a: port@1 {
			#address-cells = <1>;
			#size-cells = <0>;
			reg = <1>;
			status = "disabled";
		};
		vin1b: port@2 {
			#address-cells = <1>;
			#size-cells = <0>;
			reg = <2>;
			status = "disabled";
		};
		vin2b: port@3 {
			#address-cells = <1>;
			#size-cells = <0>;
			reg = <3>;
			status = "disabled";
		};
	};

	i2c5: i2c@4807c000 {
		ov10633@37 {
			compatible = "ovti,ov10633";
			reg = <0x37>;

			mux-gpios = <&pcf_hdmi 3 GPIO_ACTIVE_LOW>;
			port {
				camera1: endpoint {
					remote-endpoint = <&vin1a>;
					hsync-active = <1>;
					vsync-active = <1>;
					pclk-sample = <0>;
				};
			};
		};
	};
```

## Documentation/devicetree/bindings/media/ti-vpe.txt
```
Texas Instruments DRA7x VIDEO PROCESSING ENGINE (VPE)
------------------------------------------------------

The Video Processing Engine (VPE) is a key component for image post
processing applications. VPE consist of a single memory to memory
path which can perform chroma up/down sampling, deinterlacing,
scaling and color space conversion.

Required properties:
- compatible: must be "ti,vpe"
- reg:	physical base address and length of the registers set for the 8
	memory regions required;
- reg-names: name associated with the memory regions described is <reg>;
- interrupts: should contain IRQ line for VPE;

Example:
	vpe {
		compatible = "ti,vpe";
		ti,hwmods = "vpe";
		clocks = <&dpll_core_h23x2_ck>;
		clock-names = "fck";
		reg =	<0x489d0000 0x120>,
			<0x489d0300 0x20>,
			<0x489d0400 0x20>,
			<0x489d0500 0x20>,
			<0x489d0600 0x3c>,
			<0x489d0700 0x80>,
			<0x489d5700 0x18>,
			<0x489dd000 0x400>;
		reg-names =	"vpe_top",
				"vpe_chr_us0",
				"vpe_chr_us1",
				"vpe_chr_us2",
				"vpe_dei",
				"sc",
				"csc",
				"vpdma";
		interrupts = <GIC_SPI 354 IRQ_TYPE_LEVEL_HIGH>;
		#address-cells = <1>;
		#size-cells = <0>;
	};
```

## Documentation/devicetree/bindings/memory-controllers/ti/emif-sram.txt
```
EMIF SRAM Driver
=====================

TI AMx3 family of devices use a similar EMIF to other TI SoCs but have
different PM requirements. Late suspend code runs from SRAM and requires
save and restore of EMIF context and placing the SDRAM in and out of
self-refresh. Because of this, the ti-emif-sram driver introduces
relocatable PM function that can run from SRAM and place the EMIF in
the proper state for low-power mode transition.

EMIF Device Node:
====================
A emif node is used to represent an EMIF IP instance within an SoC. The node
must contain a phandle to an sram node so the ti-emif-sram driver can allocate
space within the sram and copy the relocatable PM functions.

Required properties:
--------------------
- compatible:		Should be "ti,am3352-emif" for AM33xx SoCs
- reg:			Contains the emif register address ranges.
- sram:			Phandle for generic sram node for the driver
			to use to copy PM functions to.

Example:
--------
/* AM33xx */
emif: emif@4c000000 {
	compatible = "ti,am3352-emif";
	reg =	<0x4C000000 0x1000>;
	sram = <&ocmcram>;
};
```

## Documentation/devicetree/bindings/mfd/ti,tps6594x.yaml
```yaml
# SPDX-License-Identifier: (GPL-2.0-only OR BSD-2-Clause)
%YAML 1.2
---
$id: http://devicetree.org/schemas/mfd/ti,tps6594x.yaml#
$schema: http://devicetree.org/meta-schemas/core.yaml#

title: TPS6594x Power Management Integrated Circuit (PMIC)

maintainers:
  - Keerthy <j-keerthy@ti.com>

properties:
  compatible:
    contains:
      enum:
        - ti,tps6594x

  reg:
    const: 0x48
    description: I2C slave address

  ti,system-power-controller:
    type: boolean
    description: PMIC is controlling the system power.

  rtc:
    type: object
    $ref: /schemas/rtc/rtc.yaml#
    unevaluatedProperties: false
    properties:
      compatible:
        const: ti,tps6594x-rtc

  gpio:
    type: object
    unevaluatedProperties: false
    properties:
      compatible:
        const: ti,tps6594x-gpio

additionalProperties: false

required:
  - compatible
  - reg

examples:
  - |
    i2c0 {
        #address-cells = <1>;
        #size-cells = <0>;

        pmic: pmic@48 {
            compatible = "ti,tps6594x";
            reg = <0x48>;

            rtc {
                compatible = "ti,tps6594x-rtc";
            };

            gpio {
                compatible = "ti,tps6594x-gpio";
            };
        };
    };

...
```

## Documentation/devicetree/bindings/mfd/tps65218.txt
```
Texas Instruments TPS65218 family

The TPS65218 are Integrated Power Management Chips.

Required properties:
- compatible : Must be "ti,tps65218";
  For Integrated power-management used in AM437x based boards
- interrupts : This i2c device has an IRQ line connected to the main SoC
- interrupt-controller : Since the tps65218 supports several interrupts
  internally, it is considered as an interrupt controller cascaded to the
  SoC one.
- #interrupt-cells = <2>;
- interrupt-parent : The parent interrupt controller which is gic.

Optional node:
- TPS65218 PMIC has a number of child nodes. Mainly the regularors and SMPSs.

Example:
/*
 * Integrated Power Management Chip
 */
tps65218: tps65218@24 {
	reg = <0x24>;
	compatible = "ti,tps65218";
	interrupts = <GIC_SPI 7 IRQ_TYPE_NONE>; /* NMIn */
	interrupt-parent = <&gic>;
	interrupt-controller;
	#interrupt-cells = <2>;

	dcdc1: regulator-dcdc1 {
		compatible = "ti,tps65218-dcdc1";
		/* VDD_CORE voltage limits min of OPP50 and max of OPP100 */
		regulator-name = "vdd_core";
		regulator-min-microvolt = <912000>;
		regulator-max-microvolt = <1144000>;
		regulator-boot-on;
		regulator-always-on;
	};

	dcdc2: regulator-dcdc2 {
		compatible = "ti,tps65218-dcdc2";
		/* VDD_MPU voltage limits min of OPP50 and max of OPP_NITRO */
		regulator-name = "vdd_mpu";
		regulator-min-microvolt = <912000>;
		regulator-max-microvolt = <1378000>;
		regulator-boot-on;
		regulator-always-on;
	};

	dcdc3: regulator-dcdc3 {
		compatible = "ti,tps65218-dcdc3";
		regulator-name = "vdcdc3";
		regulator-min-microvolt = <1350000>;
		regulator-max-microvolt = <1350000>;
		regulator-boot-on;
		regulator-always-on;
	};

	dcdc4: regulator-dcdc4 {
		compatible = "ti,tps65218-dcdc4";
		regulator-name = "v3_3d";
		regulator-min-microvolt = <3300000>;
		regulator-max-microvolt = <3300000>;
		regulator-boot-on;
		regulator-always-on;
	};

	dcdc5: regulator-dcdc5 {
		compatible = "ti,tps65218-dcdc5";
		regulator-name = "v1_0bat";
		regulator-min-microvolt = <1000000>;
		regulator-max-microvolt = <1000000>;
	};

	dcdc6: regulator-dcdc6 {
		compatible = "ti,tps65218-dcdc6";
		regulator-name = "v1_8vat";
		regulator-min-microvolt = <1800000>;
		regulator-max-microvolt = <1800000>;
	};

	ldo1: regulator-ldo1 {
		compatible = "ti,tps65218-ldo1";
		regulator-min-microvolt = <1800000>;
		regulator-max-microvolt = <1800000>;
		regulator-boot-on;
		regulator-always-on;
	};
};
```

## Documentation/devicetree/bindings/misc/bone_capemgr.txt
```
* Beaglebone cape manager driver

Required properties:
- compatible: "ti,bone-capemgr"
- eeprom: phandle to the EEPROM baseboard.
          The EEPROM framework interface is use to obtain the data.

Required children nodes:

- baseboardmaps: Contains nodes, which each of the them defines a mapping from
		 the baseboard EEPROM board-name ID to a DT friendly compatible
		 string.

  - board-name:      The baseboard EEPROM board name, i.e. A335BONE for the
                     original beaglebone white.
  - compatible-name: The DT friendly compatible string to be used for matching
		     compatible capes, i.e. "ti,beaglebone"


 - nvmem-cells: Defines the phandles of the nvmem cells of the baseboard and the
                slots.
 - nvmem-cells: Defines the names of the nvmem cells. Required to have at
                least a baseboard cell name.

 - #slots:	Defines how many slots are there.

- Example of a beaglebone cape-manager:

bone_capemgr {
	compatible = "ti,bone-capemgr";
	status = "okay";

	nvmem-cell = <&baseboard_data
		      &cape0_data &cape1_data &cape2_data &cape3_data>;
	nvmem-cell-names = "baseboard", "slot0", "slot1", "slot2", "slot3";

	#slots = <4>;

	/* map board revisions to compatible definitions */
	baseboardmaps {
		baseboard_beaglebone: board@0 {
			board-name = "A335BONE";
			compatible-name = "ti,beaglebone";
		};

		baseboard_beaglebone_black: board@1 {
			board-name = "A335BNLT";
			compatible-name = "ti,beaglebone-black";
		};
	};
};

The format of the cape to be loaded is in a standard overlay format with
the following root properties that are interpreted by the cape manager:

Required properties:
 - compatible: Should be compatible to the baseboard according to the
               baseboard map value, i.e. "ti,beaglebone".
 - part-numer: Should contain the part-number as stored in the EEPROM.
 - version:    Should contain a list of all the version that are supported
               by the single cape dtbo, i.e. "00A1".

Optional properties:
 - exclusive-use: A string list which state the resources this cape requires.
                  No processing or matching to anything regarding the internal
		  kernel state is performed; it's purpose is to guard against
		  conflicts with other capes.
 - priority:      A priority to be assigned when loading a cape. A lower value
                  has higher priority. The purpose of the priority is to control
		  which cape is loaded first in case of a conflict.

- Example of a serial cape:

/dts-v1/;
/plugin/;
/ {
        compatible = "ti,beaglebone", "ti,beaglebone-black";

        /* identification */
        part-number = "BB-BONE-SERL-03";
        version = "00A1";

        /* state the resources this cape uses */
        exclusive-use =
                /* the pin header uses */
                "P9.21",        /* uart2_txd */
                "P9.22",        /* uart2_rxd */
                /* the hardware ip uses */
                "uart2";

        fragment@0 {
                target = <&am33xx_pinmux>;
                __overlay__ {
                        bb_uart2_pins: pinmux_bb_uart2_pins {
                                pinctrl-single,pins = <
                                        0x150 0x21      /* spi0_sclk.uart2_rxd | MODE1 */
                                        0x154 0x01      /* spi0_d0.uart2_txd | MODE1 */
                                >;
                        };
                };
        };

        fragment@1 {
                target = <&uart2>;
                __overlay__ {
                        status = "okay";
                        pinctrl-names = "default";
                        pinctrl-0 = <&bb_uart2_pins>;
                };
        };
};
```
