## Documentation/devicetree/bindings/media/img,d5520-vxd.txt
```
Imagination D5520-VXD Driver
----------------------------

The IMG VXD video decode driver for the D5500-VXD is a video decoder for
multiple video formats including H.264 and HEVC on the TI J721E family
of SoCs.

Required properties:
- compatible: must be "img,d5500-vxd"
- reg: physical base address and length of the registers for the D5520
- interrupts: should contain interrupt number for the D5520

Example for J721E:
==================

       d5520: video-decoder@4300000 {
               /* IMG D5520 driver configuration */
               compatible = "img,d5500-vxd";
               reg = <0x00 0x04300000 0x00 0x100000>;
               power-domains = <&k3_pds 144>;
               interrupts = <GIC_SPI 180 IRQ_TYPE_LEVEL_HIGH>;
       };
```

## Documentation/devicetree/bindings/media/img,e5010-jpeg-enc.yaml
```yaml
# SPDX-License-Identifier: (GPL-2.0-only OR BSD-2-Clause)
%YAML 1.2
---
$id: http://devicetree.org/schemas/media/img,e5010-jpeg-enc.yaml#
$schema: http://devicetree.org/meta-schemas/core.yaml#

title: Imagination E5010 JPEG Encoder

maintainers:
  - Devarsh Thakkar <devarsht@ti.com>

description: |
  The E5010 is a JPEG encoder from Imagination Technologies implemented on
  TI's AM62A SoC. It is capable of real time encoding of YUV420 and YUV422
  inputs to JPEG and M-JPEG. It supports baseline JPEG Encoding up to
  8Kx8K resolution.

properties:
  compatible:
    const: img,e5010-jpeg-enc

  reg:
    items:
      - description: The E5010 main register region
      - description: The E5010 mmu register region

  reg-names:
    items:
      - const: regjasper
      - const: regmmu

  power-domains:
    maxItems: 1

  resets:
    maxItems: 1

  clocks:
    minItems: 1
    maxItems: 2

  clock-names:
    minItems: 1
    maxItems: 2

  interrupts:
    maxItems: 1

required:
  - compatible
  - reg
  - reg-names
  - interrupts
  - clocks
  - clock-names
  - power-domains

additionalProperties: false

examples:
  - |
    #include <dt-bindings/soc/ti,sci_pm_domain.h>
    #include <dt-bindings/interrupt-controller/arm-gic.h>
    #include <dt-bindings/interrupt-controller/irq.h>

    e5010: e5010@fd20000 {
        compatible = "img,e5010-jpeg-enc";
        reg = <0x00 0xfd20000 0x00 0x100>,
              <0x00 0xfd20200 0x00 0x200>;
        reg-names = "regjasper", "regmmu";
        clocks = <&k3_clks 201 0>;
        clock-names = "core_clk";
        power-domains = <&k3_pds 201 TI_SCI_PD_EXCLUSIVE>;
        interrupts = <GIC_SPI 98 IRQ_TYPE_LEVEL_HIGH>;
    };
```

## Documentation/devicetree/bindings/media/img,vxe384.txt
```
Imagination VXE384 Driver
-------------------------

The IMG VXE384 video encode driver for the VXE384 is a video encoder for
multiple video formats including H.264 on the TI J721E family of SoCs.

Required properties:
- compatible: must be "img,vxe384"
- reg: physical base address and length of the registers for the VXE384
- interrupts: should contain interrupt number for the VXE384

Example for J721E:
==================

       vxe384: video-encoder@4200000 {
               compatible = "img,vxe384";
               reg = <0x00 0x04200000 0x00 0x100000>;
               power-domains = <&k3_pds 153 TI_SCI_PD_EXCLUSIVE>;
               interrupts = <GIC_SPI 181 IRQ_TYPE_LEVEL_HIGH>;
       };
```

## Documentation/devicetree/bindings/media/img,vxe384.yaml
```yaml
# SPDX-License-Identifier: (GPL-2.0 OR BSD-2-Clause)

%YAML 1.2
---
$id: "http://devicetree.org/schemas/media/img,vxe384.yaml#"
$schema: "http://devicetree.org/meta-schemas/core.yaml#"

title: Imagination VXE384 Driver

maintainers:
  - Sidraya Jayagond  <sidraya.bj@pathpartnertech.com>

description: |
  The IMG VXE384 video encode driver for the VXE384 is a video encoder for
  multiple video formats including H.264 on the TI J721E family of SoCs.

properties:
  compatible:
    const: img,vxe384

  reg:
    maxItems: 2

  interrupts:
    maxItems: 1

  power-domains:
    maxItems: 1

required:
  - compatible
  - reg
  - interrupts

additionalProperties: false

examples:
  - |
       #include <dt-bindings/interrupt-controller/irq.h>
       #include <dt-bindings/interrupt-controller/arm-gic.h>

       vxe384: video-encoder@4200000 {
               compatible = "img,vxe384";
               reg = <0x00 0x04200000>,
                     <0x00 0x100000>;
               power-domains = <&k3_pds 153>;
               interrupts = <GIC_SPI 181 IRQ_TYPE_LEVEL_HIGH>;
       };
```

## Documentation/devicetree/bindings/media/ti,csi2rx.yaml
```yaml
# SPDX-License-Identifier: (GPL-2.0-only OR BSD-2-Clause)
%YAML 1.2
---
$id: http://devicetree.org/schemas/media/ti,csi2rx.yaml#
$schema: http://devicetree.org/meta-schemas/core.yaml#

title: TI CSI2RX Wrapper Device Tree Bindings

maintainers:
  - Pratyush Yadav <p.yadav@ti.com>

properties:
  compatible:
    items:
      - const: ti,csi2rx

  dmas:
    description: RX DMA Channel 0

  dma-names:
    items:
      - const: rx0

  reg:
    maxItems: 1
    description: Base address and size of the TI wrapper registers.

  power-domains:
    maxItems: 1
    description:
      PM domain provider node and an args specifier containing
      the device id value.

  ranges: true

  "#address-cells":
    const: 2

  "#size-cells":
    const: 2

patternProperties:
  "csi-bridge@":
    type: object
    description: CSI2 bridge node.

required:
  - compatible
  - reg
  - dmas
  - dma-names
  - power-domains
  - "#address-cells"
  - "#size-cells"

additionalProperties: false

examples:
  - |
    #include <dt-bindings/soc/ti,sci_pm_domain.h>

    ti_csi2rx0: ticsi2rx {
        compatible = "ti,csi2rx";
        dmas = <&main_udmap 0x4940>;
        dma-names = "rx0";
        reg = <0x0 0x4500000 0x0 0x1000>;
        power-domains = <&k3_pds 26 TI_SCI_PD_EXCLUSIVE>;
        #address-cells = <2>;
        #size-cells = <2>;
    };
```

## Documentation/devicetree/bindings/media/ti,vip.yaml
```yaml
# SPDX-License-Identifier: (GPL-2.0-only OR BSD-2-Clause)
%YAML 1.2
---
$id: http://devicetree.org/schemas/media/ti,vip.yaml#
$schema: http://devicetree.org/meta-schemas/core.yaml#

title: Texas Instruments DRA7x VIDEO INPUT PORT (VIP).

maintainers:
  - Benoit Parrot <bparrot@ti.com>

description: |-
  The Video Input Port (VIP) is a key component for image capture
  applications. The capture module provides the system interface and the
  processing capability to connect parallel image-sensor as well as
  BT.656/1120 capable encoder chip to DRA7x device.

  Each VIP instance supports 2 independently configurable external video
  input capture slices (Slice 0 and Slice 1) each providing up to two video
  input ports (Port A and Port B) where Port A can be configured as
  24/16/8-bit port and Port B is fixed as 8-bit port.
  Here these ports a represented as follows
    port@0 -> Slice 0 Port A
    port@1 -> Slice 0 Port B
    port@2 -> Slice 1 Port A
    port@3 -> Slice 1 Port B

  Each camera port nodes should contain a 'port' child node with child
  'endpoint' node. Please refer to the bindings defined in
  Documentation/devicetree/bindings/media/video-interfaces.yaml.

properties:
  compatible:
    enum:
      - ti,dra7-vip1
      - ti,dra7-vip2
      - ti,dra7-vip3

  label:
    description: Instance name

  reg:
    items:
      - description: The VIP main register region
      - description: Video Data Parser (PARSER) register region for Slice0
      - description: Color Space Conversion (CSC) register region for Slice0
      - description: Scaler (SC) register region for Slice0
      - description: Video Data Parser (PARSER) register region for Slice1
      - description: Color Space Conversion (CSC) register region for Slice1
      - description: Scaler (SC) register region for Slice1
      - description: Video Port Direct Memory Access (VPDMA) register region

  reg-names:
    items:
      - const: vip
      - const: parser0
      - const: csc0
      - const: sc0
      - const: parser1
      - const: csc1
      - const: sc1
      - const: vpdma

  interrupts:
    minItems: 2
    description:
      IRQ index 0 is used for Slice0 interrupts
      IRQ index 1 is used for Slice1 interrupts

  ti,vip-clk-polarity:
    $ref: "/schemas/types.yaml#/definitions/phandle-array"
    description:
      phandle to the device control module. The 1st argument should
      contain the register offset to the CTRL_CORE_SMA_SW_1 register.
      2nd argument contains the bit field to slice 0 port A,
      3rd argument contains the bit field to slice 0 port B,
      4th argument contains the bit field to slice 1 port A,
      5th argument contains the bit field to slice 1 port B.

  ports:
    type: object
    additionalProperties: false

    properties:
      "#address-cells":
        const: 1

      "#size-cells":
        const: 0

      port@0:
        type: object
        additionalProperties: false

        properties:
          reg:
            const: 0
            description: Slice 0 Port A

          label:
            description: Port name. Usually the pin group name

          endpoint:
            $ref: video-interfaces.yaml#
            type: object
            unevaluatedProperties: false

            properties:
              hsync-active: true
              vsync-active: true
              pclk-sample: true
              bus-width:
                enum: [8, 24]
                default: 8

              remote-endpoint: true

        required:
          - reg
          - label

      port@1:
        type: object
        additionalProperties: false

        properties:
          reg:
            const: 1
            description: Slice 0 Port B

          label:
            description: Port name. Usually the pin group name

          endpoint:
            $ref: /schemas/graph.yaml#/properties/endpoint
            type: object
            additionalProperties: false

            properties:
              hsync-active: true
              vsync-active: true
              pclk-sample: true
              bus-width:
                enum: [8, 24]
                default: 8

              remote-endpoint: true

        required:
          - reg
          - label

      port@2:
        type: object
        additionalProperties: false

        properties:
          reg:
            const: 2
            description: Slice 1 Port A

          label:
            description: Port name. Usually the pin group name

          endpoint:
            $ref: /schemas/graph.yaml#/properties/endpoint
            type: object
            additionalProperties: false

            properties:
              hsync-active: true
              vsync-active: true
              pclk-sample: true
              bus-width:
                enum: [8, 24]
                default: 8

              remote-endpoint: true

        required:
          - reg
          - label

      port@3:
        type: object
        additionalProperties: false

        properties:
          reg:
            const: 3
            description: Slice 1 Port B

          label:
            description: Port name. Usually the pin group name

          endpoint:
            $ref: /schemas/graph.yaml#/properties/endpoint
            type: object
            additionalProperties: false

            properties:
              hsync-active: true
              vsync-active: true
              pclk-sample: true
              bus-width:
                enum: [8, 24]
                default: 8

              remote-endpoint: true

        required:
          - reg
          - label

    required:
      - "#address-cells"
      - "#size-cells"
      - port@0

required:
  - compatible
  - label
  - reg
  - reg-names
  - interrupts
  - ti,vip-clk-polarity

additionalProperties: false

examples:
  - |
    #include <dt-bindings/interrupt-controller/arm-gic.h>

    vip1: vip@48970000 {
        compatible = "ti,dra7-vip1";
        label = "vip1";
        reg = <0x48970000 0x114>,
              <0x48975500 0xD8>,
              <0x48975700 0x18>,
              <0x48975800 0x80>,
              <0x48975a00 0xD8>,
              <0x48975c00 0x18>,
              <0x48975d00 0x80>,
              <0x4897d000 0x400>;
        reg-names = "vip",
                    "parser0",
                    "csc0",
                    "sc0",
                    "parser1",
                    "csc1",
                    "sc1",
                    "vpdma";
        interrupts = <GIC_SPI 351 IRQ_TYPE_LEVEL_HIGH>,
                     <GIC_SPI 392 IRQ_TYPE_LEVEL_HIGH>;
        ti,vip-clk-polarity = <&scm_conf 0x534 0x1 0x4 0x2 0x8>;

        ports {
              #address-cells = <1>;
              #size-cells = <0>;

              vin1a: port@0 {
                    reg = <0>;
                    label = "vin1a";

                    vin1a_ep: endpoint {
                           remote-endpoint = <&camera1>;
                           hsync-active = <1>;
                           vsync-active = <1>;
                           pclk-sample = <0>;
                           bus-width = <8>;
                    };
              };
              vin1b: port@1 {
                    reg = <1>;
                    label = "vin1b";
              };
              vin2a: port@2 {
                    reg = <2>;
                    label = "vin2a";
              };
              vin2b: port@3 {
                    reg = <3>;
                    label = "vin2b";
              };
         };
    };

    i2c {
        clock-frequency = <400000>;
        #address-cells = <1>;
        #size-cells = <0>;

         camera@37 {
              compatible = "ovti,ov10633";
              reg = <0x37>;

              clocks = <&fixed_clock>;
              clocks-names = "xvclk";

              port {
                   camera1: endpoint {
                           remote-endpoint = <&vin1a_ep>;
                           hsync-active = <1>;
                           vsync-active = <1>;
                           pclk-sample = <0>;
                           bus-width = <8>;
                   };
              };
         };
    };

...
```
