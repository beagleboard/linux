## Documentation/devicetree/bindings/misc/capes-beaglebone.txt
```
* TI Beaglebone DT Overlay Cape Driver

Required properties:

- compatible: "ti,bone-capemgr"

- eeprom: Contains the phandle beaglebone's baseboard i2c eeprom.

- baseboardmaps - node containing a list of supported
	beaglebone revisions; each node in should have the
	following properties:
	- board-name: The board name stored in the baseboard
		eeprom.
	- compatible-name: The name which will be used for
		matching compatible capes.

- slots: node containing a list of slot nodes (which in the beaglebone
	case correspond to I2C addresses for dynamically probed capes,
	or an override slot definition for hardcoded capes.
	- eeprom: Contains the phandle beaglebone's cape i2c eeprom.

	It is possible to define override slots that will be activated
	when the baseboard matches, and/or if supplied on the kernel command
	line and/or when dynamically requested on runtime.
	In that case the slot is marked with
	- ti,cape-override: Marks a slot override.
	- compatible: any of the "runtime", "kernel", or any compatible-name
	  on a matching baseboardmap node.
	- Any of the eeprom-format-revision, board-name, version, manufacturer,
	  part-number, number-of-pins, serial-number, pin-usage, vdd-3v3exp,
	  vdd-5v, sys-5v, dc-supplied properties which fill in the simulated
	  cape's EEPROM fields. The part-number field is required, the rest
	  are optional taking into default values.

- capemaps: node contains list of cape mappings, which allow converting
	from a part-number & version tuple to the filename of the dtbo file.
	- part-number: part number contained in the EEPROM
	- version node containing a
		- version: specific version to map to
		- dtbo: name of the dtbo file 

Example:
bone_capemgr {
	compatible = "ti,bone-capemgr";
	status = "okay";

	eeprom = <&baseboard_eeprom>;

	baseboardmaps {
		baseboard_beaglebone: board@0 {
			board-name = "A335BONE";
			compatible-name = "ti,beaglebone";
		};
	};

	slots {
		slot@0 {
			eeprom = <&cape_eeprom0>;
		};

		slot@1 {
			eeprom = <&cape_eeprom1>;
		};

		slot@2 {
			eeprom = <&cape_eeprom2>;
		};

		slot@3 {
			eeprom = <&cape_eeprom3>;
		};
	};

	/* mapping between board names and dtb objects */
	capemaps {
		/* Weather cape */
		cape@0 {
			part-number = "BB-BONE-WTHR-01";
			version@00A0 {
				version = "00A0";
				dtbo = "cape-bone-weather-00A0.dtbo";
			};
		};
	};
};

Example of the override syntax when used on a bone compatible foo board.

{
	...

	baseboardmaps {
		...
		baseboard_beaglebone: board@0 {
			board-name = "A335FOO";
			compatible-name = "ti,foo";
		};

		slot@6 {
			ti,cape-override;
			compatible = "ti,foo";
			board-name = "FOO-hardcoded";
			version = "00A0";
			manufacturer = "Texas Instruments";
			part-number = "BB-BONE-FOO-01";
		};
	};

};

Example of the same override syntax when used from the kernel command-line:

	capemgr.extra_override=FOO-hardcoded:00A0,FOO-another-hardcoded:00A0
```

## Documentation/devicetree/bindings/misc/dra7xx-debugss.txt
```
Texas Instruments Debug Sub-System (DebugSS) module for DRA7xx devices

Required properties:
- compatible : Should be "ti,dra7xx-debugss"

Optional properties:
- clocks : the clocks feeding the Debug sub-system.
- clocks-names : clock name strings correspond to the clocks
		 defined above. These strings are used inside
		 module source code to identify the respective
                 clocks

Documentation:
http://www.ti.com/lit/ds/symlink/dra746.pdf

Examples:

debugss: debugss {
        compatible = "ti,dra7xx-debugss";
        clocks = <&sys_clkin1>;
        clock-names = "sysclockin1";
};
```

## Documentation/devicetree/bindings/misc/mikrobus-connector.yaml
```yaml
# SPDX-License-Identifier: GPL-2.0 OR BSD-2-Clause
%YAML 1.2
---
$id: http://devicetree.org/schemas/misc/mikrobus-connector.yaml#
$schema: http://devicetree.org/meta-schemas/core.yaml#

title: mikroBUS add-on board socket

maintainers:
  - Ayush Singh <ayushdevel1325@gmail.com>

properties:
  compatible:
    const: mikrobus-connector

  pinctrl-0: true
  pinctrl-1: true
  pinctrl-2: true
  pinctrl-3: true
  pinctrl-4: true
  pinctrl-5: true
  pinctrl-6: true
  pinctrl-7: true
  pinctrl-8: true

  pinctrl-names:
    items:
      - const: default
      - const: pwm_default
      - const: pwm_gpio
      - const: uart_default
      - const: uart_gpio
      - const: i2c_default
      - const: i2c_gpio
      - const: spi_default
      - const: spi_gpio

  mikrobus-gpios:
    minItems: 11
    maxItems: 12

  i2c-adapter:
    description: i2c adapter attached to the mikrobus socket.

  spi-controller:
    description: spi bus number of the spi-master attached to the mikrobus socket.

  uart:
    description: uart port attached to the mikrobus socket

  pwms:
    description: the pwm-controller corresponding to the mikroBUS PWM pin.
    maxItems: 1

additionalProperties: false

examples:
  - |
      mikrobus-0 {
        compatible = "mikrobus-connector";
        status = "okay";
        pinctrl-names = "default", "pwm_default", "pwm_gpio","uart_default", "uart_gpio", "i2c_default", 
                        "i2c_gpio", "spi_default", "spi_gpio";
        pinctrl-0 = <&P2_03_gpio_input_pin &P1_04_gpio_pin &P1_02_gpio_pin>;
        pinctrl-1 = <&P2_01_pwm_pin>;
        pinctrl-2 = <&P2_01_gpio_pin>;
        pinctrl-3 = <&P2_05_uart_pin &P2_07_uart_pin>;
        pinctrl-4 = <&P2_05_gpio_pin &P2_07_gpio_pin>;
        pinctrl-5 = <&P2_09_i2c_pin &P2_11_i2c_pin>;
        pinctrl-6 = <&P2_09_gpio_pin &P2_11_gpio_pin>;
        pinctrl-7 = <&P1_12_spi_pin &P1_10_spi_pin &P1_08_spi_sclk_pin &P1_06_spi_cs_pin>;
        pinctrl-8 = <&P1_12_gpio_pin &P1_10_gpio_pin &P1_08_gpio_pin &P1_06_gpio_pin>;
        i2c-adapter = <&i2c1>;
        spi-controller = <&spi1>;
        uart = <&uart4>;
        pwms = <&ehrpwm1 0 500000 0>;
        mikrobus-gpios = <&gpio1 18 0> , <&gpio0 23 0>, <&gpio0 30 0> , <&gpio0 31 0>, <&gpio0 15 0>,
                         <&gpio0 14 0>, <&gpio0 4 0> , <&gpio0 3 0>, <&gpio0 2 0>, <&gpio0 5 0>,
                         <&gpio2 25 0>, <&gpio2 3 0>;
      };
```

## Documentation/devicetree/bindings/misc/thead,iso7816-smart-card.txt
```
= Thead light dcd smart card which complies with ISO7816 protocol msic device tree bindings =

This binding is intended to represent LIGHT-ISO7816 DCD SMART CARD which is found in Thead SoCs

Required properties:
- compatible:	should be
		"thead,light-fm-efuse": for light fullmask
- reg:	should contain registers location and length
- interrupts:	the interrupt number for this device
- interrupt-parent:	the interrupt controller to manage this device interrupt

Example:

	iso7816: iso7816-card@fff7f30000 {
		compatible = "thead,light-iso7816-card";
		reg = <0xff 0xf7f30000 0x0 0x4000>;
		interrupts = <69>;
		interrupt-parent = <&intc>;
	};
```

## Documentation/devicetree/bindings/misc/ti,dma-buf-phys.yaml
```yaml
# SPDX-License-Identifier: GPL-2.0-only OR BSD-2-Clause
# Copyright (C) 2020 Texas Instruments Incorporated - https://www.ti.com/
%YAML 1.2
---
$id: http://devicetree.org/schemas/misc/ti,dma-buf-phys.yaml#
$schema: http://devicetree.org/meta-schemas/core.yaml#

title: DMA-BUF contiguous buffer physical address user-space exporter binding

description: |
  Driver allowing user-space attaching of DMA-BUFs returning CPU physical
  addresses. The reasoning for making this act like a regular device
  described by DT is so the virtual device that binds the buffer can be
  made to act as if it is out on a bus or behind an IOMMU, for example.

maintainers:
  - Andrew Davis <afd@ti.com>

properties:
  compatible:
    const: ti,dma-buf-phys

  iommus:
    maxItems: 1

  dma-coherent: true

required:
  - compatible

additionalProperties: false

examples:
  - |
    dma-buf-phys {
      compatible = "ti,dma-buf-phys";
      iommus = <&some_iommu>;
      dma-coherent;
    };
```

## Documentation/devicetree/bindings/misc/ti,dma_buf_phys.txt
```
DMA-BUF contiguous buffer physical address user-space exporter binding

Driver allowing user-space attaching of DMA-BUFs returning CPU physical
addresses. The reasoning for making this act like a regular device
described by DT is so the virtual device that binds the buffer can be
made to act as if it is out on a bus or behind an IOMMU, for example.

Required Properties:
 - compatible:		Must be "ti,dma_buf_phys"

Example:

dma_buf_phys {
	compatible = "ti,dma_buf_phys";
	iommus = <&some_iommu>;
	dma-coherent;
};
```

## Documentation/devicetree/bindings/misc/ti,dma_buf_phys.yaml
```yaml
# SPDX-License-Identifier: GPL-2.0-only OR BSD-2-Clause
# Copyright 2021 Texas Instruments Incorporated
%YAML 1.2
---
$id: "http://devicetree.org/schemas/misc/ti,dma_buf_phys.yaml#"
$schema: "http://devicetree.org/meta-schemas/core.yaml#"

title: DMA-BUF contiguous buffer physical address user-space exporter

maintainer: Gowtham Tammana <g-tammana@ti.com>

description: |
  Driver allowing user-space attaching of DMA-BUFs returning CPU
  physical addresses. The reasoning for making this act like a regular
  device described by DT is so the virtual device that binds the buffer
  can be made to act as if it is out on a bus or behind an IOMMU, for
  example.

properties:
  compatible:
    const: ti,dma_buf_phys

required:
  - compatible

examples:
  - |
    dma_buf_phys {
            compatible = "ti,dma_buf_phys";
            iommus = <&some_iommu>;
            dma-coherent;
    };
```

## Documentation/devicetree/bindings/misc/ti,mspm0l110x.yaml
```yaml
# SPDX-License-Identifier: GPL-2.0-only OR BSD-2-Clause
%YAML 1.2
---
$id: http://devicetree.org/schemas/misc/ti,mspm0l110x.yaml#
$schema: http://devicetree.org/meta-schemas/core.yaml#

title: Texas Instruments MSPM0L110x Mixed-Signal MCU

description:
  The MSPM0L110x MCU can be connected via I2C or UART.

maintainers:
  - Ayush Singh <ayush@beagleboard.org>

properties:
  compatible:
    const: ti,mspm0l1105

  reg:
    maxItems: 1

  reset-gpios:
    maxItems: 1

  bootloader-backdoor-gpios:
    maxItems: 1
    description: |
      gpios to enable bootloader backdoor in cc1352p7 bootloader to allow
      flashing new firmware.

required:
  - compatible

additionalProperties: false

examples:
  - |
    #include <dt-bindings/gpio/gpio.h>

    i2c {
        #address-cells = <1>;
        #size-cells = <0>;

        mcu: mcu@48 {
          reg = <0x48>;
          compatible = "ti,mspm0l1105";
          reset-gpios = <&pio 35 GPIO_ACTIVE_LOW>;
          bootloader-backdoor-gpios = <&pio 36 GPIO_ACTIVE_LOW>;
        };
    };
```

## Documentation/devicetree/bindings/misc/ti,pat.txt
```
Texas Instruments Page-based Address Translator (PAT) driver binding
--------------------------------------------------------------------

A Page-based Address Translator (PAT) device performs address translation
using tables stored in an internal SRAM. Each PAT supports a set number of
pages, each occupying a programmable 4KB, 16KB, 64KB, or 1MB of addresses
in a window for which an incoming transaction will be translated.

TI-PAT controller Device Node
=============================

The TI-PAT node describes the Texas Instrument's Page-based Address
Translator (PAT).

Required properties:
-------------------
- compatible: should be "ti,j721e-pat"
- reg-names:
	mmrs - Memory mapped registers region
	table - Location of the table of translation pages
- reg: register addresses corresponding to the above
- ti,pat-window-base: base address of window translated by this PAT
- ti,pat-window-size: size of window translated by this PAT

Example:

navss_pat0: pat@31010000 {
	compatible = "ti,j721e-pat";
	reg = <0x00 0x31010000 0x00 0x00000100>,
	      <0x00 0x36400000 0x00 0x00040000>;
	reg-names = "mmrs",
	            "table";
	ti,pat-window-base = <0x48 0x00000000>;
	ti,pat-window-size = <0x00 0x40000000>;
};
```
