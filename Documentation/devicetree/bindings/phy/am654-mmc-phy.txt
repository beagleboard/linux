## Documentation/devicetree/bindings/phy/ti,phy-j721e-wiz.txt
```
TI J721E WIZ (SERDES Wrapper)

Required properties:
 - compatible: Should be "ti,j721e-wiz-16g" for Sierra phy wrapper,
	       or "ti,j721e-wiz-10g" for Torrent phy wrapper.
 - #address-cells : should be 2 to indicate the child node should use 2 cell
     for address
 - #size-cells: should be 2 to indicate the child node should use 2 cell for
     size
 - power-domains: As documented by the generic PM domain bindings in
     Documentation/devicetree/bindings/power/power_domain.txt.
 - clocks: clock-specifier to represent input to the WIZ required for WIZ
     module to be functional
 - num-lanes: Represents thenumber of lanes enabled in the SoC
     Should be '2' for Sierra wrapper in J721E
     Should be '4' for Torrent wrapper in J721E
 - #reset-cells: As documented by the generic reset bindings in
     Documentation/devicetree/bindings/reset/reset.txt
     Should be '1'
 - ranges: Empty ranges property to describe 1:1 translation between parent
     address space and child address space

Optional properties:
assigned-clocks and assigned-clock-parents: As documented in the generic
clock bindings in Documentation/devicetree/bindings/clock/clock-bindings.txt

 - typec-dir-gpios: GPIO to signal Type-C cable orientation for lane swap.
     If GPIO is active, lane 0 and lane 1 of SERDES will be swapped to
     achieve the funtionality of an exernal type-C plug flip mux.

 - typec-dir-debounce: Number of milliseconds to wait before sampling
     typec-dir-gpio. If not specified, the GPIO will be sampled ASAP.
     Type-C spec states minimum CC pin debounce of 100 ms and maximum
     of 200 ms.

 - lane<n>-mode, : Integer describing static lane usage for lane n. For
     Sierra there may be properties for n = 0 and n = 1, for Torrent n = 0,
     n = 1, n = 2, and n = 3. The constants to indicate the lane usage 
     are defined in "include/dt-bindings/phy/phy.h". The lane is assumed
     to be unused if the lane<n>-use property does not exist.

Required subnodes:
 - Clock Subnode: WIZ node should have '3' subnodes for each of the clock
     selects it supports. The clock subnodes should have the following names
	1) pll0_refclk
	2) pll1_refclk
	3) refclk_dig
     Each of these subnodes should clocks, clock-output-names, #clock-cells,
     assigned-clocks and assigned-clock-parents. All these properties are
     documented in the generic clock bindings in
     Documentation/devicetree/bindings/clock/clock-bindings.txt
 - SERDES Subnode: WIZ node should have '1' subnode for the SERDES
     *) Sierra SERDES should follow the bindings specified in
        Documentation/devicetree/bindings/phy/phy-cadence-sierra.txt
     *) Torrent SERDES should follow the bindings specified in
        Documentation/devicetree/bindings/phy/phy-cadence-dp.txt

Example: Example shows binding for SERDES_16G (Sierra SERDES with WIZ wrapper)
serdes_wiz0: wiz@5000000 {
	compatible = "ti,j721e-wiz-16g";
	#address-cells = <2>;
	#size-cells = <2>;
	power-domains = <&k3_pds 292 TI_SCI_PD_EXCLUSIVE>;
	clocks = <&k3_clks 292 5>;
	num-lanes = <2>;
	#reset-cells = <1>;
	ranges;
	lane0-mode = <PHY_TYPE_PCIE>;
	lane1-mode = <PHY_TYPE_PCIE>;

	pll0_refclk: pll0_refclk {
		clocks = <&k3_clks 292 11>, <&cmn_refclk>;
		clock-output-names = "pll0_refclk";
		#clock-cells = <0>;
		assigned-clocks = <&pll0_refclk>;
		assigned-clock-parents = <&k3_clks 292 11>;
	};

	pll1_refclk: pll1_refclk {
		clocks = <&k3_clks 292 0>, <&cmn_refclk1>;
		clock-output-names = "pll1_refclk";
		#clock-cells = <0>;
		assigned-clocks = <&pll1_refclk>;
		assigned-clock-parents = <&k3_clks 292 0>;
	};

	refclk_dig: refclk_dig {
		clocks = <&k3_clks 292 11>, <&k3_clks 292 0>,
			 <&cmn_refclk>, <&cmn_refclk1>;
		clock-output-names = "refclk_dig";
		#clock-cells = <0>;
		assigned-clocks = <&refclk_dig>;
		assigned-clock-parents = <&k3_clks 292 11>;
	};

	serdes0: serdes@5000000 {
		compatible = "cdns,ti,sierra-phy-t0";
		reg-names = "serdes";
		reg = <0x00 0x5000000 0x00 0x10000>;
		#address-cells = <1>;
		#size-cells = <0>;
		resets = <&serdes_wiz0 0>;
		reset-names = "sierra_reset";
		pcie0_phy0: link@0 {
			reg = <0>;
			cdns,num-lanes = <2>;
			#phy-cells = <0>;
			cdns,phy-type = <PHY_TYPE_PCIE>;
			resets = <&serdes_wiz0 1>, <&serdes_wiz0 2>;
		};
	};
};
```

## Documentation/devicetree/bindings/phy/ti-phy.txt
```
TI PHY: DT DOCUMENTATION FOR PHYs in TI PLATFORMs

OMAP CONTROL PHY

Required properties:
 - compatible: Should be one of
 "ti,control-phy-otghs" - if it has otghs_control mailbox register as on OMAP4.
 "ti,control-phy-usb2" - if it has Power down bit in control_dev_conf register
                        e.g. USB2_PHY on OMAP5.
 "ti,control-phy-pipe3" - if it has DPLL and individual Rx & Tx power control
                        e.g. USB3 PHY and SATA PHY on OMAP5.
 "ti,control-phy-pcie" - for pcie to support external clock for pcie and to
			set PCS delay value.
			e.g. PCIE PHY in DRA7x
 "ti,control-phy-usb2-dra7" - if it has power down register like USB2 PHY on
                        DRA7 platform.
 "ti,control-phy-usb2-am437" - if it has power down register like USB2 PHY on
                        AM437 platform.
 - reg : register ranges as listed in the reg-names property
 - reg-names: "otghs_control" for control-phy-otghs
	      "power", "pcie_pcs" and "control_sma" for control-phy-pcie
	      "power" for all other types

omap_control_usb: omap-control-usb@4a002300 {
        compatible = "ti,control-phy-otghs";
        reg = <0x4a00233c 0x4>;
        reg-names = "otghs_control";
};

OMAP USB2 PHY

Required properties:
 - compatible: Should be "ti,omap-usb2"
	       Should be "ti,dra7x-usb2" for the 1st instance of USB2 PHY on
	       DRA7x
	       Should be "ti,dra7x-usb2-phy2" for the 2nd instance of USB2 PHY
	       in DRA7x
	       Should be "ti,am654-usb2" for the USB2 PHYs on AM654.
 - reg : Address and length of the register set for the device.
 - #phy-cells: determine the number of cells that should be given in the
   phandle while referencing this phy.
 - clocks: a list of phandles and clock-specifier pairs, one for each entry in
   clock-names.
 - clock-names: should include:
   * "wkupclk" - wakeup clock.
   * "refclk" - reference clock (optional).

Deprecated properties:
 - ctrl-module : phandle of the control module used by PHY driver to power on
   the PHY.

Recommended properies:
- syscon-phy-power : phandle/offset pair. Phandle to the system control
  module and the register offset to power on/off the PHY.

This is usually a subnode of ocp2scp to which it is connected.

usb2phy@4a0ad080 {
	compatible = "ti,omap-usb2";
	reg = <0x4a0ad080 0x58>;
	ctrl-module = <&omap_control_usb>;
	#phy-cells = <0>;
	clocks = <&usb_phy_cm_clk32k>, <&usb_otg_ss_refclk960m>;
	clock-names = "wkupclk", "refclk";
};

TI PIPE3 PHY

Required properties:
 - compatible: Should be "ti,phy-usb3", "ti,phy-pipe3-sata" or
   "ti,phy-pipe3-pcie. "ti,omap-usb3" is deprecated.
 - reg : Address and length of the register set for the device.
 - reg-names: The names of the register addresses corresponding to the registers
   filled in "reg".
 - #phy-cells: determine the number of cells that should be given in the
   phandle while referencing this phy.
 - clocks: a list of phandles and clock-specifier pairs, one for each entry in
   clock-names.
 - clock-names: should include:
   * "wkupclk" - wakeup clock.
   * "sysclk" - system clock.
   * "refclk" - reference clock.
   * "dpll_ref" - external dpll ref clk
   * "dpll_ref_m2" - external dpll ref clk
   * "phy-div" - divider for apll
   * "div-clk" - apll clock

Optional properties:
 - id: If there are multiple instance of the same type, in order to
   differentiate between each instance "id" can be used (e.g., multi-lane PCIe
   PHY). If "id" is not provided, it is set to default value of '1'.
 - syscon-pllreset: Handle to system control region that contains the
   CTRL_CORE_SMA_SW_0 register and register offset to the CTRL_CORE_SMA_SW_0
   register that contains the SATA_PLL_SOFT_RESET bit. Only valid for sata_phy.
 - syscon-pcs : phandle/offset pair. Phandle to the system control module and the
   register offset to write the PCS delay value.

Deprecated properties:
 - ctrl-module : phandle of the control module used by PHY driver to power on
   the PHY.

Recommended properies:
 - syscon-phy-power : phandle/offset pair. Phandle to the system control
   module and the register offset to power on/off the PHY.

This is usually a subnode of ocp2scp to which it is connected.

usb3phy@4a084400 {
	compatible = "ti,phy-usb3";
	reg = <0x4a084400 0x80>,
	      <0x4a084800 0x64>,
	      <0x4a084c00 0x40>;
	reg-names = "phy_rx", "phy_tx", "pll_ctrl";
	ctrl-module = <&omap_control_usb>;
	#phy-cells = <0>;
	clocks = <&usb_phy_cm_clk32k>,
		 <&sys_clkin>,
		 <&usb_otg_ss_refclk960m>;
	clock-names =	"wkupclk",
			"sysclk",
			"refclk";
};

sata_phy: phy@4A096000 {
	compatible = "ti,phy-pipe3-sata";
	reg = <0x4A096000 0x80>, /* phy_rx */
	      <0x4A096400 0x64>, /* phy_tx */
	      <0x4A096800 0x40>; /* pll_ctrl */
	reg-names = "phy_rx", "phy_tx", "pll_ctrl";
	ctrl-module = <&omap_control_sata>;
	clocks = <&sys_clkin1>, <&sata_ref_clk>;
	clock-names = "sysclk", "refclk";
	syscon-pllreset = <&scm_conf 0x3fc>;
	#phy-cells = <0>;
};


TI AM654 PHY

Required properties:
 - compatible: Should be "ti,phy-am654-serdes"
 - reg : Address and length of the register set for the device.
 - reg-names: Should be "serdes" which corresponds to the register space
	populated in "reg".
 - #phy-cells: determine the number of cells that should be given in the
	phandle while referencing this phy. Should be "2". The 1st cell
	corresponds to the phy type (should be one of the types specified in
	include/dt-bindings/phy/phy.h) and the 2nd cell should be the serdes
	lane function.
	If SERDES0 is referenced 2nd cell should be:
		0 - USB3
		1 - PCIe0 Lane0
		2 - ICSS2 SGMII Lane0
	If SERDES1 is referenced 2nd cell should be:
		0 - PCIe1 Lane0
		1 - PCIe0 Lane1
		2 - ICSS2 SGMII Lane1
 - clocks: List of clock-specifiers representing the input to the SERDES.
	Should have 3 items representing the left input clock, external
	reference clock and right input clock in that order.
 - clock-output-names: List of clock names for each of the clock outputs of
	SERDES. Should have 3 items for CMU reference clock,
	left output clock and right output clock in that order.
 - assigned-clocks: As defined in
	Documentation/devicetree/bindings/clock/clock-bindings.txt
 - assigned-clock-parents: As defined in
	Documentation/devicetree/bindings/clock/clock-bindings.txt
 - #clock-cells: Should be <1> to choose between the 3 output clocks.
	Defined in Documentation/devicetree/bindings/clock/clock-bindings.txt

   The following macros are defined in dt-bindings/phy/phy-am654-serdes.h
   for selecting the correct reference clock. This can be used while
   specifying the clocks created by SERDES.
	=> AM654_SERDES_CMU_REFCLK
	=> AM654_SERDES_LO_REFCLK
	=> AM654_SERDES_RO_REFCLK

 - mux-controls: phandle to the multiplexer

Example:

Example for SERDES0 is given below. It has 3 clock inputs;
left input reference clock as indicated by <&k3_clks 153 4>, external
reference clock as indicated by <&k3_clks 153 1> and right input
reference clock as indicated by <&serdes1 AM654_SERDES_LO_REFCLK>. (The
right input of SERDES0 is connected to the left output of SERDES1).

SERDES0 registers 3 clock outputs as indicated in clock-output-names. The
first refers to the CMU reference clock, second refers to the left output
reference clock and the third refers to the right output reference clock.

The assigned-clocks and assigned-clock-parents is used here to set the
parent of left input reference clock to MAINHSDIV_CLKOUT4 and parent of
CMU reference clock to left input reference clock.

serdes0: serdes@900000 {
	compatible = "ti,phy-am654-serdes";
	reg = <0x0 0x900000 0x0 0x2000>;
	reg-names = "serdes";
	#phy-cells = <2>;
	power-domains = <&k3_pds 153>;
	clocks = <&k3_clks 153 4>, <&k3_clks 153 1>,
			<&serdes1 AM654_SERDES_LO_REFCLK>;
	clock-output-names = "serdes0_cmu_refclk", "serdes0_lo_refclk",
				"serdes0_ro_refclk";
	assigned-clocks = <&k3_clks 153 4>, <&serdes0 AM654_SERDES_CMU_REFCLK>;
	assigned-clock-parents = <&k3_clks 153 8>, <&k3_clks 153 4>;
	ti,serdes-clk = <&serdes0_clk>;
	mux-controls = <&serdes_mux 0>;
	#clock-cells = <1>;
	status = "disabled";
};
```

## Documentation/devicetree/bindings/pinctrl/thead,light-pinctrl.txt
```
* Thead Light PAD mux controller

Please refer to pinctrl-bindings.txt in this directory for details of the
common pinctrl bindings used by client devices, including the meaning of the
phrase "pin configuration node".

Thead light pin configuration node is a node of a group of pins which can be
used for a specific device or function. This node represents both mux_mode and
config of the pins in that group. The 'mux_mode' selects the function mode,
and the 'config' configures various pad settings such as pull-up, open drain,
drive strength, etc.

Required properties for padmux controller:
- compatible: "thead,light-<soc>-pinctrl"
- reg: the padmux config/mux_mode registers base address.
- thead,pins: each entry consists of 3 integers and represents:
	      <pin_id mux_mode config>
  pin_id macro can be found in include/dt-bindings/pinctrl/light-pinctrl.h.
  config is the pad setting value like pull-up on this pin.


Examples:
#include <dt-bindings/pinctrl/light-pinctrl.h>

/* Pin Controller Node */
padmux0: pinctrl@ffef01c000 {
	compatible = "thead,light-mpw-pinctrl";
	reg = <0xff 0xef01c000 0x0 0x4000>;

	light-mpw-evb {
		/* Pin Configuration Node:
		 * Format: <pin_id  mux_mode  config>
		 */
		pinctrl_uart0: uart0grp {
			thead,pins = <
				UART0_RXD	0x0	0x72
				UART0_TXD	0x0	0x72
			>;
		};
	};
};
```
