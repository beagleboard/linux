## Documentation/devicetree/bindings/pinctrl/ti,iodelay-pinctrl.txt
```
Texas Instruments I/O Delay module configuration pinctrl definition

Used in conjunction with Documentation/devicetree/bindings/pinctrl/ti,omap-pinctrl.txt

Required Properties:
- compatible: Should be:
  "ti,dra7-iodelay" - I/O delay configuration for DRA7
- reg	- must be the register address range of IODelay module
- #address-cells = <1>;
- #size-cells = <0>;

Important note: Use of "ti,dra7-iodelay" compatible definition need to be
carefully evaluated due to the expectation of glitch during configuration.

Example:

dra7_iodelay_core: padconf@4844a000 {
	compatible = "ti,dra7-iodelay";
	reg = <0x4844a000 0x0d1c>;
	#address-cells = <1>;
	#size-cells = <0>;
};

Configuration definition follows similar model as the pinctrl-single:
The groups of pin configuration are defined under "pinctrl-single,pins"

&dra7_iodelay_core {
	mmc2_iodelay_3v3_conf: mmc2_iodelay_3v3_conf {
		pinctrl-single,pins = <
			0x18c (A_DELAY(0) | G_DELAY(120))	/* CFG_GPMC_A19_IN */
			0x1a4 (A_DELAY(265) | G_DELAY(360))	/* CFG_GPMC_A20_IN */
			0x1b0 (A_DELAY(0) | G_DELAY(120))	/* CFG_GPMC_A21_IN */
			0x1bc (A_DELAY(0) | G_DELAY(120))	/* CFG_GPMC_A22_IN */
			0x1c8 (A_DELAY(287) | G_DELAY(420))	/* CFG_GPMC_A23_IN */
			0x1d4 (A_DELAY(144) | G_DELAY(240))	/* CFG_GPMC_A24_IN */
			0x1e0 (A_DELAY(0) | G_DELAY(0))		/* CFG_GPMC_A25_IN */
			0x1ec (A_DELAY(120) | G_DELAY(0))	/* CFG_GPMC_A26_IN */
			0x1f8 (A_DELAY(120) | G_DELAY(180))	/* CFG_GPMC_A27_IN */
			0x360 (A_DELAY(0) | G_DELAY(0))		/* CFG_GPMC_CS1_IN */
		>;
	};
};

Usage in conjunction with pinctrl single:

For a complete description of the pins both the regular muxing as well as the
iodelay configuration is necessary. For example:

&dra7_pmx_core {
	mmc2_pins_default: mmc2_pins_default {
		pinctrl-single,pins = <
			0x9c (PIN_INPUT_PULLUP | MANUAL_MODE | MUX_MODE1) /* gpmc_a23.mmc2_clk */
			0xb0 (PIN_INPUT_PULLUP | MANUAL_MODE | MUX_MODE1) /* gpmc_cs1.mmc2_cmd */
			0xa0 (PIN_INPUT_PULLUP | MANUAL_MODE | MUX_MODE1) /* gpmc_a24.mmc2_dat0 */
			0xa4 (PIN_INPUT_PULLUP | MANUAL_MODE | MUX_MODE1) /* gpmc_a25.mmc2_dat1 */
			0xa8 (PIN_INPUT_PULLUP | MANUAL_MODE | MUX_MODE1) /* gpmc_a26.mmc2_dat2 */
			0xac (PIN_INPUT_PULLUP | MANUAL_MODE | MUX_MODE1) /* gpmc_a27.mmc2_dat3 */
			0x8c (PIN_INPUT_PULLUP | MANUAL_MODE | MUX_MODE1) /* gpmc_a19.mmc2_dat4 */
			0x90 (PIN_INPUT_PULLUP | MANUAL_MODE | MUX_MODE1) /* gpmc_a20.mmc2_dat5 */
			0x94 (PIN_INPUT_PULLUP | MANUAL_MODE | MUX_MODE1) /* gpmc_a21.mmc2_dat6 */
			0x98 (PIN_INPUT_PULLUP | MANUAL_MODE | MUX_MODE1) /* gpmc_a22.mmc2_dat7 */
		>;
	};
};

&dra7_iodelay_core {
	mmc2_iodelay_3v3_conf: mmc2_iodelay_3v3_conf {
		pinctrl-single,pins = <
			0x18c (A_DELAY(0) | G_DELAY(120))	/* CFG_GPMC_A19_IN */
			0x1a4 (A_DELAY(265) | G_DELAY(360))	/* CFG_GPMC_A20_IN */
			0x1b0 (A_DELAY(0) | G_DELAY(120))	/* CFG_GPMC_A21_IN */
			0x1bc (A_DELAY(0) | G_DELAY(120))	/* CFG_GPMC_A22_IN */
			0x1c8 (A_DELAY(287) | G_DELAY(420))	/* CFG_GPMC_A23_IN */
			0x1d4 (A_DELAY(144) | G_DELAY(240))	/* CFG_GPMC_A24_IN */
			0x1e0 (A_DELAY(0) | G_DELAY(0))		/* CFG_GPMC_A25_IN */
			0x1ec (A_DELAY(120) | G_DELAY(0))	/* CFG_GPMC_A26_IN */
			0x1f8 (A_DELAY(120) | G_DELAY(180))	/* CFG_GPMC_A27_IN */
			0x360 (A_DELAY(0) | G_DELAY(0))		/* CFG_GPMC_CS1_IN */
		>;
	};
};

&mmc2 {
	pinctrl-names = "default";
	pinctrl-0 = <&mmc2_pins_default &mmc2_iodelay_3v3_conf>;
};
```

## Documentation/devicetree/bindings/pinctrl/ti,omap-pinctrl.txt
```
OMAP Pinctrl definitions

Required properties:
- compatible : Should be one of:
  "ti,omap3-padconf" - OMAP3 compatible pinctrl
  "ti,omap4-padconf" - OMAP4 compatible pinctrl
  "ti,omap5-padconf" - OMAP5 compatible pinctrl
  "ti,dra7-padconf" - DRA7 compatible pinctrl

See Documentation/devicetree/bindings/pinctrl/pinctrl-single.txt for further details.
```

## Documentation/devicetree/bindings/power/voltdm/voltage_domain.txt
```
Specifying Voltage Domain information for devices
=================================================

1. Specifying a voltage domain.

SoCs may have multiple voltage domains under which various clocks operate.

Mandatory Properties:
- #voltdm-cells - indicates if there are specifiers needed to reference the
  voltage domain

Optional Properties:
- voltage-tolerance: Specify the voltage tolerance in percentage

2. Voltage domain consumer
consumer nodes can be reference using the below binding:
- <name>-voltdm: phandle to the voltage domain node.

Examples:

A. Voltage Domain controlling multiple regulator
voltage_domain_mpu: voltdm@1 {
	compatible = "xyz";
	#voltdm-cells = <0>;
	vdd-supply = <&vcc>;
	vbb-supply = <&abb_mpu>;
	...
};

voltage_domain_gpu: voltdm@2 {
	compatible = "xyz";
	#voltdm-cells = <0>;
	vdd-supply = <&dcdc2>;
	vbb-supply = <&abb_gpu>;
	...
};
...
&cpu0 {
	cpu0-voltdm = <&voltage_domain_mpu>;
	voltage-tolerance = <1>;
};

&gpu {
	gpu-voltdm = <&voltage_domain_gpu>;
};

B. Indexed voltage domain device

#define SOC_XYZ_VOLTAGE_DOMAIN_MPU	0
#define SOC_XYZ_VOLTAGE_DOMAIN_GFX	1

voltage_domain_socx: voltdm@1 {
	compatible = "abc";
	#voltdm-cells = <1>;
	...
};
...
&cpu0 {
	cpu0-voltdm = <&voltage_domain_socx SOC_XYZ_VOLTAGE_DOMAIN_MPU>;
	voltage-tolerance = <1>;
};

&gpu {
	gpu-voltdm = <&voltage_domain_socx SOC_XYZ_VOLTAGE_DOMAIN_GFX>;
};
```

## Documentation/devicetree/bindings/power/voltdm/voltdm_omap.txt
```
Texas Instruments OMAP compatible voltage domain description

This binding uses [1] and describes the voltage domain devices
typically used on Texas Instruments OMAP compatible SoC family of
processors.

[1] Documentation/devicetree/bindings/power/voltdm/voltage_domain.txt

Required Properties:
- compatible: Should be one of:
	"ti,omap-voltdm" - basic voltage domain controlling VDD and VBB
	"ti,omap5-voltdm" - OMAP5+ optimized voltages in efuse(class0)VDD
			    along with VBB
	"ti,omap5-core-voltdm" - OMAP5+ optimized voltages in efuse(vlass0) VDD
			    but no VBB.
- vdd-supply: phandle to regulator controlling VDD supply
- vbb-supply: phandle to regulator controlling Body Bias supply (optional if
  "ti,omap5-core-voltdm")
  (Usually Adaptive Body Bias regulator)
- #voltdm-cells: shall be <0>
- reg: Address and length of the efuse register set for the device (mandatory
	only for "ti,omap5-voltdm")
- ti,efuse-settings: An array of u32 tuple items providing information about
	optimized efuse configuration. Each item consists of the following:
	volt: voltage in uV - reference voltage (OPP voltage)
	efuse_offseet: efuse offset from reg where the optimized voltage is stored.

Optional Properties:
- ti,absolute-max-voltage-uv: absolute maximum voltage for the voltage domain.

Example:
voltage_domain_mpu: voltdm@1 {
	compatible = "ti,omap-voltdm";
	#voltdm-cells = <0>;

	vdd-supply = <&vcc>;
	vbb-supply = <&abb_mpu>;
};

voltdm_mpu: voltdm@4a003b20 {
	compatible = "ti,omap5-voltdm";
	#voltdm-cells = <0>;
	vdd-supply = <&vcc>;
	vbb-supply = <&abb_mpu>;
	reg = <0x4a003b20 0x8>;
	ti,efuse-settings = <
	/* uV   offset */
	1060000 0x0
	1160000 0x4
	1210000 0x8
	>;
};

voltdm_core: voltdm@4a003d20 {
	compatible = "ti,omap5-core-voltdm";
	#voltdm-cells = <0>;
	vdd-supply = <&smps4>;
	reg = <0x4a003b20 0x4>;
	ti,efuse-settings = <
	/* uV   offset */
	1060000 0x0
	>;
};
```

## Documentation/devicetree/bindings/pwm/pwm-pru.txt
```
PRUSS PWM controller on TI SoCs

The PRUSS can be programmed as multi IEP-based PWM controllers.

Each PRU PWM node should define the PRU Application node properties as detailed
in bindings ti,pru-rproc.txt and one or more PWM chip node(s) describing the
IEP-based PWM controller(s).

Required properties:
--------------------
- compatible        : should be "ti,pru-pwm".
- prus              : phandle to the PRU node used.
- firmware-name     : firmware for the PRU core.

PWM Chip Node
==============
Required properties:
--------------------
- compatible        : should be "ti,pru-pwmchip".
- reg               : index of the pwmchip corresponding to the index of the
		      IEP, 0-based.
- #pwm-cells        : should be 2. See pwm.txt in this directory for a
		      description of the cell formats.

Example (AM654x EVM board):
---------------------------

	pru_pwm0 {
		compatible = "ti,pru-pwm";
		prus = <&pru0_0>;
		firmware-name = "ti-pruss/am65x-pru0-pwm-fw.elf";
		assigned-clocks = <&icssg0_iepclk_mux>;
		assigned-clock-parents = <&k3_clks 62 10>;
		#address-cells = <1>;
		#size-cells = <0>;

		pwm_chip@0 {
			compatible = "ti,pru-pwmchip";
			reg = <0>;
			#pwm-cells = <2>;
			pinctrl-0 = <&prupwm0_chip0_pins_default>;
			pinctrl-names = "default";
		};

		pwm_chip@1 {
			compatible = "ti,pru-pwmchip";
			reg = <1>;
			#pwm-cells = <2>;
			pinctrl-0 = <&prupwm0_chip1_pins_default>;
			pinctrl-names = "default";
		};
	};
```

## Documentation/devicetree/bindings/pwm/pwm-tiehrpwm.txt
```
TI SOC EHRPWM based PWM controller

Required properties:
- compatible: Must be "ti,<soc>-ehrpwm".
  for am33xx - compatible = "ti,am33xx-ehrpwm";
  for da850  - compatible = "ti,da850-ehrpwm", "ti,am33xx-ehrpwm";
- #pwm-cells: should be 3. See pwm.txt in this directory for a description of
  the cells format. The only third cell flag supported by this binding is
  PWM_POLARITY_INVERTED.
- reg: physical base address and size of the registers map.

Optional properties:
- clocks: Reference to the ehrpwm's tb clock
- clock-names : must contain "tbclk"

Example:

ehrpwm0: pwm@48300200 { /* EHRPWM on am33xx */
	compatible = "ti,am33xx-ehrpwm";
	#pwm-cells = <3>;
	reg = <0x48300200 0x100>;
	clocks = <&ehrpwm0_tbclk>;
	clock-names = "tbclk";
};

ehrpwm0: pwm@01f00000 { /* EHRPWM on da850 */
	compatible = "ti,da850-ehrpwm", "ti,am33xx-ehrpwm";
	#pwm-cells = <3>;
	reg = <0x300000 0x2000>;
};
```

## Documentation/devicetree/bindings/pwm/thead,pwm-light.txt
```
= Thead Light PWM Controller =

This binding is intended to represent PWM which is found in Thead SoCs

Required properties:
- compatible:	should be
		"thead,pwm-light": for light fullmask
- reg:		physical base address and length of the controller's registers

Examples:

	pwm: pwm@ffec01c000 {
		compatible = "thead,pwm-light";
		reg = <0xff 0xec01c000 0x0 0x4000>;
	};
```
