## Documentation/devicetree/bindings/remoteproc/ti,keystone-rproc.txt
```
TI Keystone DSP devices
=======================

Binding status: Unstable - Subject to changes for using multiple memory regions

The TI Keystone 2 family of SoCs usually have one or more (upto 8) TI DSP Core
sub-systems that are used to offload some of the processor-intensive tasks or
algorithms, for achieving various system level goals.

These processor sub-systems usually contain additional sub-modules like L1
and/or L2 caches/SRAMs, an Interrupt Controller, an external memory controller,
a dedicated local power/sleep controller etc. The DSP processor core in
Keystone 2 SoCs is usually a TMS320C66x CorePac processor.

DSP Device Node:
================
Each DSP Core sub-system is represented as a single DT node. Each node has a
number of required or optional properties that enable the OS running on the
host processor (ARM CorePac) to perform the device management of the remote
processor and to communicate with the remote processor.

Required properties:
--------------------
The following are the mandatory properties:

- compatible:		Should be one of the following,
			    "ti,k2hk-dsp" for DSPs on Keystone 2 66AK2H/K SoCs
			    "ti,k2l-dsp" for DSPs on Keystone 2 66AK2L SoCs
			    "ti,k2e-dsp" for DSPs on Keystone 2 66AK2E SoCs
			    "ti,k2g-dsp" for DSPs on Keystone 2 66AK2G SoCs

- reg:			Should contain an entry for each value in 'reg-names'.
			Each entry should have the memory region's start address
			and the size of the region, the representation matching
			the parent node's '#address-cells' and '#size-cells' values.

- reg-names:		Should contain strings with the following names, each
			representing a specific internal memory region, and
			should be defined in this order,
			     "l2sram", "l1pram", "l1dram"

- label:		Should contain a string identifying the DSP instance
			within the SoC. Should be the string "dsp" followed by
			the instance number. Eg: "dsp0", "dsp1",..."dsp7" etc

- clocks: 		Should contain the device's input clock, and should be
			defined as per the bindings in,
			Documentation/devicetree/bindings/clock/keystone-gate.txt
			    for 66AK2HK/66AK2L/66AK2E SoCs or,
			Documentation/devicetree/bindings/clock/ti,sci-clk.txt
			    for 66AK2G SoC

- ti,syscon-dev:	Should be a pair of the phandle to the Keystone Device
			State Control node, and the register offset of the DSP
			boot address register within that node's address space.

- resets:		Should contain the phandle to the reset controller node
			managing the resets for this device, and a reset
			specifier. Please refer to either of the following reset
			bindings for the reset argument specifier as per SoC,
			Documentation/devicetree/bindings/reset/ti-syscon-reset.txt
			    for 66AK2HK/66AK2L/66AK2E SoCs or,
			Documentation/devicetree/bindings/reset/ti,sci-reset.txt
			    for 66AK2G SoC

- interrupt-parent:	Should contain a phandle to the Keystone 2 IRQ controller
			IP node that is used by the ARM CorePac processor to
			receive interrupts from the DSP remote processors. See
			Documentation/devicetree/bindings/interrupt-controller/ti,keystone-irq.txt
			for details.

- interrupts: 		Should contain an entry for each value in 'interrupt-names'.
			Each entry should have the interrupt source number used by
			the remote processor to the host processor. The values should
			follow the interrupt-specifier format as dictated by the
			'interrupt-parent' node. The purpose of each is as per the
			description in the 'interrupt-names' property.

- interrupt-names:	Should contain strings with the following names, each
			representing a specific interrupt,
			    "vring" - interrupt for virtio based IPC
			    "exception" - interrupt for exception notification

- kick-gpio: 		Should specify the gpio device needed for the virtio IPC
			stack. This will be used to interrupt the remote processor.
			The gpio device to be used is as per the bindings in,
			Documentation/devicetree/bindings/gpio/gpio-dsp-keystone.txt

Optional properties:
--------------------

- power-domains:	_required_ property only for Keystone 2 66AK2G SoCs.
			Should contain a phandle to a PM domain provider node.
			This property is as per the binding,
			Documentation/devicetree/bindings/soc/ti/sci-pm-domain.txt

- ti,sci-id:		_required_ property only for Keystone 2 66AK2G SoCs.
			Should contain the SCI device id to identify the specific
			device. The id values are defined in the dt include file,
			include/dt-bindings/genpd/k2g.h

- memory-region:	phandle to the reserved memory node to be associated
			with the remoteproc device. The reserved memory node
			can be a CMA memory node, and should be defined as
			per the bindings in
			Documentation/devicetree/bindings/reserved-memory/reserved-memory.txt


Examples:
---------

1.
	/* 66AK2H/K DSP node in SoC DTS file */
	soc {
		dsp0: dsp@10800000 {
			compatible = "ti,k2hk-dsp";
			reg = <0x10800000 0x00100000>,
			      <0x10e00000 0x00008000>,
			      <0x10f00000 0x00008000>;
			reg-names = "l2sram", "l1pram", "l1dram";
			label = "dsp0";
			clocks = <&clkgem0>;
			ti,syscon-dev = <&devctrl 0x40>;
			resets = <&pscrst 0>;
			interrupt-parent = <&kirq0>;
			interrupts = <0 8>;
			interrupt-names = "vring", "exception";
			kick-gpio = <&dspgpio0 27 0>;
		};

	};

	/* K2HK EVM Board file */
	&dsp0 {
		memory-region = <&dsp_common_cma_pool>;
	};

2.
	/* 66AK2G DSP node in SoC DTS file */
	soc {
		dsp0: dsp@10800000 {
			compatible = "ti,k2g-dsp";
			reg = <0x10800000 0x00100000>,
			      <0x10e00000 0x00008000>,
			      <0x10f00000 0x00008000>;
			reg-names = "l2sram", "l1pram", "l1dram";
			label = "dsp0";
			power-domains = <&k2g_pds K2G_DEV_CGEM0>;
			clocks = <&k2g_clks K2G_DEV_CGEM0 0>;
			ti,syscon-dev = <&devctrl 0x40>;
			resets = <&k2g_reset K2G_DEV_CGEM0 K2G_DEV_CGEM0_DSP0_RESET>;
			interrupt-parent = <&kirq0>;
			interrupts = <0 8>;
			interrupt-names = "vring", "exception";
			kick-gpio = <&dspgpio0 27 0>;
		};

	};

	/* K2G EVM Board file */
	&dsp0 {
		memory-region = <&dsp_common_cma_pool>;
	};
```

## Documentation/devicetree/bindings/remoteproc/ti,pru-consumer.yaml
```yaml
# SPDX-License-Identifier: (GPL-2.0-only or BSD-2-Clause)
%YAML 1.2
---
$id: http://devicetree.org/schemas/remoteproc/ti,pru-consumer.yaml#
$schema: http://devicetree.org/meta-schemas/core.yaml#

title: Common TI PRU Consumer Binding

maintainers:
  - Suman Anna <s-anna@ti.com>

description: |
  A PRU application/consumer/user node typically uses one or more PRU device
  nodes to implement a PRU application/functionality. Each application/client
  node would need a reference to at least a PRU node, and optionally define
  some properties needed for hardware/firmware configuration. The below
  properties are a list of common properties supported by the PRU remoteproc
  infrastructure.

  The application nodes shall define their own bindings like regular platform
  devices, so below are in addition to each node's bindings.

properties:
  prus:
    $ref: /schemas/types.yaml#/definitions/phandle-array
    description: phandles to the PRU, RTU or Tx_PRU nodes used

  firmware-name:
    $ref: /schemas/types.yaml#/definitions/string-array
    description: |
      firmwares for the PRU cores, the default firmware for the core from
      the PRU node will be used if not provided. The firmware names should
      correspond to the PRU cores listed in the 'prus' property

  ti,pruss-gp-mux-sel:
    $ref: /schemas/types.yaml#/definitions/uint32-array
    enum: [0, 1, 2, 3, 4]
    description: |
      array of values for the GP_MUX_SEL under PRUSS_GPCFG register for a PRU.
      This selects the internal muxing scheme for the PRU instance. Values
      should correspond to the PRU cores listed in the 'prus' property. The
      GP_MUX_SEL setting is a per-slice setting (one setting for PRU0, RTU0,
      and Tx_PRU0 on K3 SoCs). Use the same value for all cores within the
      same slice in the associative array. If the array size is smaller than
      the size of 'prus' property, the default out-of-reset value (0) for the
      PRU core is used.

  ti,pru-interrupt-map:
    $ref: /schemas/types.yaml#/definitions/uint32-array
    description: |
      PRU interrupt mappings, containing an array of entries with each entry
      consisting of 4 cell-values. First one is an index towards the "prus"
      property to identify the PRU core for the interrupt map, second is the
      PRU System Event id, third is the PRU interrupt channel id and fourth
      is the PRU host interrupt id. If provided, this map will supercede any
      other configuration provided through firmware
    minItems: 1
    maxItems: 64
    items:
      items:
        - description: index towards the "prus" property to identify the PRU core
                       for the interrupt map
        - description: PRU System Event id
        - description: PRU interrupt channel id
        - description: PRU host interrupt id

required:
 - prus

dependencies:
  firmware-name: [ prus ]
  ti,pruss-gp-mux-sel: [ prus ]
  ti,pru-interrupt-map: [ prus ]

examples:
  - |
    /* PRU application node example */
    pru-app {
        prus = <&pru0>, <&pru1>;
        firmware-name = "pruss-app-fw0", "pruss-app-fw1";
        ti,pruss-gp-mux-sel = <2>, <1>;
        /* setup interrupts for prus:
           prus[0] => pru0: ev=16, chnl=2, host-irq=7,
           prus[1] => pru1: ev=19, chnl=1, host-irq=3 */
        ti,pru-interrupt-map = <0 16 2 7>, <1 19 1 3>;
    };
```

## Documentation/devicetree/bindings/remoteproc/ti,pru-rproc.txt
```
PRU Core on TI SoCs
===================

Each PRUSS has dual PRU cores, each represented by a PRU node. Each PRU core
has a dedicated Instruction RAM, Control and Debug register sets, and use
the Data RAMs present within the PRUSS for code execution.

Each PRU core node should be defined as a child node of the corresponding PRUSS
node. Each node can optionally be rendered inactive by using the standard DT
string property, "status".

Please see the overall PRUSS bindings document for additional details
including a complete example,
    Documentation/devicetree/bindings/soc/ti/ti,pruss.txt

Required Properties:
--------------------
- compatible     : should be
                       "ti,am3356-pru" for AM335x family of SoCs
                       "ti,am4376-pru" for AM437x family of SoCs
                       "ti,am5728-pru" for AM57xx family of SoCs
                       "ti,k2g-pru" for 66AK2G family of SoCs
- reg            : base address and size for each of the 3 sub-module address
                   spaces as mentioned in reg-names, and in the same order as
                   the reg-names
- reg-names      : should contain each of the following 3 names, the binding is
                   agnostic of the order of these reg-names, preferable to have
                   the "iram" entry as the first one
                       "iram" for Instruction RAM,
                       "control" for the CTRL sub-module registers,
                       "debug" for the Debug sub-module registers,
- firmware-name  : should contain the name of the default firmware image file
                   located on the firmware search path

Optional Properties:
--------------------
The virtio based communication between the MPU and a PRU core _requires_
either the 'mboxes' property, or the set of 'interrupt-parent', 'interrupts'
and 'interrupt-names' properties to be defined. The latter option is the
preferred choice. The 'mboxes' property is not applicable for 66AK2G and
DA850/OMAP-L138 SoCs.

- mboxes           : OMAP Mailbox specifier denoting the sub-mailbox, if using
                     a mailbox for IPC signalling between host and a PRU core.
                     The specifier format is as per the bindings,
                         Documentation/devicetree/bindings/mailbox/omap-mailbox.txt
                     This property should match with the sub-mailbox node used
                     in the corresponding firmware image.
- interrupt-parent : phandle to the PRUSS INTC node. Should be defined if
                     interrupts property is to be used.
- interrupts       : array of interrupt specifiers if using PRU system events
                     for IPC signalling between host and a PRU core. This
                     property should match with the PRU system event used in
                     the corresponding firmware image.
- interrupt-names  : should use one of the following names for each interrupt,
                     the name should match the corresponding PRU system event
                     number,
                         "vring" - for PRU to HOST virtqueue signalling
                         "kick"  - for HOST to PRU virtqueue signalling


Example:
--------

1.	/* AM33xx PRU-ICSS */
	pruss_tm: target-module@300000 {	/* 0x4a300000, ap 9 04.0 */
		compatible = "ti,sysc-pruss", "ti,sysc";
		ranges = <0x0 0x300000 0x80000>;
		...

		pruss: pruss@0 {
			compatible = "ti,am3356-pruss";
			reg = <0x0 0x80000>;
			...

			pruss_mem: memories@0 {
				reg = <0x0 0x2000>,
				      <0x2000 0x2000>,
				      <0x10000 0x3000>;
				reg-names = "dram0", "dram1", "shrdram2";
			};

			pru0: pru@34000 {
				compatible = "ti,am3356-pru";
				reg = <0x34000 0x2000>,
				      <0x22000 0x400>,
				      <0x22400 0x100>;
				reg-names = "iram", "control", "debug";
				firmware-name = "am335x-pru0-fw";
				interrupt-parent = <&pruss_intc>;
				interrupts = <16>, <17>;
				interrupt-names = "vring", "kick";
			};

			pru1: pru@38000 {
				compatible = "ti,am3356-pru";
				reg = <0x38000 0x2000>,
				      <0x24000 0x400>,
				      <0x24400 0x100>;
				reg-names = "iram", "control", "debug";
				firmware-name = "am335x-pru1-fw";
				interrupt-parent = <&pruss_intc>;
				interrupts = <18>, <19>;
				interrupt-names = "vring", "kick";
				/* mboxes = <&mailbox &mbox_pru1>; */
			};
		};
	};
```
