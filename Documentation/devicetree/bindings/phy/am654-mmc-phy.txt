## Documentation/devicetree/bindings/remoteproc/omap-remoteproc.txt
```
OMAP4+ Remoteproc Devices
=========================

The OMAP family of SoCs usually have one or more slave processor sub-systems
that are used to offload some of the processor-intensive tasks, or to manage
other hardware accelerators, for achieving various system level goals.

The processor cores in the sub-system are usually behind an IOMMU, and may
contain additional sub-modules like Internal RAM and/or ROMs, L1 and/or L2
caches, an Interrupt Controller, a Cache Controller etc.

The OMAP SoCs usually have a DSP processor sub-system and/or an IPU processor
sub-system. The DSP processor sub-system can contain any of the TI's C64x,
C66x or C67x family of DSP cores as the main execution unit. The IPU processor
sub-system usually contains either a Dual-Core Cortex-M3 or Dual-Core Cortex-M4
processors.

Remote Processor Node:
======================
Each remote processor sub-system is represented as a single DT node. Each node
has a number of required or optional properties that enable the OS running on
the host processor (MPU) to perform the device management of the remote
processor and to communicate with the remote processor. The various properties
can be classified as constant or variable. The constant properties are dictated
by the SoC and does not change from one board to another having the same SoC.
Examples of constant properties include 'iommus', 'reg'. The variable properties
are dictated by the system integration aspects such as memory on the board, or
configuration used within the corresponding firmware image. Examples of variable
properties include 'mboxes', 'memory-region', 'timers', 'watchdog-timers' etc.

Required properties:
--------------------
The following are the mandatory properties:

- compatible:	Should be one of the following,
		    "ti,omap4-dsp" for DSPs on OMAP4 SoCs
		    "ti,omap5-dsp" for DSPs on OMAP5 SoCs
		    "ti,dra7-dsp" for DSPs on DRA7xx SoCs
		    "ti,omap4-ipu" for IPUs on OMAP4 SoCs
		    "ti,omap5-ipu" for IPUs on OMAP5 SoCs
		    "ti,dra7-ipu" for IPUs on DRA7xx SoCs

- ti,hwmods:	Name of the hwmod associated with the remoteproc device

- iommus:	phandles to OMAP IOMMU nodes, that need to be programmed
		for this remote processor to access any external RAM memory or
		other peripheral device address spaces. This property usually
		has only a single phandle. Multiple phandles are used only in
		cases where the sub-system has different ports for different
		sub-modules within the processor sub-system (eg: DRA7 DSPs),
		and need the same programming in both the MMUs.

- mboxes:	OMAP Mailbox specifier denoting the sub-mailbox, to be used for
		communication with the remote processor. The specifier format is
		as per the bindings,
		Documentation/devicetree/bindings/mailbox/omap-mailbox.txt
		This property should match with the sub-mailbox node used in
		the firmware image.

Optional properties:
--------------------
Some of these properties are mandatory on some SoCs, and some are optional
depending on the configuration of the firmware image to be executed on the
remote processor. The conditions are mentioned for each property.

The following are the optional properties:
- reg:			Address space for any remoteproc memories present on
			the SoC. Should contain an entry for each value in
			'reg-names'. These are mandatory for all DSP and IPU
			processors that have them (OMAP4/OMAP5 DSPs do not have
			any RAMs)

- reg-names:		Required names for each of the address spaces defined in
			the 'reg' property. Should contain a string from among
			the following names, each representing the corresponding
			internal RAM memory region,
			   "l2ram" for L2 RAM,
			   "l1pram" for L1 Program RAM Memory/Cache,
			   "l1dram" for L1 Data RAM Memory/Cache,

			All devices may not have all the above memories.

- syscon-bootreg:	Should be a pair of the phandle to the System Control
			Configuration region that contains the boot address
			register, and the register offset of the boot address
			register within the System Control module. This property
			is required for all the DSP instances on OMAP4, OMAP5
			and DRA7xx SoCs.

- memory-region:	phandle to the reserved memory node to be associated
			with the remoteproc device. The reserved memory node
			should be a CMA memory node, and should be defined as
			per the bindings,
			Documentation/devicetree/bindings/reserved-memory/reserved-memory.txt

- mbox-names:		Optional names for the OMAP mailbox specifiers mentioned
			in the 'mboxes' property, one per specifier value

- timers:		One or more phandles to OMAP DMTimer nodes, that serve
			as System/Tick timers for the OS running on the remote
			processors. This will usually be a single timer if the
			processor sub-system is running in SMP mode, or one per
			core in the processor sub-system.

			This property is mandatory on remote processors requiring
			external tick wakeup, and to support Power Management
			features. The timers to be used should match with the
			timers used in the firmware image.

- watchdog-timers:	One or more phandles to OMAP DMTimer nodes, used to
			serve as Watchdog timers for the processor cores. This
			will usually be one per executing processor core, even
			if the processor sub-system is running a SMP OS.

			The timers to be used should match with the watchdog
			timers used in the firmware image.

- ti,rproc-standby-info: Standby data for the remote processor. This is
			 mandatory to support Power Management for the OMAP
			 remoteprocs, and should contain the address containing
			 the module standby status.

Example:
--------

/* OMAP4 DSP node in SoC DTS file */
ocp {
	dsp: dsp {
		compatible = "ti,omap4-dsp";
		ti,hwmods = "dsp";
		syscon-bootreg = <&scm_conf 0x304>;
		iommus = <&mmu_dsp>;
		mboxes = <&mailbox &mbox_dsp>;
		ti,rproc-standby-info = <0x4a004420>;
		status = "disabled";
	};
};

/* OMAP4 DSP node additional fields in a Board DTS file */
&dsp {
	status = "okay";
	memory-region = <&dsp_cma_pool>;
	timers = <&timer5>;
	watchdog-timers = <&timer6>;
};
```

## Documentation/devicetree/bindings/remoteproc/ti,davinci-rproc.txt
```
TI Davinci DSP devices
=======================

Binding status: Unstable - Subject to changes for DT clocks

The TI Davinci family of SoCs usually contains a TI DSP Core sub-system that
is used to offload some of the processor-intensive tasks or algorithms, for
achieving various system level goals.

The processor cores in the sub-system usually contain additional sub-modules
like L1 and/or L2 caches/SRAMs, an Interrupt Controller, an external memory
controller, a dedicated local power/sleep controller etc. The DSP processor
core used in Davinci SoCs is usually a C674x DSP CPU.

DSP Device Node:
================
Each DSP Core sub-system is represented as a single DT node.

Required properties:
--------------------
The following are the mandatory properties:

- compatible:		Should be one of the following,
			    "ti,da850-dsp" for DSPs on OMAP-L138 SoCs

- reg:			Should contain an entry for each value in 'reg-names'.
			Each entry should have the memory region's start address
			and the size of the region, the representation matching
			the parent node's '#address-cells' and '#size-cells' values.

- reg-names:		Should contain strings with the following names, each
			representing a specific internal memory region or a
			specific register space,
			     "l2sram", "l1pram", "l1dram", "host1cfg", "chipsig_base"

- interrupts: 		Should contain the interrupt number used to receive the
			interrupts from the DSP. The value should follow the
			interrupt-specifier format as dictated by the
			'interrupt-parent' node.

- memory-region:	phandle to the reserved memory node to be associated
			with the remoteproc device. The reserved memory node
			can be a CMA memory node, and should be defined as
			per the bindings in
			Documentation/devicetree/bindings/reserved-memory/reserved-memory.txt

Optional properties:
--------------------
- interrupt-parent:	phandle to the interrupt controller node. This property
			is needed if the device node hierarchy doesn't have an
			interrupt controller.

Undefined properties:
---------------------
The following properties are not yet defined, but will become mandatory as and
when the corresponding bindings are defined

- clocks: 		Should contain the device's input clock

- resets:		Should contain the phandle to the reset controller node
			managing the resets for this device, and a reset
			specifier.


Example:
--------

	/* DA850 DTS file */
	{
		dsp: dsp@11800000 {
			compatible = "ti,da850-dsp";
			reg = <0x11800000 0x40000>,
			      <0x11e00000 0x8000>,
			      <0x11f00000 0x8000>,
			      <0x01c14044 0x4>,
			      <0x01c14174 0x8>;
			reg-names = "l2sram", "l1pram", "l1dram", "host1cfg",
				    "chipsig";
			interrupt-parent = <&intc>;
			interrupts = <28>;
			status = "disabled";
		};

	};

	/* OMAP-L138 LCDK Board file */
	reserved-memory {
		#address-cells = <1>;
		#size-cells = <1>;
		ranges;

		dsp_cma_pool: dsp_cma@c3000000 {
                        compatible = "shared-dma-pool";
                        reg = <0xc3000000 0x1000000>;
                        reusable;
                        status = "okay";
                };
	};

	&dsp {
		status = "okay";
		memory-region = <&dsp_cma_pool>;
	};
```

## Documentation/devicetree/bindings/remoteproc/ti,k3-dsp-rproc.txt
```
TI K3 DSP devices
=================

The TI K3 family of SoCs usually have one or more TI DSP Core sub-systems that
are used to offload some of the processor-intensive tasks or algorithms, for
achieving various system level goals.

These processor sub-systems usually contain additional sub-modules like L1
and/or L2 caches/SRAMs, an Interrupt Controller, an external memory controller,
a dedicated local power/sleep controller etc. The DSP processor cores in the
K3 SoCs is usually either a TMS320C66x CorePac processor or a TMS320C71x CorePac
processor.

DSP Device Node:
================
Each DSP Core sub-system is represented as a single DT node. Each node has a
number of required or optional properties that enable the OS running on the
host processor (Arm CorePac) to perform the device management of the remote
processor and to communicate with the remote processor.

Required properties:
--------------------
The following are the mandatory properties:

- compatible:		Should be one of the following,
			    "ti,j721e-c66-dsp" for C66x DSPs on K3 J721E SoCs
			    "ti,j721e-c71-dsp" for C71x DSPs on K3 J721E SoCs

- reg:			Should contain an entry for each value in 'reg-names'.
			Each entry should have the memory region's start address
			and the size of the region, the representation matching
			the parent node's '#address-cells' and '#size-cells' values.

- reg-names:		Should contain strings with the following names, each
			representing a specific internal memory region (if
			present), and should be defined in this order,
			     "l2sram", "l1pram", "l1dram"
			NOTE: C71x DSPs do not have a "l1pram" memory.

- ti,sci:		Should be a phandle to the TI-SCI System Controller node

- ti,sci-dev-id:	Should contain the TI-SCI device id corresponding to the
			DSP Core. Please refer to the corresponding System
			Controller documentation for valid values for the DSP
			cores.

- ti,sci-proc-ids:	Should contain 2 integer values. The first cell should
			contain the TI-SCI processor id for the DSP core device
			and the second cell should contain the TI-SCI host id to
			which the processor control ownership should be
			transferred to.

- resets:		Should contain the phandle to the reset controller node
			managing the resets for this device, and a reset
			specifier. Please refer to the following reset bindings
			for the reset argument specifier,
			Documentation/devicetree/bindings/reset/ti,sci-reset.txt

- firmware-name:	Should contain the name of the default firmware image
			file located on the firmware search path

- mboxes:		OMAP Mailbox specifier denoting the sub-mailbox, to be
			used for communication with the remote processor. The
			specifier format is as per the bindings,
			Documentation/devicetree/bindings/mailbox/omap-mailbox.txt
			This property should match with the sub-mailbox node
			used in the firmware image.

- memory-region:	phandle to the reserved memory nodes to be associated
			with the remoteproc device. There should be atleast two
			reserved memory nodes defined - the first one would be
			used for dynamic DMA allocations like vrings and vring
			buffers, and the remaining ones used for the firmware
			image sections. The reserved memory nodes should be
			carveout nodes, and should be defined as per the
			bindings in
			Documentation/devicetree/bindings/reserved-memory/reserved-memory.txt

Optional properties:
--------------------

- sram:			pHandle to a reserved on-chip SRAM region. The region
			should be defined as a child node of the respective
			SRAM node, and should be defined as per the generic
			bindings in,
			Documentation/devicetree/bindings/misc/sram.txt


Example:
---------

1. J721E SoC
	/* J721E remoteproc alias */
	aliases {
		rproc0 = &mcu_r5fss0_core0;
		rproc1 = &mcu_r5fss0_core1;
		rproc2 = &main_r5fss0_core0;
		rproc3 = &main_r5fss0_core1;
		rproc4 = &main_r5fss1_core0;
		rproc5 = &main_r5fss1_core1;
		rproc6 = &c66_0;
		rproc7 = &c66_1;
		rproc8 = &c71_0;
	};

	/* DSP Carveout reserved memory nodes */
	reserved-memory {
		#address-cells = <2>;
		#size-cells = <2>;
		ranges;

		c66_0_dma_memory_region: c66-dma-memory@a6000000 {
			compatible = "shared-dma-pool";
			reg = <0x00 0xa6000000 0x00 0x100000>;
			no-map;
		};

		c66_0_memory_region: c66-memory@a6100000 {
			compatible = "shared-dma-pool";
			reg = <0x00 0xa6100000 0x00 0xf00000>;
			no-map;
		};

		c71_0_dma_memory_region: c71-dma-memory@a8000000 {
			compatible = "shared-dma-pool";
			reg = <0x00 0xa8000000 0x00 0x100000>;
			no-map;
		};

		c71_0_memory_region: c71-memory@a8100000 {
			compatible = "shared-dma-pool";
			reg = <0x00 0xa8100000 0x00 0xf00000>;
			no-map;
		};
	};

	cbass_main: interconnect@100000 {
		compatible = "simple-bus";
		#address-cells = <2>;
		#size-cells = <2>;
		ranges = <0x00 0x64800000 0x00 0x64800000 0x00 0x00800000>, /* C71_0 */
			 <0x4d 0x80800000 0x4d 0x80800000 0x00 0x00800000>, /* C66_0 */
			 <0x4d 0x81800000 0x4d 0x81800000 0x00 0x00800000>; /* C66_1 */

		/* J721E C66_0 DSP node */
		c66_0: dsp@4d80800000 {
			compatible = "ti,j721e-c66-dsp";
			reg = <0x4d 0x80800000 0x00 0x00048000>,
			      <0x4d 0x80e00000 0x00 0x00008000>,
			      <0x4d 0x80f00000 0x00 0x00008000>;
			reg-names = "l2sram", "l1pram", "l1dram";
			ti,sci = <&dmsc>;
			ti,sci-dev-id = <142>;
			ti,sci-proc-ids = <0x03 0xFF>;
			resets = <&k3_reset 142 1>;
			firmware-name = "j7-c66_0-fw";
			memory-region = <&c66_0_dma_memory_region>,
					<&c66_0_memory_region>;
			mboxes = <&mailbox0_cluster3 &mbox_c66_0>;
		};

		/* J721E C71_0 DSP node */
		c71_0: dsp@64800000 {
			compatible = "ti,j721e-c71-dsp";
			reg = <0x00 0x64800000 0x00 0x00080000>,
			      <0x00 0x64e00000 0x00 0x0000c000>;
			reg-names = "l2sram", "l1dram";
			ti,sci = <&dmsc>;
			ti,sci-dev-id = <15>;
			ti,sci-proc-ids = <0x30 0xFF>;
			resets = <&k3_reset 15 1>;
			firmware-name = "j7-c71_0-fw";
			memory-region = <&c71_0_dma_memory_region>,
					<&c71_0_memory_region>;
			mboxes = <&mailbox0_cluster4 &mbox_c71_0>;
		};
	};
```
