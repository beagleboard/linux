## Documentation/devicetree/bindings/phy/am654-mmc-phy.txt
```
TI AM654 MMC PHY
-------------------

Required properties:
 - compatible: ti,am654-emmc-phy
 - #phy-cells: must be 0
 - reg: PHY registers address offset and size
 - clocks: must be phandle of the clock provider which is the host
	   controller
 - clock-names: must be "mmcclk"
 - ti,otap-del-sel: Output Tap Delay select.
 - ti,trm-icp: DLL trim select.
 - ti,driver-strength-ohm: driver strength in ohms.
			   Valid values are 33, 40, 50, 66, and 100 ohms.

Example:
			mmc_phy1: mmc_phy@10100 {
				compatible = "ti,am654-mmc-phy";
				reg = <0x10100 0x34>;
				clocks = <&sdhci1>;
				clock-names = "mmcclk";
				#phy-cells = <0>;
				ti,otap-del-sel = <0x2>;
				ti,trm-icp = <0x8>;
				status = "disabled";
			};

Host controller node:

			sdhci1: sdhci@0 {
				compatible = "ti,am654-sdhci-5.1";
				reg = <0x0 0x1000>;
				power-domains = <&k3_pds 48>;
				clocks = <&k3_clks 48 0>, <&k3_clks 48 1>;
				clock-names = "clk_ahb", "clk_xin";
				interrupts = <GIC_SPI 137 IRQ_TYPE_LEVEL_HIGH>;
				clock-output-names = "mmc_cardclck";
				#clock-cells = <0>;
				phys=<&mmc_phy1>;
				phy-names = "phy_arasan";
				status = "disabled";
			};
```

## Documentation/devicetree/bindings/phy/cdns,dphy.yaml
```yaml
# SPDX-License-Identifier: (GPL-2.0-only OR BSD-2-Clause)
%YAML 1.2
---
$id: http://devicetree.org/schemas/phy/cdns,dphy.yaml#
$schema: http://devicetree.org/meta-schemas/core.yaml#

title: Cadence DPHY Device Tree Bindings

maintainers:
  - Pratyush Yadav <p.yadav@ti.com>

properties:
  compatible:
    items:
      - const: cdns,dphy

  reg:
    maxItems: 1
    description: Physical base address and length of the DPHY registers.

  power-domains:
    maxItems: 1

  clocks:
    maxItems: 2
    description: DPHY reference clocks.

  clock-names:
    items:
      - const: psm
      - const: pll_ref

  "#address-cells":
    const: 2

  "#size-cells":
    const: 2

  "#phy-cells":
    const: 0

required:
  - compatible
  - reg
  - "#phy-cells"

additionalProperties: false

examples:
  - |

    dphy0: dphy@fd0e0000{
        compatible = "cdns,dphy";
        reg = <0x0 0xfd0e0000 0x0 0x1000>;
        clocks = <&psm_clk>, <&pll_ref_clk>;
        clock-names = "psm", "pll_ref";
        #phy-cells = <0>;
    };
```

## Documentation/devicetree/bindings/phy/ti,k2-serdes-phy.txt
```
TI Keystone SerDes PHY DT Documentation
---------------------------------------
Required properties:
 - compatible: should be one of
	* "ti,keystone-serdes-gbe"
	* "ti,keystone-serdes-pcie"
 - reg:
	* base address and length of the SerDes register set
 - num-lanes:
	* Number of lanes in SerDes.

Optional properties:
 - rx-force-enable:
	* Include this property if receiver attenuation and boost are
	  to be configured with specific values defined in rx-force.
 - link-rate-kbps:
	* SerDes link rate to be configured, in kbps.


For gbe SerDes, it is optional to represent each lane as a sub-node,
which can be enabled or disabled individually using the "status" property.
If a lane is not represented by a node, the lane is disabled.

Required properties (lane sub-node):
 - #phy-cells:
	* From the generic phy bindings, must be 0;
 - reg:
	* lane number

Optional properties (lane sub-node):
 - control-rate:
	* Lane control rate
		0: full rate
		1: half rate
		2: quarter rate
 - rx-start:
	* Initial lane rx equalizer attenuation and boost configurations.
	* Must be array of 2 integers.
 - rx-force:
	* Forced lane rx equalizer attenuation and boost configurations.
	* Must be array of 2 integers.
 - tx-coeff:
	* Lane c1, c2, cm, attenuation and regulator output voltage
	  configurations.
	* Must be array of 5 integers.
 - loopback:
	* Include this property to enable loopback at the SerDes
	  lane level.

Example for Keystone K2E GBE:
-----------------------------

gbe_serdes0: phy@232a000 {
	compatible		= "ti,keystone-serdes-gbe";
	reg			= <0x0232a000 0x2000>;
	link-rate-kbps		= <1250000>;
	num-lanes		= <4>;
	#address-cells = <1>;
	#size-cells = <0>;

	serdes0_lane0: lane@0 {
		status		= "ok";
		#phy-cells	= <0>;
		reg		= <0>;
		control-rate	= <2>;
		rx-start	= <7 5>;
		rx-force	= <1 1>;
		tx-coeff	= <0 0 0 12 4>;
	};
	serdes0_lane1: lane@1 {
		status		= "ok";
		#phy-cells	= <0>;
		reg		= <1>;
		control-rate	= <2>;
		rx-start	= <7 5>;
		rx-force	= <1 1>;
		tx-coeff	= <0 0 0 12 4>;
	};
	serdes0_lane2: lane@2 {
		status		= "disabled";
		#phy-cells	= <0>;
		reg		= <2>;
		control-rate	= <2>;
		rx-start	= <7 5>;
		rx-force	= <1 1>;
		tx-coeff	= <0 0 0 12 4>;
	};
	serdes0_lane3: lane@3 {
		status		= "disabled";
		#phy-cells	= <0>;
		reg		= <3>;
		control-rate	= <2>;
		rx-start	= <7 5>;
		rx-force	= <1 1>;
		tx-coeff	= <0 0 0 12 4>;
	};
};

gbe_serdes1: phy@2324000 {
	compatible		= "ti,keystone-serdes-gbe";
	reg			= <0x02324000 0x2000>;
	link-rate-kbps		= <1250000>;
	num-lanes		= <4>;
	#address-cells = <1>;
	#size-cells = <0>;

	serdes1_lane0: lane@0 {
		status		= "disabled";
		#phy-cells	= <0>;
		reg		= <0>;
		control-rate	= <2>;
		rx-start	= <7 5>;
		rx-force	= <1 1>;
		tx-coeff	= <0 0 0 12 4>;
	};
	serdes1_lane1: lane@1 {
		status		= "disabled";
		#phy-cells	= <0>;
		reg		= <1>;
		control-rate	= <2>;
		rx-start	= <7 5>;
		rx-force	= <1 1>;
		tx-coeff	= <0 0 0 12 4>;
	};
	serdes1_lane2: lane@2 {
		status		= "disabled";
		#phy-cells	= <0>;
		reg		= <2>;
		control-rate	= <2>;
		rx-start	= <7 5>;
		rx-force	= <1 1>;
		tx-coeff	= <0 0 0 12 4>;
	};
	serdes1_lane3: lane@3 {
		status		= "disabled";
		#phy-cells	= <0>;
		reg		= <3>;
		control-rate	= <2>;
		rx-start	= <7 5>;
		rx-force	= <1 1>;
		tx-coeff	= <0 0 0 12 4>;
	};
};

netcp: netcp@24000000 {
	...

	netcp-devices {
		...

		gbe@200000 {
			...

			gbe0: interface-0 {
				phys = <&serdes0_lane0>;
				...
			};
			gbe1: interface-1 {
				phys = <&serdes0_lane1>;
				...
			};

			...
		};

		...
	};
};

Example for Keystone PCIE:
--------------------------

	pcie0_phy: phy@2320000 {
		compatible = "ti,keystone-serdes-pcie";
		reg = <0x02320000 0x4000>;
		link-rate-kbps = <5000000>;
		num-lanes = <2>;
	};

No SerDes phy handle needed in PCIe controller node
since the SerDes PHY provider driver performs all
the configurations needed for PCIe.
```

## Documentation/devicetree/bindings/phy/ti,omap-usb2.yaml
```yaml
# SPDX-License-Identifier: (GPL-2.0-only OR BSD-2-Clause)
%YAML 1.2
---
$id: http://devicetree.org/schemas/phy/ti,omap-usb2.yaml#
$schema: http://devicetree.org/meta-schemas/core.yaml#

title: OMAP USB2 PHY

maintainers:
 - Kishon Vijay Abraham I <kishon@ti.com>
 - Roger Quadros <rogerq@ti.com>

properties:
  compatible:
    anyOf:
      - items:
        - enum:
          - "ti,dra7x-usb2"
          - "ti,dra7x-usb2-phy2"
          - "ti,am654-usb2"
        - enum:
          - "ti,omap-usb2"

  reg:
    maxItems: 1
    description: address and length of the register set for the device.

  '#phy-cells':
    description:
      Number of cells in a PHY specifier.  The meaning of all those
      cells is defined by the binding for the phy node. The PHY
      provider can use the values in cells to find the appropriate PHY.
    $ref: /schemas/types.yaml#/definitions/uint32

  clocks:
    minItems: 1
    items:
      - description: wakeup clock
      - description: reference clock

  clock-names:
    minItems: 1
    items:
      - const: "wkupclk"
      - const: "refclk"

  syscon-phy-power:
    description:
      phandle/offset pair. Phandle to the system control module
      register offset to power on/off the PHY.

  ctrl-module:
    description:
      (deprecated) phandle of the control module used by PHY driver
      to power on the PHY. Use syscon-phy-power instead.

required:
  - compatible
  - reg
  - '#phy-cells'
  - clocks
  - clock-names

examples:
  - |
    usb0_phy: phy@4100000 {
      compatible = "ti,am654-usb2", "ti,omap-usb2";
      reg = <0x0 0x4100000 0x0 0x54>;
      syscon-phy-power = <&scm_conf 0x4000>;
      clocks = <&k3_clks 151 0>, <&k3_clks 151 1>;
      clock-names = "wkupclk", "refclk";
      #phy-cells = <0>;
    };
```

## Documentation/devicetree/bindings/phy/ti,phy-gmii-sel.yaml
```yaml
# SPDX-License-Identifier: (GPL-2.0-only OR BSD-2-Clause)
# Copyright (C) 2020 Texas Instruments Incorporated - http://www.ti.com/
%YAML 1.2
---
$id: "http://devicetree.org/schemas/phy/ti,phy-gmii-sel.yaml#"
$schema: "http://devicetree.org/meta-schemas/core.yaml#"

title: CPSW Port's Interface Mode Selection PHY Tree Bindings

maintainers:
  - Kishon Vijay Abraham I <kishon@ti.com>

description: |
  TI am335x/am437x/dra7(am5)/dm814x CPSW3G Ethernet Subsystem supports
  two 10/100/1000 Ethernet ports with selectable G/MII, RMII, and RGMII interfaces.
  The interface mode is selected by configuring the MII mode selection register(s)
  (GMII_SEL) in the System Control Module chapter (SCM). GMII_SEL register(s) and
  bit fields placement in SCM are different between SoCs while fields meaning
  is the same.
                                               +--------------+
        +-------------------------------+      |SCM           |
        |                     CPSW      |      |  +---------+ |
        |        +--------------------------------+gmii_sel | |
        |        |                      |      |  +---------+ |
        |   +----v---+     +--------+   |      +--------------+
        |   |Port 1..<--+-->GMII/MII<------->
        |   |        |  |  |        |   |
        |   +--------+  |  +--------+   |
        |               |               |
        |               |  +--------+   |
        |               |  | RMII   <------->
        |               +-->        |   |
        |               |  +--------+   |
        |               |               |
        |               |  +--------+   |
        |               |  | RGMII  <------->
        |               +-->        |   |
        |                  +--------+   |
        +-------------------------------+

  CPSW Port's Interface Mode Selection PHY describes MII interface mode between
  CPSW Port and Ethernet PHY which depends on Eth PHY and board configuration.
  |
  CPSW Port's Interface Mode Selection PHY device should defined as child device
  of SCM node (scm_conf) and can be attached to each CPSW port node using standard
  PHY bindings.

properties:
  compatible:
    enum:
      - ti,am3352-phy-gmii-sel
      - ti,dra7xx-phy-gmii-sel
      - ti,am43xx-phy-gmii-sel
      - ti,dm814-phy-gmii-sel
      - ti,am654-phy-gmii-sel
      - ti,j7200-cpsw5g-phy-gmii-sel
      - ti,j721e-cpsw9g-phy-gmii-sel
      - ti,j784s4-cpsw9g-phy-gmii-sel

  reg:
    description: Address and length of the register set for the device

  '#phy-cells': true

  ti,qsgmii-main-ports:
    $ref: /schemas/types.yaml#/definitions/uint32-array
    description: |
      Required only for QSGMII mode. Array to select the port for
      QSGMII main mode. Rest of the ports are selected as QSGMII_SUB
      ports automatically. For J7200 CPSW5G with the compatible:
      ti,j7200-cpsw5g-phy-gmii-sel, ti,qsgmii-main-ports is an
      array of only one element, which is the port number ranging
      from 1 to 4. For J721E CPSW9G with the compatible:
      ti,j721e-cpsw9g-phy-gmii-sel, and
      For J784S4 CPSW9G with the compatible:
      ti,j784s4-cpsw9g-phy-gmii-sel, ti,qsgmii-main-ports is an
      array of two elements, which corresponds to two pairs of
      4 ports each. The first element and second element of the
      array both range from 1 to 4 each. However, for the second
      element, the values 1 to 4 map to the ports 5 to 8. Thus,
      it is possible to specify which port among the two different
      sets of 4 ports is the QSGMII main port. For example:
      ti,qsgmii-main-ports = <2>, <1>;
      would mean that of the 8 CPSW9G ports, ports 2 and 5 are the
      main ports for the two sets of QSGMII interfaces formend by
      ports 1-4 and ports 5-8. Both elements need to be filled
      if the property is being used. For example, if the first set of
      4 ports are configured for RGMII and the second set of 4 ports
      are configured for QSGMII with port 7 being the main port, then:
      ti,qsgmii-main-ports = <1>, <3>;
      is the correct value for this configuration. It does not matter
      what the first element's value is, but a valid value must be
      filled even if any of the first 4 ports are not being used in
      QSGMII mode.

allOf:
  - if:
      properties:
        compatible:
          contains:
            enum:
              - ti,dra7xx-phy-gmii-sel
              - ti,dm814-phy-gmii-sel
              - ti,am654-phy-gmii-sel
    then:
      properties:
        '#phy-cells':
          const: 1
          description: CPSW port number (starting from 1)
  - if:
      properties:
        compatible:
          contains:
            enum:
              - ti,j7200-cpsw5g-phy-gmii-sel
    then:
      properties:
        '#phy-cells':
          const: 1
          description: CPSW port number (starting from 1)
        ti,qsgmii-main-ports:
          maxItems: 1
          items:
            minimum: 1
            maximum: 4
  - if:
      properties:
        compatible:
          contains:
            enum:
              - ti,j721e-cpsw9g-phy-gmii-sel
              - ti,j784s4-cpsw9g-phy-gmii-sel
    then:
      properties:
        '#phy-cells':
          const: 1
          description: CPSW port number (starting from 1)
        ti,qsgmii-main-ports:
          maxItems: 2
          items:
            minimum: 1
            maximum: 4
  - if:
      properties:
        compatible:
          contains:
            enum:
              - ti,am3352-phy-gmii-sel
              - ti,am43xx-phy-gmii-sel
    then:
      properties:
        '#phy-cells':
          const: 2
          description: |
            - CPSW port number (starting from 1)
            - RMII refclk mode

required:
  - compatible
  - reg
  - '#phy-cells'

additionalProperties: false

examples:
  - |
    phy_gmii_sel: phy@650 {
        compatible = "ti,am3352-phy-gmii-sel";
        reg = <0x650 0x4>;
        #phy-cells = <2>;
    };
```
