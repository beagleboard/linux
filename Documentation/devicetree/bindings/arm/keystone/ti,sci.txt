## Documentation/devicetree/bindings/arm/keystone/ti,sci.txt
```
Texas Instruments System Control Interface (TI-SCI) Message Protocol
-------------------------------------------------------------------

Texas Instrument's processors including those belonging to Keystone generation
of processors have separate hardware entity which is now responsible for the
management of the System on Chip (SoC) system. These include various system
level functions as well.

TI-SCI controller Device Node:
=============================

Required properties:
--------------------
- compatible: should be "ti,k2g-sci"
- mbox-names:
	"rx" - Mailbox corresponding to receive path
	"tx" - Mailbox corresponding to transmit path

- mboxes: Mailboxes corresponding to the mbox-names. Each value of the mboxes
	  property should contain a phandle to the mailbox controller device
	  node and an args specifier that will be the phandle to the intended
	  sub-mailbox child node to be used for communication.

See Documentation/devicetree/bindings/mailbox/mailbox.txt for more details
about the generic mailbox controller and client driver bindings. Also see
Documentation/devicetree/bindings/mailbox/ti,message-manager.txt for typical
controller that is used to communicate with this System controllers.

Optional Properties:
--------------------
- reg-names:
	debug_messages - Map the Debug message region
- reg:  register space corresponding to the debug_messages
- ti,system-reboot-controller: If system reboot can be triggered by SoC reboot

Example (K2G):
--------
	pmmc: pmmc {
		compatible = "ti,k2g-sci";
		mbox-names = "rx", "tx";
		mboxes= <&msgmgr &msgmgr_proxy_pmmc_rx>,
			<&msgmgr &msgmgr_proxy_pmmc_tx>;
		reg-names = "debug_messages";
		reg = <0x02921800 0x800>;
	};


TI-SCI Client Device Node:
========================

Client nodes refer to the required TI-SCI device using the "ti,sci" property.

Example (K2G):
-------------
	my_dev_node: dev_node {
		...
		ti,sci = <&pmmc>;
		...
	}
```

## Documentation/devicetree/bindings/arm/omap/amx3xx-pm.txt
```
AM335x Power Management bindings

Support for VTT Toggle

In order to enable the support for VTT toggle during Suspend/Resume
sequence needed by some boards (like AM335x EVM-SK & AM437x GP EVM),
the below DT properties are required. It is possible to toggle VTT
using one of two methods depending on the SoC being used, either
GPIO0 toggle (AM335x and AM437x), or any GPIO with DS_PAD_CONFIG
bits in the control module (AM437x only).

VTT Toggle using GPIO0
==================================
Supported by: AM335x and AM437x
Used on: AM335x EVM-SK

Required properties:
- compatible:		For AM335x: ti,am3353-wkup-m3
			For AM437x: ti,am4372-wkup-m3
- ti,needs-vtt-toggle:	Indicates that the boards requires VTT toggling
			during suspend/resume.
- ti,vtt-gpio-pin:	Specifies the GPIO0 pin used for VTT toggle.

Important Note:
- Here it is assumed that VTT Toggle will be done using a pin on GPIO-0 Instance.
  It will not work on any other GPIO using the above properties, regardless of
  which part is being used.

Example:
	wkup_m3: wkup_m3@44d00000 {
		compatible = "ti,am3353-wkup-m3";
		...
		...
		ti,needs-vtt-toggle;
		ti,vtt-gpio-pin = <7>;
	};

VTT Toggle using any GPIO
==================================
Supported by: AM437x ONLY
Used on: AM437x GP EVM

Many of the pins on AM437x have the ability to configure both normal and
sleep states. Because of this it is possible to use any pin with a
corresponding CTRL_CONF_* register in the control module and the
DS_PAD_CONFIG bits to toggle the VTT regulator enable pin. The DS state of
the pin must be configured such that the pin disables the VTT regulator. The
normal state of the pin must be configured such that the VTT regulator is
enabled by the state alone. This is because the VTT regulator must be enabled
before context is restored to the controlling GPIO.

Required properties:
- ti,set-io-isolation:	Indicates that the IO's should be placed into
			isolation and the DS_PAD_CONFIG values should be
			used during suspend.

Example:

On the AM437x GP EVM, the VTT enable line must be held low to disable VTT
regulator and held high to enable, so the following pinctrl entry is used.
The DS pull is enabled which uses a pull down by default and DS off mode is
used which outputs a low by default. For the normal state, a pull up is
specified so that the VTT enable line gets pulled high immediately after
the DS states are removed upon exit from DeepSleep0.

&am43xx_pinmux {
	pinctrl-names = "default";
	pinctrl-0 = <&ddr3_vtt_toggle_default>;

	ddr3_vtt_toggle_default: ddr_vtt_toggle_default {
        pinctrl-single,pins = <
                0x25C (DS0_PULL_UP_DOWN_EN | PIN_OUTPUT_PULLUP | DS0_FORCE_OFF_MODE | MUX_MODE7)
		>;
	};
	...
};

wkup_m3: wkup_m3@44d00000 {
	compatible = "ti,am3353-wkup-m3";
	...
	ti,set-io-isolation;
};

Support for I2C PMIC Voltage Scaling
==================================
It is possible to pass the name of a binary file to laod to the CM3 firmware
in order to provide I2C sequences for the CM3 to send out to the PMIC during
low power mode entry.

Optional Properties:
-scale-data-fw:	Name of the firmware binary in /lib/firmware to copy to m3
		aux data.
```

## Documentation/devicetree/bindings/arm/omap/dma-crossbar.txt
```
Some socs have a crossbar ip which muxes the dma requests
from the peripherals to the dma request input lines of the
appropriate dma controller. With this the dma controller's
available request lines are shared between the peripherals

Required properties:
- compatible : Should be "ti,dma-crossbar"
- reg: Base address and the size of the crossbar registers.
- ti,dma-reqs: Total number of dma request lines available at dma controller.
- ti,reg-size: Size of a individual register in bytes. Every individual
	    register is assumed to be of same size. Valid sizes are 1, 2, 4.
- ti,dmas-reserved: List of the reserved dma lines that are not muxed using
		 crossbar. These dma lines are reserved in the soc,
		 so crossbar bar driver should not consider them as free
		 lines. This is a table of dma request-number and a count of
		 reserved values from that number.

Optional properties:
- ti,dma-safe-map: integer which maps to a safe configuration to use
  when the dma request line is unused (when not provided, default is 0)

Examples:
		crossbar_dma: crossbar@4a020000 {
			compatible = "ti,dma-crossbar";
			reg = <0x4a002b78 0x100>;
			ti,dma-reqs = <160>;
			ti,reg-size = <2>;
			ti,dmas-reserved = < 2, 5,
					     10, 2 >;
		};

Consumer:
=========
See Documentation/devicetree/bindings/dma/dma.txt for further details.

A dma request line consumer on an SoC using dma crossbar will use:
	dmas = <&dma-controller-node crossbar_req_no  &dma-crossbar-node>
Crossbar no should be in between 0 to that described by "ti,dma-reqs".

Example:
	device_x@4809c000 {
		...
		/*
		 * sdma is p-handle to dma controller node.
		 * dmacb is p-handle to dma crossbar node.
		 * Crossbar 61, 62 are used for tx, rx respectively.
		 */
		dmas = <&sdma 61 &dmacb>, <&sdma 62 &dmacb>;
		dma-names = "tx", "rx";
		...
	};
```

## Documentation/devicetree/bindings/arm/omap/prcm.txt
```
TI Power Reset Clock Manager (PRCM)

Properties:
- compatible:	"ti,am4372-prcm" for prcm in am43x SoC's
		"ti,am3352-prcm" for prcm in am335x SoC's
- #reset-cells: 1 (refer generic reset bindings for details)

example:
	prcm: prcm@44df0000 {
		compatible = "ti,am4372-prcm";
		reg = <0x44df0000 0xa000>;
		#reset-cells = <1>;
	};
```

## Documentation/devicetree/bindings/arm/ti/k3.txt
```
Texas Instruments K3 Multicore SoC architecture device tree bindings
--------------------------------------------------------------------

Boards based on K3 Multicore SoC architecture shall have the following property:
- compatible: Every hardware block introduced in K3 Multicore SoC
  architecture shall be of the form:
  "ti,XXX-YYY", where:
     'XXX' represents the specific SoC part for which the support is added.
     'YYY' represents the corresponding peripheral in SoC being supported.

  NOTE: Generic devices such as GIC or legacy devices shall use the specified
  compatible for those devices.

  Example:
    compatible = "ti,am654-i2c";

SoCs
-------------------------------------------

Each device tree root node must specify which exact SoC in K3 Multicore SoC
architecture it uses, using one of the following compatible values:

- AM654
  compatible = "ti,am654";

Boards
-------------------------------------------

In addition, each device tree root node must specify which one or more
of the following board-specific compatible values:

- AM654 EVM
  compatible = "ti,am654-evm", "ti,am654";
```

## Documentation/devicetree/bindings/arm/ti/k3.yaml
```yaml
# SPDX-License-Identifier: (GPL-2.0 OR BSD-2-Clause)
%YAML 1.2
---
$id: http://devicetree.org/schemas/arm/ti/k3.yaml#
$schema: http://devicetree.org/meta-schemas/core.yaml#

title: Texas Instruments K3 Multicore SoC architecture device tree bindings

maintainers:
  - Nishanth Menon <nm@ti.com>

description: |
  Platforms based on Texas Instruments K3 Multicore SoC architecture
  shall have the following properties.

properties:
  $nodename:
    const: '/'
  compatible:
    oneOf:

      - description: K3 AM654 SoC
        items:
          - enum:
              - ti,am654-evm
          - const: ti,am654

      - description: K3 J721E SoC
        items:
          - enum:
              - ti,j721e-eaik
          - const: ti,j721e

      - description: K3 J7200 SoC
        items:
          - const: ti,j7200

      - description: K3 AM625 SoC
        items:
          - enum:
              - ti,am625-sk
          - const: ti,am625

      - description: K3 AM62A7 SoC
        items:
          - enum:
              - ti,am62a7-sk
          - const: ti,am62a7

      - description: K3 AM642 SoC
        items:
          - enum:
              - ti,am642-evm
              - ti,am642-sk
          - const: ti,am642

      - description: K3 J721s2 SoC
        items:
          - enum:
              - ti,am68-sk
              - ti,j721s2-evm
          - const: ti,j721s2

      - description: K3 J784s4 SoC
        items:
          - enum:
              - ti,am69-sk
              - ti,j784s4-evm
          - const: ti,j784s4

additionalProperties: true

...
```

## Documentation/devicetree/bindings/clock/ti,am654-ehrpwm-tbclk.yaml
```yaml
# SPDX-License-Identifier: (GPL-2.0-only OR BSD-2-Clause)
%YAML 1.2
---
$id: http://devicetree.org/schemas/clock/ti,am654-ehrpwm-tbclk.yaml#
$schema: http://devicetree.org/meta-schemas/core.yaml#

title: TI syscon gate clock driver

maintainers:
  - Vignesh Raghavendra <vigneshr@ti.com>

description: |

  This binding uses common clock bindings
  Documentation/devicetree/bindings/clock/clock-bindings.txt

properties:
  compatible:
    items:
      - const: ti,am654-ehrpwm-tbclk

  "#clock-cells":
    const: 1

  ti,tbclk-syscon:
    $ref: /schemas/types.yaml#/definitions/phandle
    description:
      Phandle to the system controller node that has bits to
      control eHRPWM's TBCLK

required:
  - compatible
  - "#clock-cells"
  - ti,tbclk-syscon

examples:
  - |
    tbclk_ctrl: tbclk_ctrl@4140 {
        compatible = "syscon";
        reg = <0x4140 0x18>;
    };

    ehrpwm_tbclk: clk0 {
        compatible = "ti,am654-ehrpwm-tbclk";
        #clock-cells = <1>;
        ti,tbclk-syscon = <&tbclk_ctrl>;
    };
```

## Documentation/devicetree/bindings/clock/ti,sci-clk.txt
```
Texas Instruments TI-SCI Clocks

All clocks on Texas Instruments' SoCs that contain a System Controller
core, are only controlled by this entity. Communication between a
host processor running an OS and the System Controller happens through a
protocol known as TI SCI. This clock implementation plugs into the
common clock framework and makes use of the TI SCI protocol on clock
API requests.

Required properties:
- compatible: Must be "ti,sci-clk"
- #clock-cells: Shall be 2.
  In clock consumers, this cell represents the device ID and clock ID
  exposed by the PM firmware. The assignments can be found in the header
  files <dt-bindings/genpd/<soc>.h> (which covers the device IDs) and
  <dt-bindings/clock/<soc>.h> (which covers the clock IDs), where <soc>
  is the SoC involved, for example 'k2g'.
- ti,sci: Phandle to the TI SCI device to use for managing the clocks

Optional properties:
- ti,ssc-clocks: Array of phandle clocks that shall enable spread spectrum
		 clocking while enabled
- ti,allow-freq-change-clocks: Array of phandle clocks that shall allow
			       dynamic clock frequency changes by firmware
- ti,input-term-clocks: Array of phandle clocks that shall enable input
			termination

Examples:

k2g_clks: k2g_clks {
	compatible = "ti,sci-clk";
	ti,sci = <&pmmc>;
	#clock-cells = <2>;
};

dummy_node@1234 {
	clocks = <&k2g_clks K2G_DEV_DUMMY K2G_DEV_DUMMY_FCK>;
};

dummy_node2@2345 {
	clocks = <&k2g_clks K2G_DEV_DUMMY2 K2G_DEV_DUMMY_X1_CLK>;
};

&k2g_clks {
	ti,ssc-clocks = <&k2g_clks K2G_DEV_DUMMY K2G_DEV_DUMMY_FCK>;
};
```

## Documentation/devicetree/bindings/clock/ti,syscon-gate-clock.txt
```
TI syscon gate clock driver

The gate clock node must be provided inside a system controller node.

Required:
- comaptible: Must be "ti,am654-ehrpwm-tbclk" for EHRPWM tbclk on AM654 SoC
- #clock-cells: must be <1>. It represents the index of clk instance
  within the syscon regmap. Index starts from 0.

Example:
	ctrlmmr_epwm_ctrl: syscon@104140 {
		compatible = "syscon", "simple-mfd";
		reg = <0x0 0x104140 0x0 0x18>;
		ranges = <0x0 0x0 0x104140 0x18>;
		#address-cells = <1>;
		#size-cells = <1>;

		ehrpwm_tbclk: clk@0 {
			compatible = "ti,am654-ehrpwm-tbclk";
			#clock-cells = <1>;
		};
	};

	ehrpwm0: pwm@3000000 {
		compatible = "ti,am654-ehrpwm", "ti,am3352-ehrpwm";
		#pwm-cells = <3>;
		reg = <0x0 0x3000000 0x0 0x100>;
		power-domains = <&k3_pds 40>;
		clocks = <&ehrpwm_tbclk 0>;
		clock-names = "tbclk";
	};
```

## Documentation/devicetree/bindings/counter/ti-eqep.yaml
```yaml
# SPDX-License-Identifier: GPL-2.0
%YAML 1.2
---
$id: http://devicetree.org/schemas/counter/ti-eqep.yaml#
$schema: http://devicetree.org/meta-schemas/core.yaml#

title: Texas Instruments Enhanced Quadrature Encoder Pulse (eQEP) Module

maintainers:
  - David Lechner <david@lechnology.com>

properties:
  compatible:
    enum:
      - ti,am3352-eqep
      - ti,am62-eqep

  reg:
    maxItems: 1

  interrupts:
    description: The eQEP event interrupt
    maxItems: 1

  clocks:
    description: The functional and interface clock that determines the clock
      rate for the eQEP peripheral.
    maxItems: 1

  clock-names:
    const: sysclkout

  power-domains:
    maxItems: 1

allOf:
  - if:
      properties:
        compatible:
          contains:
            enum:
              - ti,am62-eqep
    then:
      properties:
        clock-names: false

      required:
        - power-domains

required:
  - compatible
  - reg
  - interrupts
  - clocks

additionalProperties: false

examples:
  - |
    eqep0: counter@180 {
        compatible = "ti,am3352-eqep";
        reg = <0x180 0x80>;
        clocks = <&l4ls_gclk>;
        interrupts = <79>;
    };

  - |
    #include <dt-bindings/interrupt-controller/irq.h>
    #include <dt-bindings/interrupt-controller/arm-gic.h>
    #include <dt-bindings/soc/ti,sci_pm_domain.h>

    bus {
        #address-cells = <2>;
        #size-cells = <2>;
        eqep1: counter@23210000 {
          compatible = "ti,am62-eqep";
          reg = <0x00 0x23210000 0x00 0x100>;
          power-domains = <&k3_pds 60 TI_SCI_PD_EXCLUSIVE>;
          clocks = <&k3_clks 60 0>;
          interrupts = <GIC_SPI 117 IRQ_TYPE_EDGE_RISING>;
          status = "disabled";
        };
    };
...
```
