## Documentation/devicetree/bindings/cpufreq/ti-cpufreq.txt
```
Bindings for TI's CPUFreq driver
================================

The ti-cpufreq driver works with the operating-points-v2 binding described
at [../opp/opp.txt] to make sure the proper OPPs for a platform get enabled
and then creates a "cpufreq-dt" platform device to leverage the cpufreq-dt
driver described in [cpufreq-dt.txt].

The ti-cpufreq driver uses the revision and an efuse value from an SoC to
provide the OPP framework with supported hardware information that is used
to determine which OPPs from the operating-points-v2 table get enabled. If
this information is not provided the driver simply skips providing it
but still creates the "cpufreq-dt" platform device, and if a different
operating-points table has been provided the system will use that and
function as normal, otherwise it is likely no OPPs will be available due
to the system being unable to determine safe values.

Required properties:
--------------------
In 'cpus' nodes:
- operating-points-v2: Phandle to the operating-points-v2 table to use
- ti,syscon-efuse: Syscon phandle, offset to efuse register, efuse register
		   mask, and efuse register shift to get the relevant bits
		   that describe OPP availability
- ti,syscon-rev: Syscon and offset used to look up revision value on SoC

In 'operating-points-v2' table:
- opp-supported-hw: Two bitfields indicating:
	1. Which revision of the SoC the OPP is supported by
	2. Which eFuse bits indicate this OPP is available

	A bitwise and is performed against these values and if any bit
	matches, the OPP gets enabled.

NOTE: Without the above, platform-device for "cpufreq-dt" is still created
      but no determination of which OPPs should be available is done, but this
      allows for use of a v1 operating-points table or operating-points-v2
      with no opp-supported-hw values set.

Example:
--------

/* From arch/arm/boot/dts/am4372.dtsi */
cpus {
	cpu: cpu@0 {
		...

		operating-points-v2 = <&cpu0_opp_table>;

		ti,syscon-efuse = <&scm_conf 0x610 0x3f 0>;
		ti,syscon-rev = <&scm_conf 0x600>;

		...
	};
};

cpu0_opp_table: opp_table0 {
	compatible = "operating-points-v2";
	opp50@300000000 {
		opp-hz = /bits/ 64 <300000000>;
		opp-microvolt = <950000>;
		opp-supported-hw = <0xFF 0x01>;
		opp-suspend;
	};

	opp100@600000000 {
		opp-hz = /bits/ 64 <600000000>;
		opp-microvolt = <1100000>;
		opp-supported-hw = <0xFF 0x04>;
	};

	opp120@720000000 {
		opp-hz = /bits/ 64 <720000000>;
		opp-microvolt = <1200000>;
		opp-supported-hw = <0xFF 0x08>;
	};

	oppturbo@800000000 {
		opp-hz = /bits/ 64 <800000000>;
		opp-microvolt = <1260000>;
		opp-supported-hw = <0xFF 0x10>;
	};

	oppnitro@1000000000 {
		opp-hz = /bits/ 64 <1000000000>;
		opp-microvolt = <1325000>;
		opp-supported-hw = <0xFF 0x20>;
	};
};
```

## Documentation/devicetree/bindings/crypto/omap-aes.txt
```
OMAP SoC AES crypto Module

Required properties:

- compatible : Should contain entries for this and backward compatible
  AES versions:
  - "ti,omap2-aes" for OMAP2.
  - "ti,omap3-aes" for OMAP3.
  - "ti,omap4-aes" for OMAP4 and AM33XX.
  Note that the OMAP2 and 3 versions are compatible (OMAP3 supports
  more algorithms) but they are incompatible with OMAP4.
- ti,hwmods: Name of the hwmod associated with the AES odule
- reg : Offset and length of the register set for the module
- interrupt-parent : the phandle for the interrupt controller that
  services interrupts for this module.
- interrupts : the interrupt number for the AES odule.

Optional properties:
- dmas: DMA controller phandle and DMA request ordered pairs.
- dma-names: DMA request names. This string corresponds 1:1 with
	the ordered pairs in dmas. The string naming is to be
	"tx" for TX request and "rx" for RX request.

Example:
	/* AM335x */
	aes: aes@53500000 {
		compatible = "ti,omap4-aes";
		ti,hwmods = "aes";
		#address-cells = <1>;
		#size-cells = <0>;
		reg = <0x53500000 0xa0>;
		interrupt-parent = <&intc>;
		interrupts = <102>;
		dmas = <&edma 6
			&edma 5>;
		dma-names = "tx", "rx";
	};
```

## Documentation/devicetree/bindings/crypto/omap-sham.txt
```
OMAP SoC SHA crypto Module

Required properties:

- compatible : Should contain entries for this and backward compatible
  SHAM versions:
  - "ti,omap2-sham" for OMAP2 & OMAP3.
  - "ti,omap4-sham" for OMAP4 and AM33XX.
  Note that these two versions are incompatible.
- ti,hwmods: Name of the hwmod associated with the SHAM module
- reg : Offset and length of the register set for the module
- interrupt-parent : the phandle for the interrupt controller that
  services interrupts for this module.
- interrupts : the interrupt number for the SHAM module.

Optional properties:
- dmas: DMA controller phandle and DMA request ordered pair.
	Only one rx pair is valid per SHAM module.
- dma-names: DMA request name. This string corresponds 1:1 with
	the ordered pair in dmas. The string naming is to be
	"rx" for RX request.

Example:
	/* AM335x */
	sham: sham@53100000 {
		compatible = "ti,omap4-sham";
		ti,hwmods = "sham";
		#address-cells = <1>;
		#size-cells = <0>;
		reg = <0x53100000 0x200>;
		interrupt-parent = <&intc>;
		interrupts = <109>;
		dmas = <&edma 36>;
		dma-names = "rx";
	};
```

## Documentation/devicetree/bindings/crypto/sa2ul.txt
```
K3 SoC SA2UL crypto module

Required properties:

- compatible : Should be:
  - "ti,sa2ul-crypto"
- reg : Offset and length of the register set for the module

- dmas: DMA specifiers for tx and rx dma. sa2ul needs one tx channel
	and 2 rx channels. First rx channel for < 256 bytes and
	the other one for >=256 bytes. See the DMA client binding,
        Documentation/devicetree/bindings/dma/dma.txt
- dma-names: DMA request names has to have one tx and 2 rx names
	corresponding to dmas abive.

Example AM654 SA2UL:
crypto: crypto@4E00000 {
	compatible = "ti,sa2ul-crypto";
	reg = <0x0 0x4E00000 0x0 0x1200>;

	dma-names = "tx", "rx1", "rx2";
	dmas = <&main_udmap 0xc000>, <&main_udmap 0x4000>,
			<&main_udmap 0x4001>;
};
```

## Documentation/devicetree/bindings/crypto/ti,mcrc.yaml
```yaml
# SPDX-License-Identifier: (GPL-2.0-only OR BSD-2-Clause)
%YAML 1.2
---
$id: http://devicetree.org/schemas/crypto/ti,mcrc.yaml#
$schema: http://devicetree.org/meta-schemas/core.yaml#

title: Texas Instruments MCRC bindings

maintainers:
  - Kamlesh Gurudasani  <kamlesh@ti.com>

properties:
  compatible:
    const: ti,mcrc

  reg:
    maxItems: 1

  clocks:
    maxItems: 1

  power-domains:
    maxItems: 1

required:
  - compatible
  - reg
  - clocks
  - power-domains

additionalProperties: false

examples:
  - |
    mcrc: mcrc@30300000 {
      compatible = "ti,mcrc";
      reg = <0x00 0x30300000 0x00 0x1000>;
      clocks = <&k3_clks 116 0>;
      power-domains = <&k3_pds 116 TI_SCI_PD_EXCLUSIVE>;
      };

...
```

## Documentation/devicetree/bindings/crypto/ti,mcrc64.yaml
```yaml
# SPDX-License-Identifier: (GPL-2.0-only OR BSD-2-Clause)
%YAML 1.2
---
$id: http://devicetree.org/schemas/crypto/ti,mcrc64.yaml#
$schema: http://devicetree.org/meta-schemas/core.yaml#

title: Texas Instruments MCRC64

description:
  The MCRC64 engine calculates 64-bit cyclic redundancy checks
  (CRC) according to the ISO 3309 standard.

maintainers:
  - Kamlesh Gurudasani <kamlesh@ti.com>

properties:
  compatible:
    const: ti,am62-mcrc64

  reg:
    maxItems: 1

  clocks:
    maxItems: 1

  power-domains:
    maxItems: 1

required:
  - compatible
  - reg
  - clocks
  - power-domains

additionalProperties: false

examples:
  - |
    #include <dt-bindings/soc/ti,sci_pm_domain.h>

    crc@30300000 {
      compatible = "ti,am62-mcrc64";
      reg = <0x30300000 0x1000>;
      clocks = <&k3_clks 116 0>;
      power-domains = <&k3_pds 116 TI_SCI_PD_EXCLUSIVE>;
    };

...
```

## Documentation/devicetree/bindings/display/bridge/cdns,mhdp.txt
```
Cadence MHDP bridge
==========================

The Cadence MHDP bridge is a DPI to DP bridge.

Required properties:
- compatible: should be "cdns,mhdp8546",
  Use "ti,j721e-mhdp8546" for TI J7 SoCs.
- reg: physical base address and length of the controller's registers,
- clocks: DP bridge clock, it's used by the IP to know how to translate
	a number of clock cycles into a time (which is used to comply
	with DP standard timings and delays),
- phys: see the Documentation/devicetree/bindings/phy/phy-cadence-torrent.txt
- phy-names: must be "dpphy"

Required subnodes:
- ports: Ports as described in Documentation/devictree/bindings/graph.txt
	Port 0 - input port representing the DP bridge input
	Port 1 - output port representing the DP bridge output

Example:

	mhdp: dp-bridge@f0fb000000 {
		compatible = "cdns,mhdp8546";
		reg = <0xf0 0xfb000000 0x0 0x1000000>;
		clocks = <&mhdp_clock>;
		phys = <&dp_phy>;
		phy-names = "dpphy";

		ports {
			#address-cells = <1>;
			#size-cells = <0>;

			port@0 {
				reg = <0>;
				dp_bridge_input: endpoint {
					remote-endpoint = <&xxx_dpi_output>;
				};
			};

			port@1 {
				reg = <1>;
				dp_bridge_output: endpoint {
					remote-endpoint = <&xxx_dp_connector_input>;
				};
			};
		};
	};
```

## Documentation/devicetree/bindings/display/bridge/cdns,mhdp.yaml
```yaml
# SPDX-License-Identifier: (GPL-2.0 OR BSD-2-Clause)
%YAML 1.2
---
$id: "http://devicetree.org/schemas/display/bridge/cdns,mhdp.yaml#"
$schema: "http://devicetree.org/meta-schemas/core.yaml#"

title: Cadence MHDP bridge

maintainers:
  - Swapnil Jakhade <sjakhade@cadence.com>
  - Yuti Amonkar <yamonkar@cadence.com>

properties:
  compatible:
    enum:
      - cdns,mhdp8546
      - ti,j721e-mhdp8546

  reg:
    minItems: 1
    maxItems: 2
    items:
      - description:
          Register block of mhdptx apb registers upto PHY mapped area(AUX_CONFIG_P).
          The AUX and PMA registers are mapped to associated phy driver.
      - description:
          Register block for DSS_EDP0_INTG_CFG_VP registers in case of TI J7 SoCs.

  reg-names:
    minItems: 1
    maxItems: 2
    items:
      - const: mhdptx
      - const: j721e-intg

  clocks:
    maxItems: 1
    description:
      DP bridge clock, it's used by the IP to know how to translate a number of
      clock cycles into a time (which is used to comply with DP standard timings
      and delays).

  phys:
    description: Phandle to the DisplyPort phy.

  ports:
    type: object
    description:
      Ports as described in Documentation/devicetree/bindings/graph.txt

    properties:
      '#address-cells':
        const: 1

      '#size-cells':
        const: 0

      port@0:
        type: object
        description:
          input port representing the DP bridge input

      port@1:
        type: object
        description:
          output port representing the DP bridge output.

    required:
      - port@0
      - port@1
      - '#address-cells'
      - '#size-cells'

allOf:
  - if:
      properties:
        compatible:
          contains:
            const: ti,j721e-mhdp8546
    then:
      properties:
        reg:
          minItems: 2
        reg-names:
          minItems: 2

required:
  - compatible
  - clocks
  - reg
  - reg-names
  - phys
  - ports

additionalProperties: false

examples:
  - |
    mhdp: dp-bridge@f0fb000000 {
        compatible = "cdns,mhdp8546";
        reg = <0xf0 0xfb000000 0x0 0x1000000>;
        reg-names = "mhdptx";
        clocks = <&mhdp_clock>;
        phys = <&dp_phy>;

        ports {
              #address-cells = <1>;
              #size-cells = <0>;

              port@0 {
                     reg = <0>;
                     dp_bridge_input: endpoint {
                        remote-endpoint = <&xxx_dpi_output>;
                     };
              };

              port@1 {
                     reg = <1>;
                     dp_bridge_output: endpoint {
                        remote-endpoint = <&xxx_dp_connector_input>;
                     };
              };
        };
    };
...
```

## Documentation/devicetree/bindings/display/bridge/sii902x.txt
```
sii902x HDMI bridge bindings

Required properties:
	- compatible: "sil,sii9022"
	- reg: i2c address of the bridge

Optional properties:
	- interrupts: describe the interrupt line used to inform the host 
	  about hotplug events.
	- reset-gpios: OF device-tree gpio specification for RST_N pin.
	- i2s-fifo-routing: Array of exactly 4 integers indicating i2s
	  pins for audio fifo routing. First integer defines routing to
	  fifo 0 and second to fifo 1, etc. Integers can be filled with
	  definitions from: include/dt-bindings/sound/sii902x-audio.h
	  The available definitions are:
	  - ENABLE_BIT:	enable this audio fifo
	  - CONNECT_SD#: route audio input from SD0, SD1, SD2, or SD3 i2s
			 data input pin
	  - LEFT_RIGHT_SWAP_BIT: swap i2s input channels for this fifo
	  I2S HDMI audio is configured only if this property is found.
	- clocks: describes SII902x MCLK input. MCLK is used to produce
	  HDMI audio CTS values. This property is required if
	  "i2s-fifo-routing"-property is present. This property follows
	  Documentation/devicetree/bindings/clock/clock-bindings.txt
	  consumer binding.

Optional subnodes:
	- video input: this subnode can contain a video input port node
	  to connect the bridge to a display controller output (See this
	  documentation [1]).

[1]: Documentation/devicetree/bindings/media/video-interfaces.txt

Example:
	hdmi-bridge@39 {
		compatible = "sil,sii9022";
		reg = <0x39>;
		reset-gpios = <&pioA 1 0>;

		i2s-fifo-routing = <
			(ENABLE_BIT|CONNECT_SD0)
			0
			0
			0
		>;
		clocks = <&mclk>;

		ports {
			#address-cells = <1>;
			#size-cells = <0>;

			port@0 {
				reg = <0>;
				bridge_in: endpoint {
					remote-endpoint = <&dc_out>;
				};
			};
		};
	};
```

## Documentation/devicetree/bindings/display/panel/rocktech,rk101ii01d-ct.yaml
```yaml
# SPDX-License-Identifier: (GPL-2.0 OR BSD-2-Clause)
%YAML 1.2
---
$id: http://devicetree.org/schemas/display/panel/rocktech,rk101ii01d-ct.yaml#
$schema: http://devicetree.org/meta-schemas/core.yaml#

title: Rocktech Displays Ltd RK101II01D-CT 10.1" TFT 1280x800 Pixels

maintainers:
  - Jyri Sarha <jsarha@ti.com>
  - Thierry Reding <thierry.reding@gmail.com>

allOf:
  - $ref: panel-common.yaml#

description: |
  Rocktech Displays Limited RK101II01D-CT 10.1" TFT 1280x800 Pixels
  with LVDS interface, LED Backlight and capacitive touch panel. For
  touch screen details see "goodix,gt928" in:
  Documentation/devicetree/bindings/input/touchscreen/goodix.txt

properties:
  compatible:
    const: rocktech,rk101ii01d-ct

  reset-gpios: true
  enable-gpios: true
  backlight: true
  port: true

required:
  - compatible
  - power-supply

examples:
  - |
        display0 {
                compatible = "rocktech,rk101ii01d-ct";
                backlight = <&lcd_bl>;
                enable-gpios = <&pca9555 8 GPIO_ACTIVE_HIGH>;
                power-supply = <&dummy_supply>;

                port {
                        lcd_in0: endpoint {
                                remote-endpoint = <&oldi_out0>;
                        };
                };
        };
```

## Documentation/devicetree/bindings/display/panel/rockteck,rk101ii01d-ct.txt
```
Rockteck 10.1" TFT 1280x800 Pixels
- with LVDS interface, LED Backlight and capacitive touch panel

Required properties:
- compatible: should be "rockteck,rk101ii01d-ct"

This binding is compatible with the simple-panel binding, which is specified
in simple-panel.txt in this directory.
```
