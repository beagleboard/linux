## Documentation/devicetree/bindings/display/ti/ti,am6-dss.txt
```
Texas Instruments AM65x Display Subsystem
==========================================

Required properties:
- compatible: "ti,am65x-dss", "ti,am6-dss"
- reg: address and length of the register spaces for DSS submodules
- reg-names: "common", "vidl1", "vid", "ovr1", "ovr2", "vp1", "vp2"
- clocks: phandle to fclk, vp1, and vp2 clocks
- clock-names: "fck", "vp1", "vp2"
- interrupts: phandle to the DISPC interrupt
- syscon: phandle to syscon device handling OLDI_PWRDN_TX (partition 1 of
  AM654 CTRL MMR0)

The DSS outputs are described using the device graphs as documented in
Documentation/devicetree/bindings/graph.txt. AM6 DSS has a DPI output as port 0
and an OLDI output as port 1.
```

## Documentation/devicetree/bindings/display/ti/ti,am625-oldi.yaml
```yaml
# SPDX-License-Identifier: (GPL-2.0-only OR BSD-2-Clause)
%YAML 1.2
---
$id: http://devicetree.org/schemas/display/ti/ti,am625-oldi.yaml#
$schema: http://devicetree.org/meta-schemas/core.yaml#

title: Texas Instruments AM625 OLDI Transmitter

maintainers:
  - Tomi Valkeinen <tomi.valkeinen@ideasonboard.com>
  - Aradhya Bhatia <aradhya.bhatia@linux.dev>

description:
  The AM625 TI Keystone OpenLDI transmitter (OLDI TX) supports serialized RGB
  pixel data transmission between host and flat panel display over LVDS (Low
  Voltage Differential Sampling) interface. The OLDI TX consists of 7-to-1 data
  serializers, and 4-data and 1-clock LVDS outputs. It supports the LVDS output
  formats "jeida-18", "jeida-24" and "vesa-18", and can accept 24-bit RGB or
  padded and un-padded 18-bit RGB bus formats as input.

properties:
  reg:
    maxItems: 1

  clocks:
    maxItems: 1
    description: serial clock input for the OLDI transmitters

  clock-names:
    const: serial

  ti,companion-oldi:
    $ref: /schemas/types.yaml#/definitions/phandle
    description:
      phandle to companion OLDI transmitter. This property is mandatory for the
      primarty OLDI TX if the OLDI TXes are expected to work either in dual-lvds
      mode or in clone mode. This property should point to the secondary OLDI
      TX.

  ti,secondary-oldi:
    type: boolean
    description:
      Boolean property to mark the OLDI transmitter as the secondary one, when the
      OLDI hardware is expected to run as a companion HW, in cases of dual-lvds
      mode or clone mode. The primary OLDI hardware is responsible for all the
      hardware configuration.

  ti,oldi-io-ctrl:
    $ref: /schemas/types.yaml#/definitions/phandle
    description:
      phandle to syscon device node mapping OLDI IO_CTRL registers found in the
      control MMR region. These registers are required to toggle the I/O lane
      power, and control its electrical characteristics.

  ports:
    $ref: /schemas/graph.yaml#/properties/ports

    properties:
      port@0:
        $ref: /schemas/graph.yaml#/properties/port
        description: Parallel RGB input port

      port@1:
        $ref: /schemas/graph.yaml#/properties/port
        description: LVDS output port

    required:
      - port@0
      - port@1

allOf:
  - if:
      required:
        - ti,secondary-oldi
    then:
      properties:
        ti,companion-oldi: false

required:
  - reg
  - clocks
  - clock-names
  - ti,oldi-io-ctrl
  - ports

additionalProperties: false

examples:
  - |
    #include <dt-bindings/soc/ti,sci_pm_domain.h>

    oldi-transmitters {
        #address-cells = <1>;
        #size-cells = <0>;
        oldi: oldi@0 {
            reg = <0>;
            clocks = <&k3_clks 186 0>;
            clock-names = "serial";
            ti,oldi-io-ctrl = <&dss_oldi_io_ctrl>;
            ports {
                #address-cells = <1>;
                #size-cells = <0>;
                port@0 {
                    reg = <0>;
                    oldi_in: endpoint {
                        remote-endpoint = <&dpi_out>;
                    };
                };
                port@1 {
                    reg = <1>;
                    oldi_out: endpoint {
                        remote-endpoint = <&panel_in>;
                    };
                };
            };
        };
    };

...
```
