## Documentation/devicetree/bindings/display/ti/ti,j7-dss.txt
```
Texas Instruments J721E Display Subsystem
==========================================

Required properties:
- compatible: "ti,j721e-dss"
- reg: address and length of the register spaces for DSS submodules
- reg-names: "common_m", "common_s0", "common_s1", "common_s2",
	     "vidl1", "vid", "ovr1", "ovr2", "vp1", "vp2"
- clocks: phandle to fclk, vp1, vp2, vp3, and vp4 clocks
- clock-names: "fck", "vp1", "vp2", "vp3", "vp4"
- interrupts: phandle to DISPC interrupts
- interrupt-names: "common_m", "common_s0", "common_s1", and "common_s2"

Optional properties:
- dss-planes: partitioning information for pipes, if display sharing is required
- dss-vps: partitioning information for video-ports, if display sharing is required
- dss-commons: partitioning information for common areas, if display sharing is required
- dss-remote: remote name that is expected to be advertised by the display sharing firmware

The DSS outputs are described using the device graphs as documented in
Documentation/devicetree/bindings/graph.txt.

Display Sharing on Texas Instruments J721E
=-=-=-=-=-=-=-=-=-=-=-=-=-=-=-=-=-=-=-=-=-=

Partitioning the pipes
-----------------------

In J721E, multiple video-ports, pipes, and common regions can be driven by separate
compute entities, and therefore should not be accessed by tidss driver. To ensure this,
optional properties like dss-planes, dss-vps and dss-commons should be used as required
by the setup.

Pipe partitioning is described by the 'dss-planes' node. Each pipe is repesented by a 'plane'
node inside the 'dss-planes' node.

Each 'plane' node must have a 'reg' property to identify the pipe, and a 'managed' property to
indicate whether the pipe is managed by the driver. the managed property must be 0 if the
pipe is not to be accessed by the driver.

Since the children of the 'dss-planes' node uses 'reg' properties to identify pipes, it must have '#address-cells'
and '#size-cells' properties, set to 1 and 0 respectively.

dss-planes {
	#address-cells = <1>;
	#size-cells = <0>;

	/* vid1, managed by tidss */
	plane@0 {
		reg = <0>;
		managed = <1>;
	};

	/* vidl1, not managed by tidss */
	plane@1 {
		reg = <1>;
		managed = <0>;
	};

	...
};

Partitioning the video-ports
-----------------------------

Video port partitioning is described by the 'dss-vps' node. Each video-port is repesented by a 'vp'
node inside the 'dss-vps' node.

Each 'vp' node must have a 'reg' property to identify the video-port, and a 'managed' property to
indicate whether the video-port is managed by the driver. the managed property must be 0 if the
video-port is not to be accessed by the driver.

Since the children of the 'dss-vps' node uses 'reg' properties to identify pipes, it must have '#address-cells'
and '#size-cells' properties, set to 1 and 0 respectively.

dss-vps {
	#address-cells = <1>;
	#size-cells = <0>;

	/* VP1, managed by tidss */
	vp@0 {
		reg = <0>;
		managed = <1>;
	};

	/* VP2, not managed by tidss */
	vp@1 {
		reg = <1>;
		managed = <0>;
	};

	...
};

Partitioning the common regions
--------------------------------

Tidss can use at most two common regions
- mandatory interrupt region
- optional config region

The common region partitioning is described by the 'dss-commons' node. It must have a child node called
'interrupt-common' and it may contain an optional node called 'config-common'

'interrupt-common' node must contain a 'reg' property to indicate which common region to be used for interrupt
handling

'config-common' node must contain a 'reg' property to indicate which common region to be used for device
configuration. It may contain a 'status' property which can be set to "disabled" when the configuration is
not to be done.

Since the children of the  'dss-commons' node uses 'reg' properties to identify common regions, it must have
'#address-cells' and '#size-cells' properties, set to 1 and 0 respectively.

Display sharing
----------------

To enable display sharing with another compute entity, there must be a 'dss-remote' node. The node must have a
string property called 'remote-name' which indicates the remote-device name to look for and attach
```

## Documentation/devicetree/bindings/display/ti/ti,k2g-dss.txt
```
Texas Instruments K2G Display Subsystem
=======================================

Required properties:
- compatible: "ti,k2g-dss"
- reg: address and length of the register spaces for DSS submodules
- reg-names: "cfg", "common", "vid1", "ovr1", "vp1"
- clocks: phandle to fclk and vp1 clocks
- clock-names: "fck", "vp1"
- interrupts: phandle to the DISPC interrupt

The DSS outputs are described using the device graphs as documented in
Documentation/devicetree/bindings/graph.txt. K2G DSS has a single DPI output as
port 0.
```

## Documentation/devicetree/bindings/dma/ti-edma.txt
```
TI EDMA

Required properties:
- compatible : "ti,edma3"
- ti,hwmods: Name of the hwmods associated to the EDMA
- ti,edma-regions: Number of regions
- ti,edma-slots: Number of slots
- ti,edma-queue-tc-map: List of transfer control to queue mappings
- ti,edma-queue-priority-map: List of queue priority mappings
- ti,edma-default-queue: Default queue value

Optional properties:
- ti,edma-reserved-channels: List of reserved channel regions
- ti,edma-reserved-slots: List of reserved slot regions
- ti,edma-xbar-event-map: Crossbar event to channel map

Example:

edma: edma@49000000 {
	reg = <0x49000000 0x10000>;
	interrupt-parent = <&intc>;
	interrupts = <12 13 14>;
	compatible = "ti,edma3";
	ti,hwmods = "tpcc", "tptc0", "tptc1", "tptc2";
	#dma-cells = <1>;
	dma-channels = <64>;
	ti,edma-regions = <4>;
	ti,edma-slots = <256>;
	ti,edma-reserved-channels = <0  2
				     14 2
				     26 6
				     48 4
				     56 8>;
	ti,edma-reserved-slots = <0  2
				  14 2
				  26 6
				  48 4
				  56 8
				  64 127>;
	ti,edma-queue-tc-map = <0 0
				1 1
				2 2>;
	ti,edma-queue-priority-map = <0 0
				      1 1
				      2 2>;
	ti,edma-default-queue = <0>;
	ti,edma-xbar-event-map = <1 12
				  2 13>;
};
```

## Documentation/devicetree/bindings/dma/ti/k3-bcdma-v2.yaml
```yaml
# SPDX-License-Identifier: (GPL-2.0-only OR BSD-2-Clause)
# Copyright (C) 2024-2025 Texas Instruments Incorporated
# Author: Sai Sree Kartheek Adivi <s-adivi@ti.com>
%YAML 1.2
---
$id: http://devicetree.org/schemas/dma/ti/k3-bcdma-v2.yaml#
$schema: http://devicetree.org/meta-schemas/core.yaml#

title: Texas Instruments K3 DMSS BCDMA V2

maintainers:
  - Sai Sree Kartheek Adivi <s-adivi@ti.com>

description: |
  The BCDMA V2 is intended to perform similar functions as the TR
  mode channels of K3 UDMA-P.
  BCDMA V2 includes block copy channels and Split channels.

  Block copy channels mainly used for memory to memory transfers, but with
  optional triggers a block copy channel can service peripherals by accessing
  directly to memory mapped registers or area.

  Split channels can be used to service PSI-L based peripherals.
  The peripherals can be PSI-L native or legacy, non PSI-L native peripherals
  with PDMAs. PDMA is tasked to act as a bridge between the PSI-L fabric and the
  legacy peripheral.

allOf:
  - $ref: /schemas/dma/dma-controller.yaml#

properties:
  compatible:
    const: ti,am62l-dmss-bcdma

  reg:
    items:
      - description: BCDMA Control /Status Registers region
      - description: Block Copy Channel Realtime Registers region
      - description: Channel Realtime Registers region
      - description: Ring Realtime Registers region

  reg-names:
    items:
      - const: gcfg
      - const: bchanrt
      - const: chanrt
      - const: ringrt

  "#dma-cells":
    const: 4
    description: |
      cell 1: Trigger type for the channel
        0 - disable / no trigger
        1 - internal channel event
        2 - external signal
        3 - timer manager event

      cell 2: parameter for the trigger:
        if cell 1 is 0 (disable / no trigger):
          Unused, ignored
        if cell 1 is 1 (internal channel event):
          channel number whose TR event should trigger the current channel.
        if cell 1 is 2 or 3 (external signal or timer manager event):
          index of global interfaces that come into the DMA.

          Please refer to the device documentation for global interface indexes.

      cell 3: Channel number for the peripheral

        Please refer to the device documentation for the channel map.

      cell 4: ASEL value for the channel

required:
  - compatible
  - "#dma-cells"
  - reg
  - reg-names

unevaluatedProperties: false

examples:
  - |+
    cbass_main {
        #address-cells = <2>;
        #size-cells = <2>;

      main_bcdma: dma-controller@485c4000 {
          compatible = "ti,am62l-dmss-bcdma";
          reg = <0x00 0x485c4000 0x00 0x4000>,
                <0x00 0x48880000 0x00 0x10000>,
                <0x00 0x48800000 0x00 0x80000>,
                <0x00 0x47000000 0x00 0x200000>;
          reg-names = "gcfg", "bchanrt", "chanrt", "ringrt";
          #dma-cells = <4>;
        };
    };
```

## Documentation/devicetree/bindings/dma/ti/k3-pktdma-v2.yaml
```yaml
# SPDX-License-Identifier: (GPL-2.0-only OR BSD-2-Clause)
# Copyright (C) 2024-2025 Texas Instruments Incorporated
# Author: Sai Sree Kartheek Adivi <s-adivi@ti.com>
%YAML 1.2
---
$id: http://devicetree.org/schemas/dma/ti/k3-pktdma-v2.yaml#
$schema: http://devicetree.org/meta-schemas/core.yaml#

title: Texas Instruments K3 DMSS PKTDMA V2

maintainers:
  - Sai Sree Kartheek Adivi <s-adivi@ti.com>

description: |
  The PKTDMA V2 is intended to perform similar functions as the packet
  mode channels of K3 UDMA-P.
  PKTDMA V2 only includes Split channels to service PSI-L based peripherals.

  The peripherals can be PSI-L native or legacy, non PSI-L native peripherals
  with PDMAs. PDMA is tasked to act as a bridge between the PSI-L fabric and the
  legacy peripheral.

allOf:
  - $ref: /schemas/dma/dma-controller.yaml#

properties:
  compatible:
    const: ti,am62l-dmss-pktdma

  "#dma-cells":
    const: 2
    description: |
      cell 1: Channel number for the peripheral

        Please refer to the device documentation for the channel map.

      cell 2: ASEL value for the channel

  reg:
    items:
      - description: Packet DMA Control /Status Registers region
      - description: Channel Realtime Registers region
      - description: Ring Realtime Registers region

  reg-names:
    items:
      - const: gcfg
      - const: chanrt
      - const: ringrt

required:
  - compatible
  - "#dma-cells"
  - reg
  - reg-names

unevaluatedProperties: false

examples:
  - |+
    cbass_main {
        #address-cells = <2>;
        #size-cells = <2>;

      main_pktdma: dma-controller@485c0000 {
        compatible = "ti,am62l-dmss-pktdma";
        reg = <0x00 0x485c0000 0x00 0x4000>,
          <0x00 0x48900000 0x00 0x80000>,
          <0x00 0x47200000 0x00 0x100000>;
        reg-names = "gcfg", "chanrt", "ringrt";
        #dma-cells = <2>;
      };
    };
```
