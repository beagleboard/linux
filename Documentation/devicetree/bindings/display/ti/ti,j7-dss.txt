## Documentation/devicetree/bindings/gpu/ti-pvr.txt
```
Texas Instruments PowerVR 3D GPU
================================

PowerVR is a 3D Graphics Processing Unit from Imagination Technologies. Texas
Instruments SoCs have integrated different generations of PowerVR 3D GPUs. This
binding describes the GPU's integrated in Texas Instruments SoCs.

Required properties:
--------------------
  - compatible:
      accepted values:
	(a) "ti,am3352-sgx530", "img,sgx530" for TI AM33x
	(b) "ti,am4376-sgx530", "img,sgx530" for TI AM43x
	(c) "ti,dra7-sgx544", "img,sgx544" for TI DRA7xx / AM57x
	(d) "ti,am654-sgx544", "img,sgx544" for TI AM654
	(e) "ti,j721e-pvr", "img,pvr-ge8430" for TI J721E SoC with PowerVR GE8430 GPU

  - reg: base address and length of registers
  - interrupts: phandle to GPU interrupts
  - clocks: from SoC clock bindings

Optional properties:
--------------------
  - reg-names: names of registers listed in reg property in same order
  - clock-names: names of clocks listed in clocks property in same order

SoC-specific properties:
------------------------
The following properties are mandatory for OMAP architecture based SoC's
  - ti,hwmods: name of hwmod associated with AM33x, AM43x, DRA7xx devices

The following properties are mandatory for K3 AM65x and J721E SoCs only:
  - power-domains: power domain parameters from SoC device description

The following properties are optional for K3 AM65x and J721E SoCs only:
  - power-domain-names: names of domains listed in power-domains property in
    same order

Examples:
--------

1. /* DRA7 */
	sgx@56000000 {
		compatible = "ti,dra7-sgx544", "img,sgx544";
		reg = <0x56000000 0x10000>;
		reg-names = "gpu_ocp_base";
		interrupts = <GIC_SPI 16 IRQ_TYPE_LEVEL_HIGH>;
		ti,hwmods = "gpu";
		clocks = <&l3_iclk_div>, <&gpu_core_gclk_mux>,
			 <&gpu_hyd_gclk_mux>;
		clock-names = "iclk", "fclk1", "fclk2";
	};

2. /* AM65x */
	gpu@7000000 {
		compatible = "ti,am654-sgx544", "img,sgx544";
		reg = <0x0 0x7000000 0x0 0x10000>;
		interrupts = <GIC_SPI 162 IRQ_TYPE_LEVEL_HIGH>;
		power-domains = <&k3_pds 65>;
		clocks = <&k3_clks 65 0>, <&k3_clks 65 1>, <&k3_clks 65 2>, <&k3_clks 65 3>;
		clock-names = "mem_clk", "hyd_clk", "sgx_clk", "sys_clk";
	};

3. /* J721e */
	gpu: gpu@4e20000000 {
		compatible = "ti,j721e-pvr", "img,pvr-ge8430";
		reg = <0x4e 0x20000000 0x00 0x80000>;
		reg-names = "gpu_regs";
		interrupts = <GIC_SPI 24 IRQ_TYPE_LEVEL_HIGH>;
		power-domains = <&k3_pds 125 TI_SCI_PD_EXCLUSIVE>, <&k3_pds 126 TI_SCI_PD_EXCLUSIVE>;
		power-domain-names = "gpu_0", "gpucore_0";
		clocks = <&k3_clks 125 0>;
		clock-names = "ctrl";
	};
```

## Documentation/devicetree/bindings/gpu/ti-sgx.txt
```
Texas Instruments SGX 3D Graphics Processing Unit

SGX is a 3D Graphics Processing Unit from Imagination Technologies. SGX is
codename for 5th generation / Series 5 of PowerVR chipset family. This binding
describes PowerVR SGX GPU integrated in Texas Instrument SoCs.

Required properties:
 - compatible : value should take the following format:
	"ti,<soc>-<gpuversion>", "img,<gpuversion>"

   accepted values:
	(a) "ti,am3352-sgx530", "img,sgx530" for TI AM33x
	(b) "ti,am4376-sgx530", "img,sgx530" for TI AM43x
	(c) "ti,dra7-sgx544", "img,sgx544" for TI DRA7xx / AM57x
	(d) "ti,am654-sgx544", "img,sgx544" for TI AM654
 - reg: base address and length of the SGX registers
 - interrupts : SGX interrupt number
 - ti,hwmods: Name of the hwmod associated with the SGX for OMAP devices
 - power-domains: Power domain parameters of the SGX for K3 devices
 - clocks : From SoC clock binding

Optional properties:
 - reg-names : names of registers listed in reg property in same order
 - clock-names : names of clocks listed in clocks property in the same order

Examples:
	sgx@56000000 {
		compatible = "ti,dra7-sgx544", "img,sgx544";
		reg = <0x56000000 0x10000>;
		interrupts = <GIC_SPI 16 IRQ_TYPE_LEVEL_HIGH>;
		ti,hwmods = "gpu";
		clocks = <&l3_iclk_div>,
		         <&gpu_core_gclk_mux>,
		         <&gpu_hyd_gclk_mux>;
		clock-names = "iclk",
		              "fclk1",
		              "fclk2";
	};

	gpu@7000000 {
		compatible = "ti,am654-sgx544", "img,sgx544";
		reg = <0x0 0x7000000 0x0 0x10000>;
		interrupts = <GIC_SPI 162 IRQ_TYPE_LEVEL_HIGH>;
		power-domains = <&k3_pds 65>;
		clocks = <&k3_clks 65 0>,
		         <&k3_clks 65 1>,
		         <&k3_clks 65 2>,
		         <&k3_clks 65 3>;
		clock-names = "mem_clk",
		              "hyd_clk",
		              "sgx_clk",
		              "sys_clk";
	};
```

## Documentation/devicetree/bindings/hdq1w/omap_hdq.txt
```
HDQ/1w for OMAP platforms

Required properties :
- compatible : Must be "ti,am43xx-hdq".
- ti,hwmods : Must be "hdq1w".
- reg: Should contain register location and length.
- interrupts: Should contain interrupt.
- clock: Clock input to HDQ1w controller.

Example:

	hdq: hdq@48347000 {
		compatible = "ti,am43xx-hdq";
		reg = <0x48347000 0x1000>;
		interrupts = <GIC_SPI 139 IRQ_TYPE_LEVEL_HIGH>;
		clocks = <&func_12m_clk>;
		clock-names = "fck";
		ti,hwmods = "hdq1w";
		status = "disabled";
	};
```

## Documentation/devicetree/bindings/hwlock/hwlock.txt
```
Generic hwlock bindings
=======================

Generic bindings that are common to all the hwlock platform specific driver
implementations.

The validity and need of these common properties may vary from one platform
implementation to another. The platform specific bindings should explicitly
state if an optional property is used. Please also look through the individual
platform specific hwlock binding documentations for identifying the applicable
properties.

Common properties:
- #hwlock-cells:	Specifies the number of cells needed to represent a
			specific lock. This property is mandatory for all
			platform implementations.
- hwlock-num-locks:	Number of locks present in a hwlock device. This
			property is needed on hwlock devices, where the number
			of supported locks within a hwlock device cannot be
			read from a register.
- hwlock-base-id:	An unique base Id for the locks for a particular hwlock
			device. This property is mandatory if a SoC has several
			hwlock devices.

Hwlock Users:
=============

Nodes that require specific hwlock(s) should specify them using the property
"hwlocks", each containing a phandle to the hwlock node and an args specifier
value as indicated by #hwlock-cells. Multiple hwlocks can be requested using
an array of the phandle and hwlock number specifier tuple.

1. Example of a node using a single specific hwlock:

The following example has a node requesting a hwlock in the bank defined by
the node hwlock1. hwlock1 is a hwlock provider with an argument specifier
of length 1.

	node {
		...
		hwlocks = <&hwlock1 2>;
		...
	};

2. Example of a node using multiple specific hwlocks:

The following example has a node requesting two hwlocks, a hwlock within
the hwlock device node 'hwlock1' with #hwlock-cells value of 1, and another
hwlock within the hwlock device node 'hwlock2' with #hwlock-cells value of 2.

	node {
		...
		hwlocks = <&hwlock1 2>, <&hwlock2 0 3>;
		...
	};
```

## Documentation/devicetree/bindings/hwlock/ti,omap-hwspinlock.yaml
```yaml
# SPDX-License-Identifier: (GPL-2.0-only or BSD-2-Clause)
%YAML 1.2
---
$id: http://devicetree.org/schemas/hwlock/ti,omap-hwspinlock.yaml#
$schema: http://devicetree.org/meta-schemas/core.yaml#

title: TI HwSpinlock for OMAP and K3 based SoCs

maintainers:
  - Suman Anna <s-anna@ti.com>

properties:
  compatible:
    enum:
      - ti,omap4-hwspinlock  # for OMAP44xx, OMAP54xx, AM33xx, AM43xx, DRA7xx SoCs
      - ti,am64-hwspinlock   # for K3 AM64x SoCs
      - ti,am654-hwspinlock  # for K3 AM65x, J721E and J7200 SoCs

  reg:
    maxItems: 1

  "#hwlock-cells":
    const: 1
    description: |
      The OMAP hwspinlock users will use a 0-indexed relative hwlock number as
      the argument specifier value for requesting a specific hwspinlock within
      a hwspinlock bank.

      Please look at the generic hwlock binding for usage information for
      consumers, "Documentation/devicetree/bindings/hwlock/hwlock.txt"

required:
  - compatible
  - reg
  - "#hwlock-cells"

additionalProperties: false

examples:

  - |
    /* OMAP4 SoCs */
    hwspinlock: spinlock@4a0f6000 {
        compatible = "ti,omap4-hwspinlock";
        reg = <0x4a0f6000 0x1000>;
        #hwlock-cells = <1>;
    };

  - |
    / {
        /* K3 AM65x SoCs */
        model = "Texas Instruments K3 AM654 SoC";
        compatible = "ti,am654-evm", "ti,am654";
        #address-cells = <2>;
        #size-cells = <2>;

        bus@100000 {
            compatible = "simple-bus";
            #address-cells = <2>;
            #size-cells = <2>;
            ranges = <0x00 0x00100000 0x00 0x00100000 0x00 0x00020000>, /* ctrl mmr */
                     <0x00 0x30800000 0x00 0x30800000 0x00 0x0bc00000>; /* Main NavSS */

            bus@30800000 {
                compatible = "simple-mfd";
                #address-cells = <2>;
                #size-cells = <2>;
                ranges = <0x00 0x30800000 0x00 0x30800000 0x00 0x0bc00000>;

                spinlock@30e00000 {
                    compatible = "ti,am654-hwspinlock";
                    reg = <0x00 0x30e00000 0x00 0x1000>;
                    #hwlock-cells = <1>;
                };
            };
        };
    };

  - |
    / {
        /* K3 AM64x SoCs */
        model = "Texas Instruments K3 AM642 SoC";
        compatible = "ti,am642-evm", "ti,am642";
        #address-cells = <2>;
        #size-cells = <2>;

        bus@f4000 {
            compatible = "simple-bus";
            #address-cells = <2>;
            #size-cells = <2>;
            ranges = <0x00 0x000f4000 0x00 0x000f4000 0x00 0x000002e4>, /* PINCTRL */
                     <0x00 0x01000000 0x00 0x01000000 0x00 0x02330400>, /* First peripheral window */
                     <0x00 0x0f000000 0x00 0x0f000000 0x00 0x00c44200>, /* Second peripheral window */
                     <0x00 0x20000000 0x00 0x20000000 0x00 0x0a008000>; /* Third peripheral window */

            spinlock@2a000000 {
                compatible = "ti,am64-hwspinlock";
                reg = <0x00 0x2a000000 0x00 0x1000>;
                #hwlock-cells = <1>;
            };
        };
    };
```

## Documentation/devicetree/bindings/hwmon/am335x-bandgap.txt
```
TI AM335x bandgap temperature sensor
------------------------------------

Requires node properties:
- compatible: Should be "ti,am335x-bandgap"
- reg: Should contain registers location and length

Example:
	bandgap@44e10448 {
		compatible = "ti,am335x-bandgap";
		reg = <0x44e10448 0x8>;
	};
```

## Documentation/devicetree/bindings/iio/imu/inv_mpu6050.txt
```
InvenSense MPU-6050 Six-Axis (Gyro + Accelerometer) MEMS MotionTracking Device

Required properties:
 - compatible : one of "invensense,mpu6000", "invensense,mpu6050",
	"invensense,mpu6000" or "invensense,mpu9150"
 - reg : the I2C or SPI address of the sensor
 - interrupt-parent : should be the phandle for the interrupt controller
 - interrupts : interrupt mapping for GPIO IRQ

Optional properties:
 - mount-matrix: an optional 3x3 mounting rotation matrix
 - invensense,i2c-aux-master: operate aux i2c in "master" mode (default is bypass).

It is possible to attach auxiliary sensors to the MPU and have them be handled
by linux. Those auxiliary sensors are described as an i2c bus.

It is possible to interact with aux devices in "bypass" or "master" mode. In
"bypass" mode the auxiliary SDA/SCL lines are connected directly to the main i2c
interface. In "master" mode access to aux devices is done by instructing the
MPU to read or write i2c bytes.

In "bypass" mode aux devices are listed behind a "i2c@0" node with reg = <0>;
In "master" mode aux devices are listed behind a "i2c@1" node with reg = <1>;

The master and bypass modes are not supported at the same time. The
"invensense,i2c-aux-master" property must be set to activate master mode.
Bypass mode is generally faster but master mode also works when the MPU is
connected via SPI. Enabling master mode is required for automated external
readings.


It is possible to configure the MPU to automatically fetch reading for
devices connected on the auxiliary i2c bus without CPU intervention. When this
is done the driver will present the channels of the slaved devices as if they
belong to the MPU device itself.

Reads and write to config values (like scaling factors) are forwarded to the
other driver while data reads are handled from MPU registers. The channels are
also available through the MPU's iio triggered buffer mechanism. This feature
can allow sampling up to 24 bytes from 4 slaves at a much higher rate.

This is specified in device tree as an "invensense,external-sensors" node with
children indexed by slave ids 0 to 3. The child nodes identifying each external
sensor reading have the following properties:
 - reg: 0 to 3 slave index
 - invensense,addr : the I2C address to read from
 - invensense,reg : the I2C register to read from
 - invensense,len : read length from the device
 - invensense,external-channels : list of slaved channels specified by scan_index.

The sum of storagebits for external channels must equal the read length. Only
16bit channels are currently supported.


Example:
	mpu6050@68 {
		compatible = "invensense,mpu6050";
		reg = <0x68>;
		interrupt-parent = <&gpio1>;
		interrupts = <18 1>;
	};

Example describing mpu9150 (which includes an ak9875 on chip):
	mpu9150@68 {
		compatible = "invensense,mpu9150";
		reg = <0x68>;
		interrupt-parent = <&gpio1>;
		interrupts = <18 1>;

		#address-cells = <1>;
		#size-cells = <0>;
		i2c@0 {
			reg = <0>;
			#address-cells = <1>;
			#size-cells = <0>;

			ak8975@0c {
				compatible = "ak,ak8975";
				reg = <0x0c>;
			};
		};
	};

Example describing a mpu6500 via SPI with an hmc5883l on aux i2c configured for
automatic external readings as slave 0:
	mpu6500@0 {
		compatible = "invensense,mpu6500";
		reg = <0x0>;
		spi-max-frequency = <1000000>;
		interrupt-parent = <&gpio1>;
		interrupts = <31 1>;

		invensense,i2c-aux-master;

		#address-cells = <1>;
		#size-cells = <0>;
		i2c@1 {
			reg = <1>;
			#address-cells = <1>;
			#size-cells = <0>;

			hmc5883l@1e {
				compatible = "honeywell,hmc5883l";
				reg = <0x1e>;
			};
		};

		invensense,external-sensors {
			#address-cells = <1>;
			#size-cells = <0>;
			hmc5833l@0 {
				reg = <0>;
				invensense,addr = <0x1e>;
				invensense,reg = <3>;
				invensense,len = <6>;
				invensense,external-channels = <0 1 2>;
			};
		};
	};
```
