## Documentation/devicetree/bindings/gpu/ti,pvr.yaml
```yaml
# SPDX-License-Identifier: (GPL-2.0-only OR BSD-2-Clause)
%YAML 1.2
---
$id: http://devicetree.org/schemas/gpu/ti,pvr.yaml#
$schema: http://devicetree.org/meta-schemas/core.yaml#

title: Texas Instruments PowerVR Rogue GPU Bindings

description: |
  PowerVR is a family of 3D graphics processing units from Imagination
  Technologies. Texas Instruments SoCs have integrated different generations of
  PowerVR GPUs and this binding describes the GPU's integrated in Texas
  Instruments SoCs.

maintainers:
  - Darren Etheridge <detheridge@ti.com>

properties:
  $nodename:
    pattern: '^gpu@[a-f0-9]+$'

  compatible:
    oneOf:
      - items:
          - enum:
              - ti,j721s2-pvr
          - const: img,pvr-bxs64
      - items:
          - enum:
              - ti,am62-pvr
          - const: img,pvr-axe116m
      - items:
          - enum:
              - ti,j721e-pvr
          - const: img,pvr-ge8430
      - items:
          - enum:
              - ti,am654-sgx544
              - ti,dra7-sgx544
          - const: img,sgx544
      - items:
          - enum:
              - ti,am3352-sgx530
              - ti,am4376-sgx530
          - const: img,sgx530

  reg:
    maxItems: 1

  reg-names:
    const: gpu_regs

  interrupts:
    maxItems: 1

  clocks:
    minItems: 1
    maxItems: 4

  clock-names:
    minItems: 1
    maxItems: 4

  power-domains:
    minItems: 1
    maxItems: 2

  power-domain-names:
    minItems: 1
    maxItems: 2

required:
  - compatible
  - reg
  - interrupts
  - clocks

additionalProperties: false

allOf:
  - if:
      properties:
        compatible:
          contains:
            enum:
              - ti,j721s2-pvr
    then:
      properties:
        clocks:
          minItems: 1
          maxItems: 1
        power-domains:
          minItems: 2
          maxItems: 2
          items:
            - description: power domain for register access
            - description: power domain for gpu internal cores
        power-domain-names:
          minItems: 2
          maxItems: 2
          items:
            - const: gpu_0
            - const: gpucore_0
        reg:
          minItems: 1
          maxItems: 1
        interrupts:
          minItems: 1
          maxItems: 1
      required:
        - clocks
        - reg
        - power-domains
        - power-domain-names
        - interrupts
  - if:
      properties:
        compatible:
          contains:
            enum:
              - ti,am62-pvr
    then:
      properties:
        clocks:
          minItems: 1
          maxItems: 1
        power-domains:
          minItems: 1
          maxItems: 1
          items:
            - description: power domain for GPU
        reg:
          minItems: 1
          maxItems: 1
        interrupts:
          minItems: 1
          maxItems: 1
      required:
        - clocks
        - reg
        - power-domains
        - interrupts
  - if:
      properties:
        compatible:
          contains:
            enum:
              - ti,j721e-pvr
    then:
      properties:
        clocks:
          minItems: 1
        power-domains:
          maxItems: 2
          items:
            - description: power domain for register access
            - description: power domain for gpu internal cores
        power-domain-names:
          maxItems: 2
          items:
            - const: gpu_0
            - const: gpucore_0
      required:
        - power-domains
        - power-domain-names
  - if:
      properties:
        compatible:
          contains:
            enum:
              - ti,am654-sgx544
    then:
      properties:
        clocks:
          minItems: 4
        clock-names:
          minItems: 4
          items:
            - const: mem_clk
            - const: hyd_clk
            - const: sgx_clk
            - const: sys_clk
        power-domains:
          maxItems: 1
      required:
        - power-domains
  - if:
      properties:
        compatible:
          contains:
            enum:
              - ti,dra7-sgx544
    then:
      properties:
        clocks:
          minItems: 3
        clock-names:
          minItems: 3
          items:
            - const: iclk
            - const: fclk1
            - const: fclk2
  - if:
      properties:
        compatible:
          contains:
            enum:
              - ti,am3352-sgx530
              - ti,am4376-sgx530
    then:
      properties:
        clocks:
          maxItems: 1
        clock-names:
          maxItems: 1
          items:
            - const: fclk
examples:
  - |
    #include <dt-bindings/interrupt-controller/irq.h>
    #include <dt-bindings/interrupt-controller/arm-gic.h>
    #include <dt-bindings/soc/ti,sci_pm_domain.h>

    gpu: gpu@fd00000 {
      compatible = "ti,am62-pvr", "img,pvr-axe116m";
      reg = <0x00 0x0fd00000 0x00 0x20000>;
      interrupts = <GIC_SPI 86 IRQ_TYPE_LEVEL_HIGH>;
      power-domains = <&k3_pds 187 TI_SCI_PD_EXCLUSIVE>;
      clocks = <&k3_clks 187 0>;
    };

  - |
    #include <dt-bindings/interrupt-controller/irq.h>
    #include <dt-bindings/interrupt-controller/arm-gic.h>
    #include <dt-bindings/soc/ti,sci_pm_domain.h>

    gpu: gpu@4e20000000 {
      compatible = "ti,j721s2-pvr", "img,pvr-bxs64";
      reg = <0x4e 0x20000000 0x00 0x80000>;
      interrupts = <GIC_SPI 24 IRQ_TYPE_LEVEL_HIGH>;
      power-domains = <&k3_pds 130 TI_SCI_PD_EXCLUSIVE>,
                      <&k3_pds 373 TI_SCI_PD_EXCLUSIVE>;
      power-domain-names = "gpu_0", "gpucore_0";
      clocks = <&k3_clks 130 1>;
    };

  - |
    #include <dt-bindings/interrupt-controller/irq.h>
    #include <dt-bindings/interrupt-controller/arm-gic.h>
    #include <dt-bindings/soc/ti,sci_pm_domain.h>

    gpu: gpu@0 {
      compatible = "ti,j721e-pvr", "img,pvr-ge8430";
      reg = <0x00 0x80000>;
      reg-names = "gpu_regs";
      interrupts = <GIC_SPI 24 IRQ_TYPE_LEVEL_HIGH>;
      power-domains = <&k3_pds 125 TI_SCI_PD_EXCLUSIVE>,
                      <&k3_pds 126 TI_SCI_PD_EXCLUSIVE>;
      power-domain-names = "gpu_0", "gpucore_0";
      clocks = <&k3_clks 125 0>;
      clock-names = "ctrl";
    };

  - |
    #include <dt-bindings/interrupt-controller/irq.h>
    #include <dt-bindings/interrupt-controller/arm-gic.h>

    gpu@70000000 {
      compatible = "ti,am654-sgx544", "img,sgx544";
      reg = <0x0 0x10000>;
      interrupts = <GIC_SPI 162 IRQ_TYPE_LEVEL_HIGH>;
      power-domains = <&k3_pds 65>;
      clocks = <&k3_clks 65 0>, <&k3_clks 65 1>,
               <&k3_clks 65 2>, <&k3_clks 65 3>;
      clock-names = "mem_clk", "hyd_clk",
                    "sgx_clk", "sys_clk";
    };

  - |
    #include <dt-bindings/interrupt-controller/irq.h>
    #include <dt-bindings/interrupt-controller/arm-gic.h>

    gpu@56000000 {
      compatible = "ti,dra7-sgx544", "img,sgx544";
      reg = <0x0 0x10000>;
      interrupts = <GIC_SPI 16 IRQ_TYPE_LEVEL_HIGH>;
      clocks = <&l3_iclk_div>,
               <&gpu_core_gclk_mux>,
               <&gpu_hyd_gclk_mux>;
      clock-names = "iclk",
                    "fclk1",
                    "fclk2";
    };
...
```

## Documentation/devicetree/bindings/gpu/ti,rogue.txt
```
Texas Instruments PowerVR Rogue GPU
===================================

PowerVR Rogue is a family of 3D Graphics Processing Units from Imagination
Technologies. Texas Instruments SoCs have integrated different generations of
PowerVR Rogue GPUs. This binding describes the PowerVR GE8430 GPU integrated in
TI J721E SoC.

Required properties:
--------------------
  - compatible:
      accepted values: "ti,j721e-pvr", "img,pvr-ge8430"

  - reg: base address and length of registers
  - interrupts: phandle to GPU interrupts
  - clocks: from SoC clock bindings
  - power-domains: power domain parameters from SoC device description

Optional properties:
--------------------
  - reg-names: names of registers listed in reg property in same order
  - clock-names: names of clocks listed in clocks property in same order
  - power-domain-names: names of domains listed in power-domains property in
    same order

Examples:
--------

	gpu: gpu@4e20000000 {
		compatible = "ti,j721e-pvr", "img,pvr-ge8430";
		reg = <0x4e 0x20000000 0x00 0x80000>;
		reg-names = "gpu_regs";
		interrupts = <GIC_SPI 24 IRQ_TYPE_LEVEL_HIGH>;
		power-domains = <&k3_pds 125 TI_SCI_PD_EXCLUSIVE>,
		                <&k3_pds 126 TI_SCI_PD_EXCLUSIVE>;
		power-domain-names = "gpu_0", "gpucore_0";
		clocks = <&k3_clks 125 0>;
		clock-names = "ctrl";
	};
```

## Documentation/devicetree/bindings/gpu/ti,rogue.yaml
```yaml
# SPDX-License-Identifier: (GPL-2.0-only OR BSD-2-Clause)
%YAML 1.2
---
$id: http://devicetree.org/schemas/gpu/ti,rogue.yaml#
$schema: http://devicetree.org/meta-schemas/core.yaml#

title: Texas Instruments PowerVR Rogue GPU

description: |
  PowerVR Rogue is a family of 3D graphics processing units from Imagination
  Technologies. Texas Instruments SoCs have integrated different generations of
  PowerVR GPUs and this binding describes the GPU's integrated in Texas
  Instruments SoCs in the K3 generation.

maintainers:
  - Darren Etheridge <detheridge@ti.com>
  - Randolph Sapp <rs@ti.com>

properties:
  $nodename:
    pattern: '^gpu@[a-f0-9]+$'

  compatible:
    oneOf:
      - items:
          - enum:
              - ti,j721s2-pvr
          - const: img,pvr-bxs64
      - items:
          - enum:
              - ti,j721e-pvr
          - const: img,pvr-ge8430
      - items:
          - enum:
              - ti,am62p-pvr
          - const: img,pvr-bxs64

  reg:
    maxItems: 1

  interrupts:
    maxItems: 1

  clocks:
    maxItems: 1

  clock-names:
    maxItems: 1

  power-domains:
    minItems: 1
    maxItems: 2

  power-domain-names:
    maxItems: 2

  assigned-clocks:
    maxItems: 1

  assigned-clock-rates:
    maxItems: 1
    description: |
      Allows users to override the default clock value used for the GPU.
      Currently ignored on devices other than ti,am62p-pvr. This will be ported
      to other devices soon.

required:
  - compatible
  - reg
  - interrupts
  - power-domains
  - clocks

additionalProperties: false

allOf:
  - if:
      properties:
        compatible:
          contains:
            enum:
              - ti,j721s2-pvr
              - ti,j721e-pvr
    then:
      properties:
        reg:
          minItems: 1
        interrupts:
          minItems: 1
        clocks:
          minItems: 1
        power-domains:
          minItems: 1
          maxItems: 1
  - if:
      properties:
        compatible:
          contains:
            enum:
              - ti,am62p-pvr
    then:
      required:
        - power-domain-names
        - assigned-clocks
        - clock-names
      properties:
        reg:
          minItems: 1
        interrupts:
          minItems: 1
        clocks:
          minItems: 1
        clock-names:
          items:
            - const: core
        power-domains:
          minItems: 2
        power-domain-names:
          items:
            - const: firmware
            - const: dust
        assigned-clocks:
          minItems: 1
        assigned-clock-rates:
          default: 800000000
    else:
      properties:
        assigned-clocks: false
        assigned-clock-rates: false

examples:
  - |
    #include <dt-bindings/interrupt-controller/irq.h>
    #include <dt-bindings/interrupt-controller/arm-gic.h>
    #include <dt-bindings/soc/ti,sci_pm_domain.h>

    bus {
        #address-cells = <2>;
        #size-cells = <2>;
        gpu@4e20000000 {
            compatible = "ti,j721s2-pvr", "img,pvr-bxs64";
            reg = <0x4e 0x20000000 0x00 0x80000>;
            interrupts = <GIC_SPI 24 IRQ_TYPE_LEVEL_HIGH>;
            power-domains = <&k3_pds 373 TI_SCI_PD_EXCLUSIVE>;
            clocks = <&k3_clks 130 1>;
        };
    };

  - |
    #include <dt-bindings/interrupt-controller/irq.h>
    #include <dt-bindings/interrupt-controller/arm-gic.h>
    #include <dt-bindings/soc/ti,sci_pm_domain.h>

    bus {
        #address-cells = <2>;
        #size-cells = <2>;
        gpu@4e20000000 {
            compatible = "ti,j721e-pvr", "img,pvr-ge8430";
            reg = <0x4e 0x20000000 0x00 0x80000>;
            interrupts = <GIC_SPI 24 IRQ_TYPE_LEVEL_HIGH>;
            power-domains = <&k3_pds 126 TI_SCI_PD_EXCLUSIVE>;
            clocks = <&k3_clks 125 0>;
        };
    };

  - |
    #include <dt-bindings/interrupt-controller/irq.h>
    #include <dt-bindings/interrupt-controller/arm-gic.h>
    #include <dt-bindings/soc/ti,sci_pm_domain.h>

    bus {
        #address-cells = <2>;
        #size-cells = <2>;
        gpu@fd80000 {
            compatible = "ti,am62p-pvr", "img,pvr-bxs64";
            reg = <0x00 0x0fd80000 0x00 0x80000>;
            interrupts = <GIC_SPI 241 IRQ_TYPE_LEVEL_HIGH>;
            power-domains = <&k3_pds 237 TI_SCI_PD_EXCLUSIVE>,
                            <&k3_pds 242 TI_SCI_PD_EXCLUSIVE>;
            assigned-clocks = <&k3_clks 237 3>;
            assigned-clock-rates = <720000000>;
            power-domain-names = "firmware", "dust";
            clocks = <&k3_clks 237 3>;
            clock-names = "core";
        };
    };
...
```

## Documentation/devicetree/bindings/gpu/ti-bb2d.txt
```
* Texas Instruments BB2D blitter module

This binding describes the 2D BitBlit (BB2D) graphics accelerator
subsystem based on the GC320 core from Vivante Corporation available
in Texas Instruments SoCs.

Required properties:
  - compatible: should be "ti,dra7-bb2d" for TI DRA7xx/AM57xx SoCs
  - reg : base address and length of BB2D IP registers
  - interrupts : BB2D interrupt line number
  - ti,hwmods : name of the hwmod associated with BB2D module
  - clocks : handle to BB2D functional clock
  - clock-names : fck

Example:
        bb2d: bb2d@59000000 {
            compatible = "ti,dra7-bb2d";
            reg = <0x59000000 0x0700>;
            interrupts = <GIC_SPI 120 IRQ_TYPE_LEVEL_HIGH>;
            ti,hwmods = "bb2d";
            clocks = <&dss_clkctrl DRA7_BB2D_CLKCTRL 0>;
            clock-names = "fck";
        };
```
