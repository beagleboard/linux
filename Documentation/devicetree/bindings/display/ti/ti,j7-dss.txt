## Documentation/devicetree/bindings/dma/ti/k3-udma.txt
```
* Texas Instruments K3 NAVSS Unified DMA – Peripheral Root Complex (UDMA-P)

The UDMA-P is intended to perform similar (but significantly upgraded) functions
as the packet-oriented DMA used on previous SoC devices. The UDMA-P module
supports the transmission and reception of various packet types. The UDMA-P is
architected to facilitate the segmentation and reassembly of SoC DMA data
structure compliant packets to/from smaller data blocks that are natively
compatible with the specific requirements of each connected peripheral. Multiple
Tx and Rx channels are provided within the DMA which allow multiple segmentation
or reassembly operations to be ongoing. The DMA controller maintains state
information for each of the channels which allows packet segmentation and
reassembly operations to be time division multiplexed between channels in order
to share the underlying DMA hardware. An external DMA scheduler is used to
control the ordering and rate at which this multiplexing occurs for Transmit
operations. The ordering and rate of Receive operations is indirectly controlled
by the order in which blocks are pushed into the DMA on the Rx PSI-L interface.

The UDMA-P also supports acting as both a UTC and UDMA-C for its internal
channels. Channels in the UDMA-P can be configured to be either Packet-Based or
Third-Party channels on a channel by channel basis.

Required properties:
--------------------
- compatible:		Should be
			"ti,am654-navss-main-udmap" for am654 main NAVSS UDMAP
			"ti,am654-navss-mcu-udmap" for am654 mcu NAVSS UDMAP
			"ti,j721e-navss-main-udmap" for j721e main NAVSS UDMAP
			"ti,j721e-navss-mcu-udmap" for j721e mcu NAVSS UDMAP
- #dma-cells:		Should be set to <3>.
			- The first parameter is a phandle to the remote PSI-L
			  endpoint
			- The second parameter is the thread offset within the
			  remote thread ID range
			- The third parameter is the channel direction.
- reg:			Memory map of UDMAP
- reg-names:		"gcfg", "rchanrt", "tchanrt"
- interrupt-parent:	phandle for "ti,sci-irq" irqchip
- ti,ringacc:		phandle for the ring accelerator node
- ti,psil-base:		PSI-L thread ID base of the UDMAP channels
- ti,sci:		phandle on TI-SCI compatible System controller node
- ti,sci-dev-id:	TI-SCI device id
- ti,sci-rm-range-tchan: UDMA tchan resource list in pairs of type and subtype
- ti,sci-rm-range-rchan: UDMA rchan resource list in pairs of type and subtype
- ti,sci-rm-range-rflow: UDMA rflow resource list in pairs of type and subtype

For PSI-L thread management the parent NAVSS node must have:
- ti,sci:		phandle on TI-SCI compatible System controller node
- ti,sci-dev-id:	TI-SCI device id of the NAVSS instance

Remote PSI-L endpoint

Required properties:
--------------------
- ti,psil-base:		PSI-L thread ID base of the endpoint

Within the PSI-L endpoint node thread configuration subnodes must present with:
ti,psil-configX naming convention, where X is the thread ID offset.

Configuration node Required properties:
--------------------
- linux,udma-mode:	Channel mode, can be:
			- UDMA_PKT_MODE: for Packet mode channels (peripherals)
			- UDMA_TR_MODE: for Third-Party mode

Configuration node Optional properties:
--------------------
- statictr-type:	In case the remote endpoint requires StaticTR
			configuration:
			- PSIL_STATIC_TR_XY: XY type of StaticTR
			- PSIL_STATIC_TR_MCAN: MCAN type of StaticTR
- enable-acc32:		Force 32 bit access on peripheral port. Only valid for
			XY type StaticTR, not supported on am654.
			Must be enabled for threads servicing McASP with AFIFO
			bypass mode.
- enable-burst:		Enable burst access on peripheral port. Only valid for
			XY type StaticTR, not supported on am654.
- ti,channel-tpl:	Channel Throughput level:
			0 / or not present - normal channel
			1 - High Throughput channel
			2 - Ultra High Throughput channel (j721e only)
- ti,needs-epib:	If the endpoint require EPIB to be present in the
			descriptor.
- ti,psd-size:		Size of the Protocol Specific Data section of the
			descriptor.
- ti,notdpkt:		The Teardown Completion Message on the thread must be
			suppressed.

Example:

main_navss: main_navss {
	compatible = "simple-bus";
	#address-cells = <2>;
	#size-cells = <2>;
	dma-coherent;
	dma-ranges;
	ranges;

	ti,sci = <&dmsc>;
	ti,sci-dev-id = <118>;

	main_udmap: udmap@31150000 {
		compatible = "ti,am654-navss-main-udmap";
		reg =	<0x0 0x31150000 0x0 0x100>,
			<0x0 0x34000000 0x0 0x100000>,
			<0x0 0x35000000 0x0 0x100000>;
		reg-names = "gcfg", "rchanrt", "tchanrt";
		#dma-cells = <3>;

		ti,ringacc = <&ringacc>;
		ti,psil-base = <0x1000>;

		interrupt-parent = <&main_udmass_inta>;

		ti,sci = <&dmsc>;
		ti,sci-dev-id = <188>;

		ti,sci-rm-range-tchan = <0x6 0x1>, /* TX_HCHAN */
					<0x6 0x2>; /* TX_CHAN */
		ti,sci-rm-range-rchan = <0x6 0x4>, /* RX_HCHAN */
					<0x6 0x5>; /* RX_CHAN */
		ti,sci-rm-range-rflow = <0x6 0x6>; /* GP RFLOW */
	};
};

pdma0: pdma@2a41000 {
	compatible = "ti,am654-pdma";
	reg = <0x0 0x02A41000 0x0 0x400>;
	reg-names = "eccaggr_cfg";

	ti,psil-base = <0x4400>;

	/* ti,psil-config0-2 */
	UDMA_PDMA_TR_XY(0);
	UDMA_PDMA_TR_XY(1);
	UDMA_PDMA_TR_XY(2);
};

mcasp0: mcasp@02B00000 {
...
	/* tx: pdma0-0, rx: pdma0-0 */
	dmas = <&main_udmap &pdma0 0 UDMA_DIR_TX>,
	       <&main_udmap &pdma0 0 UDMA_DIR_RX>;
	dma-names = "tx", "rx";
...
};
```

## Documentation/devicetree/bindings/drm/tilcdc/tilcdc.txt
```
Device-Tree bindings for tilcdc DRM driver

Required properties:
 - compatible: value should be "ti,am33xx-tilcdc".
 - interrupts: the interrupt number
 - reg: base address and size of the LCDC device

Recommended properties:
 - interrupt-parent: the phandle for the interrupt controller that
   services interrupts for this device.
 - ti,hwmods: Name of the hwmod associated to the LCDC

Optional properties:
 - max-bandwidth: The maximum pixels per second that the memory
   interface / lcd controller combination can sustain
 - max-width: The maximum horizontal pixel width supported by
   the lcd controller.
 - max-pixelclock: The maximum pixel clock that can be supported
   by the lcd controller in KHz.
 - bgrx_16bpp: Swap blue and red to work around the TI Sitara
   erratum -- some LCD capes for BeagleBone Black output BGR in
   16bpp mode so that 24 and 32bpp modes output "correct" color.
 - bgrx_24bpp: Swap blue and red to work around the TI Sitara
   erratum (should normally be used)

Example:

	fb: fb@4830e000 {
		compatible = "ti,am33xx-tilcdc";
		reg = <0x4830e000 0x1000>;
		interrupt-parent = <&intc>;
		interrupts = <36>;
		ti,hwmods = "lcdc";
		bgrx_24bpp;
		bgrx_16bpp;
	};
```

## Documentation/devicetree/bindings/edac/keystone-mc-edac.txt
```
* Keystone DDR3 Memory Controller EDAC device bindings

Keystone MC EDAC node is defined to describe the DDR3 memory controller
ECC error detection hardware. The hardware is capable of auto correcting
1 bit ECC errors. 2 bit ECC errors are uncorrectable and triggers an
interrupt and handled by the edac ecc error driver which currently enables
only interrupt for uncorrectable errors.

The following section describes the EDAC DT node binding.

Required properties:
- compatible		: Shall be "ti,keystone-ddr3-mc-edac"
- reg			: DDR3 MC base address
- interrupts		: ECC error interrupt
- interrupt-parent	: Interrupt controller node

Example:
	ddr3edac {
		compatible = "ti,keystone-ddr3-mc-edac";
		reg = <0x21010000 0x200>;
		interrupts = <GIC_SPI 448 IRQ_TYPE_EDGE_RISING>;
		interrupt-parent = <&gic>;
	};
```

## Documentation/devicetree/bindings/extcon/extcon-gpio.txt
```
GPIO based EXTCON

EXTCON GPIO
-----------

Required Properties:
 - compatible: should be:
   * "linux,extcon-gpio"
 - gpios: specifies the gpio pin used.

Optional Properties:
 - debounce: Debounce time for GPIO IRQ in ms


Eg:

	extcon1: am43_usbid_extcon1 {
		compatible = "linux,extcon-gpio";
		gpios = <&gpio3 12 GPIO_ACTIVE_HIGH>;
		debounce = <20>;
	};
```

## Documentation/devicetree/bindings/extcon/extcon-palmas.txt
```
EXTCON FOR PALMAS/TWL CHIPS

PALMAS USB COMPARATOR
Required Properties:
 - compatible: should contain one of:
   * "ti,palmas-usb-vid".
   * "ti,twl6035-usb-vid".
   * "ti,palmas-usb" (DEPRECATED - use "ti,palmas-usb-vid").
   * "ti,twl6035-usb" (DEPRECATED - use "ti,twl6035-usb-vid").

Optional Properties:
 - ti,wakeup : To enable the wakeup comparator in probe
 - ti,enable-id-detection: Perform ID detection using OTG core.
 - ti,enable-gpio-id-detection: Perform ID detection using GPIO.
 - ti,enable-vbus-detection: Perform VBUS detection.
 - id-gpio: gpio for GPIO ID detection. See gpio binding. Only required
	    if ti,enable-gpio-id-detection is present.

palmas-usb {
       compatible = "ti,twl6035-usb", "ti,palmas-usb";
       ti,wakeup;
};
```

## Documentation/devicetree/bindings/gpu/img,sgx530.yaml
```yaml
# SPDX-License-Identifier: GPL-2.0-only
%YAML 1.2
---
$id: http://devicetree.org/schemas/gpu/img,sgx530.yaml#
$schema: http://devicetree.org/meta-schemas/core.yaml#

title: Imagination SGX530 3D Graphics Processing Unit

maintainers:
  - Andrew Davis <afd@ti.com>

description: |
  SGX530 is a 3D Graphics Processing Unit from Imagination Technologies.
  SGX is codename for 5th generation / Series 5 of PowerVR chipset family.

properties:
  $nodename:
    pattern: '^gpu@[a-f0-9]+$'

  compatible:
    items:
      - enum:
          - ti,omap3530-sgx530  # TI OMAP35x
          - ti,omap3630-sgx530  # TI OMAP36x
          - ti,am3352-sgx530  # TI AM33x
          - ti,am4376-sgx530  # TI AM43x
      - const: img,sgx530

  reg:
    maxItems: 1

  interrupts:
    maxItems: 1

required:
  - compatible
  - reg
  - interrupts

additionalProperties: false

examples:
  - |
    #include <dt-bindings/interrupt-controller/irq.h>
    #include <dt-bindings/interrupt-controller/arm-gic.h>
    #include <dt-bindings/soc/ti,sci_pm_domain.h>
    gpu@56000000 {
      compatible = "ti,am4376-sgx530", "img,sgx530";
      reg = <0x56000000 0x10000>;
      interrupts = <GIC_SPI 37 IRQ_TYPE_LEVEL_HIGH>;
    };

...
```

## Documentation/devicetree/bindings/gpu/img,sgx540.yaml
```yaml
# SPDX-License-Identifier: GPL-2.0-only
%YAML 1.2
---
$id: http://devicetree.org/schemas/gpu/img,sgx540.yaml#
$schema: http://devicetree.org/meta-schemas/core.yaml#

title: Imagination SGX540 3D Graphics Processing Unit

maintainers:
  - Andrew Davis <afd@ti.com>

description: |
  SGX540 is a 3D Graphics Processing Unit from Imagination Technologies.
  SGX is codename for 5th generation / Series 5 of PowerVR chipset family.

properties:
  $nodename:
    pattern: '^gpu@[a-f0-9]+$'

  compatible:
    items:
      - enum:
          - ti,omap4430-sgx540  # TI OMAP443x
          - ti,omap4460-sgx540  # TI OMAP446x
      - const: img,sgx540

  reg:
    maxItems: 1

  interrupts:
    maxItems: 1

required:
  - compatible
  - reg
  - interrupts

additionalProperties: false

examples:
  - |
    #include <dt-bindings/interrupt-controller/irq.h>
    #include <dt-bindings/interrupt-controller/arm-gic.h>
    #include <dt-bindings/soc/ti,sci_pm_domain.h>
    gpu@0 {
       compatible = "ti,omap4430-sgx540", "img,sgx540";
       reg = <0x0 0x2000000>; /* 32MB */
       interrupts = <GIC_SPI 21 IRQ_TYPE_LEVEL_HIGH>;
    };

...
```

## Documentation/devicetree/bindings/gpu/img,sgx544.yaml
```yaml
# SPDX-License-Identifier: GPL-2.0-only
%YAML 1.2
---
$id: http://devicetree.org/schemas/gpu/img,sgx544.yaml#
$schema: http://devicetree.org/meta-schemas/core.yaml#

title: Imagination SGX544 3D Graphics Processing Unit

maintainers:
  - Andrew Davis <afd@ti.com>

description: |
  SGX544 is a 3D Graphics Processing Unit from Imagination Technologies.
  SGX is codename for 5th generation / Series 5 of PowerVR chipset family.

properties:
  $nodename:
    pattern: '^gpu@[a-f0-9]+$'

  compatible:
    items:
      - enum:
          - ti,omap4470-sgx544  # TI OMAP447x
          - ti,omap5432-sgx544  # TI OMAP543x
          - ti,dra7-sgx544  # TI DRA7xx / AM57x
          - ti,am654-sgx544  # TI AM654
      - const: img,sgx544

  reg:
    maxItems: 1

  interrupts:
    maxItems: 1

  power-domains:
    maxItems: 1

required:
  - compatible
  - reg
  - interrupts

additionalProperties: false

allOf:
  - if:
      properties:
        compatible:
          contains:
            const: ti,am654-sgx544
    then:
      properties:
        power-domains:
          minItems: 1
      required:
        - power-domains

examples:
  - |
    #include <dt-bindings/interrupt-controller/irq.h>
    #include <dt-bindings/interrupt-controller/arm-gic.h>
    #include <dt-bindings/soc/ti,sci_pm_domain.h>
    bus {
      #address-cells = <2>;
      #size-cells = <2>;
      gpu: gpu@7000000 {
        compatible = "ti,am654-sgx544", "img,sgx544";
        reg = <0x0 0x7000000 0x0 0x10000>;
        interrupts = <GIC_SPI 162 IRQ_TYPE_LEVEL_HIGH>;
        power-domains = <&k3_pds 65 TI_SCI_PD_EXCLUSIVE>;
      };
    };

...
```

## Documentation/devicetree/bindings/gpu/ti,dra7-bb2d.yaml
```yaml
# SPDX-License-Identifier: (GPL-2.0-only OR BSD-2-Clause)
%YAML 1.2
---
$id: http://devicetree.org/schemas/gpu/ti,dra7-bb2d.yaml#
$schema: http://devicetree.org/meta-schemas/core.yaml#

title: Texas Instruments BB2D blitter module

maintainers:
  - Gowtham Tammana <g-tammana@ti.com>

properties:
  compatible:
      const: ti,dra7-bb2d

  reg:
    maxItems: 1

  interrupts:
    maxItems: 1

  clock-names:
    items:
      - const: fck

  clocks:
    maxItems: 1

  ti,hwmods:
    description: TI hwmod name
    deprecated: true
    $ref: /schemas/types.yaml#/definitions/string-array
    items:
      const: bb2d

required:
  - compatible
  - reg
  - clocks
  - clock-names

additionalProperties: false

examples:
  - |
    #include <dt-bindings/interrupt-controller/irq.h>
    #include <dt-bindings/interrupt-controller/arm-gic.h>
    bb2d: bb2d@59000000 {
        compatible = "ti,dra7-bb2d";
        interrupts = <GIC_SPI 120 IRQ_TYPE_LEVEL_HIGH>;
        clocks = <&dss_clkctrl_0>;
        clock-names = "fck";
    };
```
