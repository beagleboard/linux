## Documentation/devicetree/bindings/soc/ti/k3-navss-ringacc.txt
```
* Texas Instruments K3 NavigatorSS Ring Accelerator

The Ring Accelerator (RA) is a machine which converts read/write accesses
from/to a constant address into corresponding read/write accesses from/to a
circular data structure in memory. The RA eliminates the need for each DMA
controller which needs to access ring elements from having to know the current
state of the ring (base address, current offset). The DMA controller
performs a read or write access to a specific address range (which maps to the
source interface on the RA) and the RA replaces the address for the transaction
with a new address which corresponds to the head or tail element of the ring
(head for reads, tail for writes).

The Ring Accelerator is a hardware module that is responsible for accelerating
management of the packet queues. The K3 SoCs can have more than one RA instances

Required properties:
- compatible	: Must be "ti,am654-navss-ringacc";
- reg		: Should contain register location and length of the following
		  named register regions.
- reg-names	: should be
		  "rt" - The RA Ring Real-time Control/Status Registers
		  "fifos" - The RA Queues Registers
		  "proxy_gcfg" - The RA Proxy Global Config Registers
		  "proxy_target" - The RA Proxy Datapath Registers
- ti,num-rings	: Number of rings supported by RA

Optional properties:
 -- ti,gp-rings	: defines general purpose range of rings. Pair of values:
		  first ring in range and range size.
		  Each range of rings defined as pair of values: first ring id
		  in range and number of rings in range.
 -- ti,dma-ring-reset-quirk : enable ringacc / udma ring state interoperability
		  issue software w/a
 -- ti,sci : phandle on TI-SCI compatible System controller node
 -- ti,sci-dev-id : TI-SCI device id

Example:

ringacc: ringacc@3c000000 {
	compatible = "ti,am654-navss-ringacc";
	reg =	<0x0 0x3c000000 0x0 0x400000>,
		<0x0 0x38000000 0x0 0x400000>,
		<0x0 0x31120000 0x0 0x100>,
		<0x0 0x33000000 0x0 0x40000>;
	reg-names = "rt", "fifos",
		    "proxy_gcfg", "proxy_target";
	ti,num-rings = <818>;
	ti,gp-rings = <302 466>; /* start, cnt */
	ti,dma-ring-reset-quirk;
	ti,sci = <&dmsc>;
	ti,sci-dev-id = <187>;
};

client:

dma_ipx: dma_ipx@<addr> {
	...
	ti,ringacc = <&ringacc>;
	...
}
```

## Documentation/devicetree/bindings/soc/ti/keystone-dsp-mem.txt
```
TI Keystone DSP Memory Mapping
==============================

Binding status: Unstable - ABI compatibility may be broken in the future

The Keystone DSP Memory Mapping binding defines the memory regions that
are reserved to be used with DSPs. These regions can be mapped into
userspace for providing direct user-mode access to these regions for the
purposes of shared memory communication with the DSP remote processor
devices on the SoC. These memory regions can also be used for supporting
user-space based loading of the DSP remoteproc devices.

The memory regions can either be from regular DDR memory or from the
On-chip RAM, and there can be one or more regions of each memory type.

DDR Memory usage (Optional):
----------------------------
One or more memory regions from DDR memory can be reserved specifically
to be used by the DSPs on the SoC. Each region should be defined as a
child node of the reserved-memory node with the following required
properties:

- compatible : Should be "ti,keystone-dsp-mem-pool"
- reg        : Should contain the region's start address and size following
               the #address-cells and #size-cells defined in the parent
               reserved-memory node.
- no-map     : Should be defined to remove this region from kernel

Please see Documentation/devicetree/bindings/reserved-memory/reserved-memory.txt
for more details on reserved-memory node.

SRAM usage (Optional):
----------------------
The On-chip Multicore Shared Memory (MSM) RAM can also be exposed to
userspace by defining specific child nodes under the corresponding parent
SRAM node. The generic SRAM binding is as per the binding document
Documentation/devicetree/bindings/misc/sram.txt. Following properties
should be used in each corresponding child node for the userspace mapping
usecase:

- compatible : Should be "ti,keystone-dsp-msm-ram"
- reg        : Should contain a pair of values for the address and size
               of the region, following the parent-child ranges convention.

Example:
--------
	/* 66AK2H EVM */
	reserved-memory {
		#address-cells = <2>;
		#size-cells = <2>;
		ranges;

		dsp_common_mpm_memory: dsp-common-mpm-memory@820000000 {
			compatible = "ti,keystone-dsp-mem-pool";
			reg = <0x00000008 0x20000000 0x00000000 0x20000000>;
			no-map;
		};
	};

	soc {
		msm_ram: msmram@c000000 {
			compatible = "mmio-sram";
			reg = <0x0c000000 0x600000>;
			ranges = <0x0 0x0c000000 0x600000>;
			#address-cells = <1>;
			#size-cells = <1>;

			mpm-sram@0 {
				compatible = "ti,keystone-dsp-msm-ram";
				reg = <0x0 0x80000>;
			};
		};
	};
```

## Documentation/devicetree/bindings/soc/ti/sci-pm-domain.txt
```
Texas Instruments TI-SCI Generic Power Domain
---------------------------------------------

Some TI SoCs contain a system controller (like the PMMC, etc...) that is
responsible for controlling the state of the IPs that are present.
Communication between the host processor running an OS and the system
controller happens through a protocol known as TI-SCI [1]. This pm domain
implementation plugs into the generic pm domain framework and makes use of
the TI SCI protocol power on and off each device when needed.

[1] Documentation/devicetree/bindings/arm/keystone/ti,sci.txt

PM Domain Node
==============
The PM domain node represents the global PM domain managed by the PMMC,
which in this case is the single implementation as documented by the generic
PM domain bindings in Documentation/devicetree/bindings/power/power_domain.txt.

Required Properties:
--------------------
- compatible: should be "ti,sci-pm-domain"
- #power-domain-cells: Must be 0.
- ti,sci: Phandle to the TI SCI device to use for managing the devices.

Example:
--------------------
k2g_pds: k2g_pds {
        compatible = "ti,sci-pm-domain";
        #power-domain-cells = <0>;
        ti,sci = <&pmmc>;
};

PM Domain Consumers
===================
Hardware blocks that require SCI control over their state must provide
a reference to the sci-pm-domain they are part of and a unique device
specific ID that identifies the device.

Required Properties:
--------------------
- power-domains: phandle pointing to the corresponding PM domain node.
- ti,sci-id: index representing the device id to be passed oevr SCI to
	     be used for device control.

See dt-bindings/genpd/k2g.h for the list of valid identifiers for k2g.

Example:
--------------------
uart0: serial@02530c00 {
	compatible = "ns16550a";
	...
	power-domains = <&k2g_pds>;
	ti,sci-id = <K2G_DEV_UART0>;
};
```

## Documentation/devicetree/bindings/soc/ti/ti,j721e-pat.yaml
```yaml
# SPDX-License-Identifier: GPL-2.0-only OR BSD-2-Clause
# Copyright (C) 2020 Texas Instruments Incorporated - https://www.ti.com/
%YAML 1.2
---
$id: http://devicetree.org/schemas/misc/ti,j721e-pat.yaml#
$schema: http://devicetree.org/meta-schemas/core.yaml#

title: Texas Instruments Page-based Address Translator (PAT) bindings

description: |
  A Page-based Address Translator (PAT) device performs address translation
  using tables stored in an internal SRAM. Each PAT supports a set number of
  pages, each occupying a programmable 4KB, 16KB, 64KB, or 1MB of addresses
  in a window for which an incoming transaction will be translated.

maintainers:
  - Andrew Davis <afd@ti.com>

properties:
  compatible:
    const: ti,j721e-pat

  reg:
    items:
      - description: Memory mapped registers region
      - description: Location of the table of translation pages

  reg-names:
    items:
      - const: mmrs
      - const: table

  ti,pat-window-base:
    maxItems: 1
    description: Base address of window translated by this PAT

  ti,pat-window-size:
    maxItems: 1
    description: Size of window translated by this PAT

required:
  - compatible
  - reg
  - reg-names
  - ti,pat-window-base
  - ti,pat-window-size

additionalProperties: false

examples:
  - |
    pat@31010000 {
     compatible = "ti,j721e-pat";
     reg = <0x00 0x31010000 0x00 0x00000100>,
           <0x00 0x36400000 0x00 0x00040000>;
     reg-names = "mmrs",
                 "table";
     ti,pat-window-base = <0x48 0x00000000>;
     ti,pat-window-size = <0x00 0x40000000>;
   };
```
