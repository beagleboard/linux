## Documentation/devicetree/bindings/reset/syscon-reset.txt
```
SysCon Reset Controller
=======================

Almost all SoCs have hardware modules that require reset control in addition
to clock and power control for their functionality. The reset control is
typically provided by means of memory-mapped I/O registers. These registers are
sometimes a part of a larger register space region implementing various
functionalities. This register range is best represented as a syscon node to
allow multiple entities to access their relevant registers in the common
register space.

A SysCon Reset Controller node defines a device that uses a syscon node
and provides reset management functionality for various hardware modules
present on the SoC.

SysCon Reset Controller Node
============================
Each of the reset provider/controller nodes should be a child of a syscon
node and have the following properties.

Required properties:
--------------------
 - compatible		: Should be "syscon-reset"
 - #reset-cells		: Should be 1. Please see the reset consumer node below
			  for usage details
 - #address-cells	: Should be 1
 - #size-cells		: Should be 0

SysCon Reset Child Node
============================
Each reset provider/controller node should have a child node for each reset
it would like to expose to consumers.

Required properties:
--------------------
 - reg			: Reset's logical number, this value will be used by
			  consumers of this reset as their reset specifier value
 - reset-control	: Contains the reset control register information,
			  Should contain 3 cells defined as:
			    Cell #1 : register offset of the reset
			              control/status register from the syscon
			              register base
			    Cell #2 : bit shift value for the reset in the
			              respective reset control/status register
			    Cell #3 : polarity of the reset bit, should use the
				      definitions defined in the DT include file
					include/dt-bindings/reset/syscon.h
				      Should be RESET_ASSERT_SET for resets
				      that are asserted when the bit is set,
				      and RESET_ASSERT_CLEAR for resets that
				      are asserted when the bit is cleared.

Optional properties:
--------------------
 - reset-status		: Contains the reset status register information. The
			  contents of this property are the equivalent to
			  reset-control as defined above. If this property is
			  not present and the toggle flag is not set, the
			  reset register is assumed to be the same as the
			  control register
 - toggle		: Mark this reset as a toggle only reset, this is used
			  when no status register is available.

SysCon Reset Consumer Nodes
===========================
Each of the reset consumer nodes should have the following properties,
in addition to their own properties.

Required properties:
--------------------
 - resets	: A phandle and a reset specifier, the reset specifier should
		  be a numerical address matching the desired reset as set
		  by the reg property defined above.

Please also refer to Documentation/devicetree/bindings/reset/reset.txt for
common reset controller usage by consumers.

Example:
--------
The following example demonstrates a syscon node, the reset controller node
using the syscon node, and a consumer (a DSP device) on the TI Keystone 2
Edison SoC.

/ {
	soc {
		psc: power-sleep-controller@02350000 {
			compatible = "syscon", "simple-mfd";
			reg = <0x02350000 0x1000>;

			pscrst: psc-reset {
				compatible = "syscon-reset";
				#reset-cells = <1>;
				#address-cells = <1>;
				#size-cells = <0>;

				dsp@0 {
					reg = <0>;
					reset-control = <0xa3c 8 RESET_ASSERT_CLEAR>;
					reset-status = <0x83c 8 RESET_ASSERT_CLEAR>;
				};
			};
		};

		dsp0: dsp0 {
			...
			resets = <&pscrst 0>;
			...
		};
	};
};
```

## Documentation/devicetree/bindings/reset/ti,sci-reset.txt
```
Texas Instruments System Control Interface (TI-SCI) Reset Controller
=====================================================================

Some TI SoCs contain a system controller (like the Power Management Micro
Controller (PMMC) on Keystone K2G SoC) that are responsible for controlling
the state of the various hardware modules present on the SoC. Communication
between the host processor running an OS and the system controller happens
through a protocol called TI System Control Interface (TI-SCI protocol).
For TI SCI details, please refer to the document,
Documentation/devicetree/bindings/arm/keystone/ti,sci.txt

TI-SCI Reset Controller Node
============================
This reset controller node uses the TI SCI protocol to perform the reset
management of various hardware modules present on the SoC. Must be a child
node of the associated TI-SCI system controller node.

Required properties:
--------------------
 - compatible	: Should be "ti,sci-reset"
 - #reset-cells	: Should be 2. Please see the reset consumer node below for
		  usage details.

TI-SCI Reset Consumer Nodes
===========================
Each of the reset consumer nodes should have the following properties,
in addition to their own properties.

Required properties:
--------------------
 - resets	: A phandle and reset specifier pair, one pair for each reset
		  signal that affects the device, or that the device manages.
		  The phandle should point to the TI-SCI reset controller node,
		  and the reset specifier should have 2 cell-values. The first
		  cell should contain the device ID, the values of which are
		  specified in the <dt-bindings/genpd/<soc>.h> include file.
		  The second cell should contain the reset mask value used by
		  system controller, the values of which are specified in the
		  include file <dt-bindings/reset/<soc>.h>, where <soc> is the
		  name of the SoC involved, for example 'k2g'.

Please also refer to Documentation/devicetree/bindings/reset/reset.txt for
common reset controller usage by consumers.

Example:
--------
The following example demonstrates both a TI-SCI reset controller node and a
consumer (a DSP device) on the K2G SoC.

#include <dt-bindings/genpd/k2g.h>
#include <dt-bindings/reset/k2g.h>

pmmc: pmmc {
	compatible = "ti,k2g-sci";

	k2g_reset: reset-controller {
		compatible = "ti,sci-reset";
		#reset-cells = <2>;
	};
};

dsp0: dsp0 {
	...
	resets = <&k2g_reset K2G_DEV_CGEM0 K2G_DEV_CGEM0_DSP0_RESET>;
	...
};
```

## Documentation/devicetree/bindings/serial/keystone-uart.txt
```
Keystone UART controller

Required properties:
- compatible : should be "ti,keystone-uart" for K2G, K2E, K2L and K2HL
               controllers

See Documentation/devicetree/bindings/serial/8250.txt for other required
and optional properties.

Example:

	uart1: serial@02531000 {
		compatible = "ti,keystone-uart", "ns16550a";
		current-speed = <115200>;
		reg-shift = <2>;
		reg-io-width = <4>;
		reg = <0x02531000 0x100>;
		interrupts = <GIC_SPI 165 IRQ_TYPE_EDGE_RISING>;
		status = "disabled";
		power-domains = <&k2g_pds K2G_DEV_UART1>;
		clocks = <&k2g_clks K2G_DEV_UART1 0>;
		clock-names = "fck";
	};
```

## Documentation/devicetree/bindings/serial/omap_serial.txt
```
OMAP UART controller

Required properties:
- compatible : should be "ti,omap2-uart" for OMAP2 controllers
- compatible : should be "ti,omap3-uart" for OMAP3 controllers
- compatible : should be "ti,omap4-uart" for OMAP4 controllers
- compatible : should be "ti,am3352-uart" for AM335x controllers

Optional properties:
- clock-frequency : frequency of the clock input to the UART
```

## Documentation/devicetree/bindings/serial/pru-suart.txt
```
PRU Software UART on TI SoCs

The PRU can be programmed as multi-ports UART.

Each PRU SUART node should define the PRU Application node properties as
detailed in bindings ti,pru-rproc.txt and one or more port nodes describing
the emulated UART port(s).

Required properties:
--------------------
- compatible           : should be "ti,pru-soft-uart".
- interrupt-parent     : phandle to the PRUSS INTC node.
- prus                 : phandle to the PRU node used.
- firmware-name        : software UART firmware for the PRU core.
- ti,pru-interrupt-map : PRU interrupt mappings, see ti,pru-rproc.txt for
                         details. The number of the entries in the array
                         should match the number of the port nodes.

UART Port Node
==============
Required properties:
--------------------
- reg               : index of the port, 0-based.
- interrupts        : interrupt specifier for PRU signaling the host. The
                      property should match the event defined in
                      ti,pru-interrupt-map property.
- ti,pru-suart-pins : PRU pin mapping for UART signals, containing a single
                      entry of 2 or 4 byte cell-values. The first two values
		      are for txd and rxd pins, the next two values are
		      optional which are for cts and rts pins. The value is
		      the index of the PRU GPIOs defined in PRU R30 and R31.

Example (AM335x BeagleBone Black board):
---------------------------------------

	pru_suart0 {
		compatible = "ti,pru-soft-uart";
		interrupt-parent = <&pruss_intc>;
		prus = <&pru0>;
		firmware-name = "ti-pruss/pru0_swuart-fw.out";
		ti,pru-interrupt-map = <0 21 2 2 >, <0 22 3 3>, <0 23 4 4>;
		pinctrl-0 = <&pru_uart0_bone_pins>;
		pinctrl-names = "default";
		#address-cells = <1>;
		#size-cells = <0>;

		pru0_port0: port@0 {
			reg = <0>;
			interrupts = <21>;
			ti,pru-suart-pins = /bits/ 8 <0 1>;
		};
		pru0_port1: port@1 {
			reg = <1>;
			interrupts = <22>;
			ti,pru-suart-pins = /bits/ 8 <2 3 4 5>;
		};
		pru0_port2: port@2 {
			reg = <2>;
			interrupts = <23>;
			ti,pru-suart-pins = /bits/ 8 <8 9 10 11>;
		};
	};
```

## Documentation/devicetree/bindings/serial/ti,pru-swuart.txt
```
PRU Software UART on TI SoCs

The PRU can be programmed as multi-ports UART.

Each PRU Software UART (SWUART) node should define the PRU Application node
properties as detailed in bindings ti,pru-consumer.yaml and one or more port
nodes describing the emulated UART port(s).

Required properties:
--------------------
- compatible           : should be "ti,pru-swuart".
- interrupt-parent     : phandle to the PRUSS INTC node.
- ti,prus              : phandle to the PRU node used.
- firmware-name        : SWUART firmware for the PRU core.

UART Port Node
==============
Required properties:
--------------------
- reg                : index of the port, 0-based.
- interrupts         : interrupt specifier for PRU signaling the host,
		       containing an single entry of 3 cell-values.
		       The First one is the PRU System Event id.
		       The second is the PRU interrupt channel id.
		       The third is the PRU host interrupt id.
- ti,pru-swuart-pins : PRU pin mapping for UART signals, containing a single
                       entry of 2 or 4 byte cell-values. The first two values
		       are for txd and rxd pins, the next two values are
		       optional which are for cts and rts pins. The value is
		       the index of the PRU GPIOs defined in PRU R30 and R31.

Example (AM335x BeagleBone Black board):
---------------------------------------

	pru-swuart0 {
		compatible = "ti,pru-swuart";
		interrupt-parent = <&pruss_intc>;
		ti,prus = <&pru0>;
		firmware-name = "ti-pruss/pru0_swuart-fw.out";
		pinctrl-0 = <&pru_uart0_bone_pins>;
		pinctrl-names = "default";
		#address-cells = <1>;
		#size-cells = <0>;

		pru0_port0: port@0 {
			reg = <0>;
			interrupts = <21 2 2>;
			ti,pru-swuart-pins = /bits/ 8 <0 1>;
		};
		pru0_port1: port@1 {
			reg = <1>;
			interrupts = <22 3 3>;
			ti,pru-swuart-pins = /bits/ 8 <2 3 4 5>;
		};
		pru0_port2: port@2 {
			reg = <2>;
			interrupts = <23 4 4>;
			ti,pru-swuart-pins = /bits/ 8 <8 9 10 11>;
		};
	};
```

## Documentation/devicetree/bindings/serial/ti,pruss-uart.yaml
```yaml
# SPDX-License-Identifier: (GPL-2.0-only OR BSD-2-Clause)
%YAML 1.2
---
$id: http://devicetree.org/schemas/serial/ti,pruss-uart.yaml#
$schema: http://devicetree.org/meta-schemas/core.yaml#

title: TI PRUSS serial UART

maintainers:
  - Bin Liu <b-liu@ti.com>

description: |
  The PRU-ICSS module has a serial UART peripheral, which is based on
  industry standard TL16C550, with 16-bytes TX/RX FIFOs.

allOf:
  - $ref: /schemas/serial.yaml#

properties:
  compatible:
    items:
      - const: ti,pruss-uart

  reg:
    maxItems: 1

  clocks:
    maxItems: 1

  interrupts:
    minItems: 3
    maxItems: 3
    description: |
      PRU UART interrupt mappings, containing an entry of 3 cell-values.
      The first is the PRU System Event id for PRU UART Interrupt Request.
      The second is the PRU interrupt channel id.
      The third is the PRU host interrupt id.

required:
  - compatible
  - reg
  - clocks
  - interrupt-parent
  - interrupts

examples:
  - |
    pruss_uart: serial@28000 {
        compatible = "ti,pruss-uart";
        reg = <0x28000 0x38>;
        clocks = <&dpll_per_m2_ck>;
        interrupt-parent = <&pruss_intc>;
        interrupts = <6 2 2>;
    };
```

## Documentation/devicetree/bindings/soc/thead/light-iopmp.txt
```
* Thead light family IOPMP

Light family includes support SoC level IOPMP to limit master
access permission. It supports multiple valid iopmp regions configuration,
iopmp bypass, and only set default iopmp region.

Required Properties:
  - compatible: should be one of the following.
      * thead,light-iopmp - for light iopmp.

Example:

#include <include/dt-bindings/soc/thead,light-iopmp.h>

iopmp {
	compatible = "thead,light-iopmp";

	/* config#1: multiple valid regions */
	iopmp_emmc: IOPMP_EMMC {
		regions = <0x0 0x100000>,
			  <0x100000 0x200000>;
		attr = <0xFFFFFFFF>;
		dummy_slave= <0x800000>;
	};

	/* config#2: iopmp bypass */
	iopmp_sdio0: IOPMP_SDIO0 {
		bypass_en;
	};

	/* config#3: iopmp default region set */
	iopmp_sdio1: IOPMP_SDIO1 {
		attr = <0xFFFFFFFF>;
		is_default_region;
	};

	...
};
```

## Documentation/devicetree/bindings/soc/ti/k3-navss-psilcfg.txt
```
* Texas Instruments K3 NavigatorSS PSI-L (Packet Streaming Interface Link)


The PSI-L is used to transfer words of packet data and control information
between two peer entities via direct connection. There are credits used for flow
control to guarantee that blocking does not occur between threads. Multiple
packet transfers can be ongoing simultaneously across a PSI-L interface each
on a separate logical thread but all sharing a single datapath through time
division multiplexing. Each packet which is transferred is accompanied by a
destination thread ID which indicates the logical destination thread to which
the packet is being sent.

Required properties:
- compatible:		Must be "ti,k3-navss-psilcfg";
- ti,sci:		phandle on TI-SCI compatible System controller node
- ti,sci-dev-id:	TI-SCI device id

Example:

navss256: navss256@30000000 {
	compatible = "ti,k3-navss256","simple-bus";
	...
	psilcfg: psilcfg@30001000 {
		compatible = "ti,k3-navss-psilcfg";

		ti,sci = <&dmsc>;
		ti,sci-dev-id = <118>;
	};
};

client:

dma_ipx: dma_ipx@<addr> {
	...
	ti,psi-proxy = <&psilcfg>;
	...
}
```
