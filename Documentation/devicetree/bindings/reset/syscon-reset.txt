## Documentation/devicetree/bindings/soc/ti/wkup_m3_ipc.txt
```
Wakeup M3 IPC Driver
=====================

The TI AM33xx and AM43xx family of devices use a small Cortex M3 co-processor
(commonly referred to as Wakeup M3 or CM3) to help with various low power tasks
that cannot be controlled from the MPU, like suspend/resume and certain deep
C-states for CPU Idle. Once the wkup_m3_ipc driver uses the wkup_m3_rproc driver
to boot the wkup_m3, it handles communication with the CM3 using IPC registers
present in the SoC's control module and a mailbox. The wkup_m3_ipc exposes an
API to allow the SoC PM code to execute specific PM tasks.

Wkup M3 Device Node:
====================
A wkup_m3_ipc device node is used to represent the IPC registers within an
SoC.

Required properties:
--------------------
- compatible:		Should be,
				"ti,am3352-wkup-m3-ipc" for AM33xx SoCs
				"ti,am4372-wkup-m3-ipc" for AM43xx SoCs
- reg:			Contains the IPC register address space to communicate
			with the Wakeup M3 processor
- interrupts:		Contains the interrupt information for the wkup_m3
			interrupt that signals the MPU.
- ti,rproc:		phandle to the wkup_m3 rproc node so the IPC driver
			can boot it.
- mboxes:		phandles used by IPC framework to get correct mbox
			channel for communication. Must point to appropriate
			mbox_wkupm3 child node.

Example:
--------
/* AM33xx */
	l4_wkup: l4_wkup@44c00000 {
		...

		scm: scm@210000 {
			compatible = "ti,am3-scm", "simple-bus";
			reg = <0x210000 0x2000>;
			#address-cells = <1>;
			#size-cells = <1>;
			ranges = <0 0x210000 0x2000>;

			...

			wkup_m3_ipc: wkup_m3_ipc@1324 {
				compatible = "ti,am3352-wkup-m3-ipc";
				reg = <0x1324 0x24>;
				interrupts = <78>;
				ti,rproc = <&wkup_m3>;
				mboxes = <&mailbox &mbox_wkupm3>;
			};

			...
		};
	};

Support for VTT Toggle
==================================
In order to enable the support for VTT toggle during Suspend/Resume
sequence needed by some boards (like AM335x EVM-SK & AM437x GP EVM),
the below DT properties are required. It is possible to toggle VTT
using one of two methods depending on the SoC being used, either
GPIO0 toggle (AM335x and AM437x), or any GPIO with DS_PAD_CONFIG
bits in the control module (AM437x only).

VTT Toggle using GPIO0
----------------------------------
Supported by: AM335x and AM437x
Used on: AM335x EVM-SK

Optional properties:
- ti,needs-vtt-toggle:	Indicates that the boards requires VTT toggling
			during suspend/resume.
- ti,vtt-gpio-pin:	Specifies the GPIO0 pin used for VTT toggle.

Important Note:
- Here it is assumed that VTT Toggle will be done using a pin on GPIO-0 Instance.
  It will not work on any other GPIO using the above properties, regardless of
  which part is being used.

Example:
	wkup_m3_ipc: wkup_m3_ipc@1324 {
		compatible = "ti,am3352-wkup-m3-ipc";
		...
		...
		ti,needs-vtt-toggle;
		ti,vtt-gpio-pin = <7>;
		...
	};


IO Isolation
============
Supported by: AM43xx SoCs

It is possible to configure any pin with a corresponding CTRL_CONF_*
register in the control module to use the states defined in the DS_PAD_CONFIG
bits by enabling IO isolation on the SoC. The 'ti,set-io-isolation' property
tells the wkup_m3_ipc driver to enable IO isolation late in the suspend path
after all drivers have been disabled.

Optional properties:
- ti,set-io-isolation:	Indicates that the IO's should be placed into
			isolation and the DS_PAD_CONFIG values should be
			used during suspend.

Example (VTT Toggle using any GPIO on am437x-gp-evm):
-----------------------------------------------------

On the AM437x GP EVM, the VTT enable line must be held low to disable VTT
regulator and held high to enable, so the following pinctrl entry is used.
The DS pull is enabled which uses a pull down by default and DS off mode is
used which outputs a low by default. For the normal state, a pull up is
specified so that the VTT enable line gets pulled high immediately after
the DS states are removed upon exit from DeepSleep0.

	&am43xx_pinmux {
		pinctrl-names = "default";
		pinctrl-0 = <&ddr3_vtt_toggle_default>;

		ddr3_vtt_toggle_default: ddr_vtt_toggle_default {
		pinctrl-single,pins = <
			0x25C (DS0_PULL_UP_DOWN_EN | PIN_OUTPUT_PULLUP |
			       DS0_FORCE_OFF_MODE | MUX_MODE7)>;
		};
		...
	};

	wkup_m3_ipc: wkup_m3_ipc@1324 {
		compatible = "ti,am4372-wkup-m3-ipc";
		...
		...
		ti,set-io-isolation;
		...
	};
```

## Documentation/devicetree/bindings/sound/ti,j721e-cpb-audio.txt
```
* Audio support for j721e Common Processor Board

The audio support on the board is using pcm3168a codec connected to McASP10
serializers in parallel setup.
The pcm3168a SCKI clock is coming via the j721e AUDIO_REFCLK2 pin.
In order to support 48KHz and 44.1KHz family of sampling rates the parent clock
for AUDIO_REFCLK2 needs to be changed between PLL4 (for 48KHz) and PLL15 (for
44.1KHz). The same PLLs are used for McASP10's AUXCLK clock via different
HSDIVIDER.

Required properties:
- compatible : "ti,j721e-cpb-audio"
- ti,model : Sound card name, should be "j721e-cpb-analog"
- ti,cpb-mcasp : phandle to McASP10
- ti,cpb-codec : phandle to the pcm3168a codec on the CPB
- clocks : Must contain an entry for each entry in clock-names.
- clock-names : Must include the following entries:
		"pll4" (PLL4 clock)
		"pll15" (PLL15 clock)
		"cpb-mcasp" (McASP10 auxclk clock)
		"cpb-mcasp-48000" (PLL4_HSDIV0 parent for McASP10 auxclk)
		"cpb-mcasp-44100" (PLL15_HSDIV0 parent for McASP10 auxclk)
		"audio-refclk2" (AUDIO_REFCLK2 clock)
		"audio-refclk2-48000" (PLL4_HSDIV2 parent for AUDIO_REFCLK2
				       clock)
		"audio-refclk2-44100" (PLL15_HSDIV2 parent for AUDIO_REFCLK2
				       clock)

Example:

sound0: sound@0 {
	compatible = "ti,j721e-cpb-audio";
	ti,model = "j721e-cpb-analog";

	status = "okay";

	ti,cpb-mcasp = <&mcasp10>;
	ti,cpb-codec = <&pcm3168a_1>;

	clocks = <&pll4>, <&pll15>,
		 <&k3_clks 184 1>,
		 <&k3_clks 184 2>, <&k3_clks 184 4>,
		 <&k3_clks 157 371>,
		 <&k3_clks 157 400>, <&k3_clks 157 401>;
	clock-names = "pll4", "pll15",
		      "cpb-mcasp",
		      "cpb-mcasp-48000", "cpb-mcasp-44100",
		      "audio-refclk2",
		      "audio-refclk2-48000", "audio-refclk2-44100";
};
```

## Documentation/devicetree/bindings/sound/ti,j721e-cpb-ivi-audio.txt
```
* Audio support for j721e Infotainment Expansion Board

The Infotainment board plugs into the Common Processor Board, the support of the
extension board is extending the CPB audio support, decribed in:
sound/ti,j721e-cpb-audio.txt

The audio support on the Infotainment Expansion Board consists of McASP0
connected to two pcm3168a codecs with dedicated set of serializers to each.
The SCKI for pcm3168a is sourced from j721e AUDIO_REFCLK0 pin.

In order to support 48KHz and 44.1KHz family of sampling rates the parent clock
for AUDIO_REFCLK0 needs to be changed between PLL4 (for 48KHz) and PLL15 (for
44.1KHz). The same PLLs are used for McASP0's AUXCLK clock via different
HSDIVIDER.

Note: the same PLL4 and PLL15 is used by the audio support on the CPB!

Required properties:
- compatible : "ti,j721e-cpb-ivi-audio" for separate PCMs for each codec
	       "ti,j721e-cpb-ivi-multicodec-audio" for single PCM stream for the
						   IVI card
	       "ti,j721e-cpb-ivi-dpcm-audio" for single PCM stream for the
					     IVI card with DPCM

- ti,model : Sound card name, should be "j721e-cpb-ivi-analog" or
	     "j721e-cpb-ivi-multicodec-analog" or "j721e-cpb-ivi-dpcm-analog"
- ti,ivi-mcasp : phandle to McASP0
- ti,ivi-codec-a : phandle to the pcm3168a-A codec on the expansion board
- ti,ivi-codec-b : phandle to the pcm3168a-B codec on the expansion board
- clocks : Must contain an entry for each entry in clock-names.
- clock-names : Must include the following entries:
		"pll4" (PLL4 clock)
		"pll15" (PLL15 clock)
		"cpb-mcasp" (McASP10 auxclk clock)
		"cpb-mcasp-48000" (PLL4_HSDIV0 parent for McASP10 auxclk)
		"cpb-mcasp-44100" (PLL15_HSDIV0 parent for McASP10 auxclk)
		"audio-refclk2" (AUDIO_REFCLK2 clock)
		"audio-refclk2-48000" (PLL4_HSDIV2 parent for AUDIO_REFCLK2
				       clock)
		"audio-refclk2-44100" (PLL15_HSDIV2 parent for AUDIO_REFCLK2
				       clock)
		"ivi-mcasp" (McASP0 auxclk clock)
		"ivi-mcasp-48000" (PLL4_HSDIV0 parent for McASP0 auxclk)
		"ivi-mcasp-44100" (PLL15_HSDIV0 parent for McASP0 auxclk)
		"audio-refclk0" (AUDIO_REFCLK0 clock)
		"audio-refclk0-48000" (PLL4_HSDIV2 parent for AUDIO_REFCLK0
				       clock)
		"audio-refclk0-44100" (PLL15_HSDIV2 parent for AUDIO_REFCLK0
				       clock)

Example:

sound0: sound@0 {
	compatible = "ti,j721e-cpb-ivi-multicodec-audio";
	ti,model = "j721e-cpb-ivi-multicodec-analog";

	status = "okay";

	ti,cpb-mcasp = <&mcasp10>;
	ti,cpb-codec = <&pcm3168a_1>;

	ti,ivi-mcasp = <&mcasp0>;
	ti,ivi-codec-a = <&pcm3168a_a>;
	ti,ivi-codec-b = <&pcm3168a_b>;

	clocks = <&pll4>, <&pll15>,
		 <&k3_clks 184 1>,
		 <&k3_clks 184 2>, <&k3_clks 184 4>,
		 <&k3_clks 157 371>,
		 <&k3_clks 157 400>, <&k3_clks 157 401>,
		 <&k3_clks 174 1>,
		 <&k3_clks 174 2>, <&k3_clks 174 4>,
		 <&k3_clks 157 301>,
		 <&k3_clks 157 330>, <&k3_clks 157 331>;
	clock-names = "pll4", "pll15",
		      "cpb-mcasp",
		      "cpb-mcasp-48000", "cpb-mcasp-44100",
		      "audio-refclk2",
		      "audio-refclk2-48000", "audio-refclk2-44100",
		      "ivi-mcasp",
		      "ivi-mcasp-48000", "ivi-mcasp-44100",
		      "audio-refclk0",
		      "audio-refclk0-48000", "audio-refclk0-44100";
};
```

## Documentation/devicetree/bindings/staging/android/ion/ti,ion.txt
```
Texas Instruments ION heap declaration binding

Describes heaps and the associated memory. Each child node provides
information about a single heap. Only chunk and carveout heaps are currently
supported. CMA and system heaps are automatically generated when enabled.

Required Properties:
 - compatible:		Must be "ti,ion"

Required child node properties:
 - memory-region:	A phandle to the reserved memory node that backs this
			heap. The reserved memory node can be a CMA memory
			node, and should be defined as per the bindings in
			Documentation/devicetree/bindings/reserved-memory/reserved-memory.txt

 - ion-heap-type:	Heap type ID as defined by uapi/ion.h

Required child node properties for chunk heaps:
 - ion-chunk-size:	Size of each allocation pool, allocation will only
			be made in granules of this size to prevent
			fragmentation

Example:

ion {
	compatible = "ti,ion";
	ti_chunk_heap_0 {
		memory-region = <&ion_block_mem_0>;
		ion-heap-type = <3>; // ION_HEAP_TYPE_CHUNK
		ion-chunk-size = <0x00010000>; // 64KB
	};

	ti_carveout_heap_0 {
		memory-region = <&ion_block_mem_1>;
		ion-heap-type = <2>; // ION_HEAP_TYPE_CARVEOUT
	};
};
```

## Documentation/devicetree/bindings/staging/media/cnm,wave.yaml
```yaml
# SPDX-License-Identifier: (GPL-2.0 OR BSD-2-Clause)
%YAML 1.2
---
$id: http://devicetree.org/schemas/staging/media/cnm,wave.yaml#
$schema: http://devicetree.org/meta-schemas/core.yaml#

title: Chips&Media Wave 5 Series multi-standard codec IP

maintainers:
  - Nas Chung <nas.chung@chipsnmedia.com>
  - Robert Beckett <bob.beckett@collabora.com>
  - Dafna Hirschfeld <dafna.hirschfeld@collabora.com>

description: |-
  The Chips&Media WAVE codec IP is a multi format video encoder/decoder

properties:
  compatible:
    anyOf:
      - items:
        - enum:
            - cnm,cm511-vpu
            - cnm,cm517-vpu
            - cnm,cm521-vpu
            - cnm,cm521c-vpu
            - cnm,cm521c-dual-vpu
            - cnm,cm521e1-vpu
            - cnm,cm537-vpu
  reg:
    maxItems: 1

  clocks:
    minItems: 1
    maxItems: 4

  clock-names:
    minItems: 1
    maxItems: 4

  interrupts:
    maxItems: 1

  power-domains:
    maxItems: 1

  resets:
    maxItems: 1

  sram:
    $ref: /schemas/types.yaml#/definitions/phandle
    description: phandle pointing to the SRAM device node
    maxItems: 1

required:
  - compatible
  - reg
  - interrupts
  - clocks
  - clock-names

additionalProperties: false

examples:
  - |
    vpu: video-codec@12345678 {
        compatible = "cnm,cm521-vpu";
        reg = <0x12345678 0x1000>;
        interrupts = <42>;
        clocks = <&clks 42>;
        clock-names = "vcodec";
        sram = <&sram>;
    };
```

## Documentation/devicetree/bindings/thermal/ti_k3_thermal.txt
```
* Texas Instrument K3 VTM bandgap bindings

In the Voltage Thermal Management Module(VTM), K3 supplies a voltage
reference and a temperature sensor feature that are gathered in the band
gap voltage and temperature sensor (VBGAPTS) module. The band
gap provides current and voltage reference for its internal
circuits and other analog IP blocks. The analog-to-digital
converter (ADC) produces an output value that is proportional
to the silicon temperature.

Required properties:
- compatible : Should be:
  - "ti,am654-vtm" : for K3 AM654 VTM bandgap
- reg: Base address and address range of the VTM registers
- power-domains  : Should contain a phandle to a PM domain provider node and an
                   args specifier containing the VTM device id value. This
                   property is as per the binding,
                       Documentation/devicetree/bindings/soc/ti/sci-pm-domain.txt
- #thermal-sensor-cells: Should be 1. See ./thermal.txt for a description

Example:

AM654:
wkup_vtm0: wkup_vtm0@42050000 {
	compatible = "ti,am654-vtm";
	reg = <0x0 0x42050000 0x0 0x25c>;
	power-domains = <&k3_pds 80>;
	#thermal-sensor-cells = <1>;
};
```

## Documentation/devicetree/bindings/ufs/ti-j721e-ufs.txt
```
TI J721e UFS Host Controller Glue Driver

Required properties:
- compatible : Must be ""ti,j721e-ufs" for TI J721e SoC
- reg : address of TI UFS glue registers
- clocks : phandle to the M-PHY clock

Subnodes:

Cadence UFS Host Controller node needs to be added as a subnode to glue
driver node. See Documentation/devicetree/bindings/ufs/cdns,ufshc.txt
for subnode bindings

Example :

	ufs_wrapper: ufs-wrapper@4e80000 {
		compatible = "ti,j721e-ufs";
		reg = <0x0 0x4e80000 0x0 0x100>;
		power-domains = <&k3_pds 277>;
		clocks = <&k3_clks 277 1>;
		assigned-clocks = <&k3_clks 277 1>;
		assigned-clock-parents = <&k3_clks 277 4>;
		ranges;
		#address-cells = <2>;
		#size-cells = <2>;

		ufs@4e84000 {
			compatible = "cdns,ufshc-m31-16nm", "jedec,ufs-2.0";
			reg = <0x0 0x4e84000 0x0 0x10000>;
			interrupts = <GIC_SPI 17 IRQ_TYPE_LEVEL_HIGH>;
			power-domains = <&k3_pds 277>;
			freq-table-hz = <0 0>, <0 0>;
			clocks = <&k3_clks 277 0>, <&k3_clks 277 1>;
			clock-names = "core_clk", "phy_clk";
			assigned-clocks = <&k3_clks 277 1>;
			assigned-clock-parents = <&k3_clks 277 4>;
			dma-coherent;
		};
	};
```
