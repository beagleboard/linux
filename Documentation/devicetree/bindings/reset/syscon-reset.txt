## Documentation/devicetree/bindings/usb/cdns-usb3-ti.txt
```
Binding for the TI specific wrapper for the Cadence USBSS-DRD controller

Required properties:
  - compatible: Should contain "ti,j721e-usb"
  - reg: Physical base address and size of the wrappers register area.
  - power-domains: Should contain a phandle to a PM domain provider node
                   and an args specifier containing the USB device id
                   value. This property is as per the binding documentation:
                   Documentation/devicetree/bindings/soc/ti/sci-pm-domain.txt
  - clocks: Clock phandles to usb2_refclk and lpm_clk
  - clock-names: Should contain "usb2_refclk" and "lpm_clk"

Optional properties:
 - ti,usb2-only: If present, it restricts the controller to USB2.0 mode of
		 operation. Must be present if USB3 PHY is not available
		 for USB.
 - ti,modestrap-host: Set controller modestrap to HOST mode.
 - ti,modestrap-peripheral: Set controller modestrap to PERIPHERAL mode.
 - ti,vbus-divider: Should be present if USB VBUS line is connected to the
		 VBUS pin of the SoC via a 1/3 voltage divider.

Sub-nodes:
The USB2 PHY and the Cadence USB3 controller should be the sub-nodes.

Example:

	ti_usb0: cdns_usb@4104000 {
		compatible = "ti,j721e-usb";
		reg = <0x00 0x4104000 0x00 0x100>;
		power-domains = <&k3_pds 288 TI_SCI_PD_EXCLUSIVE>;
		clocks = <&k3_clks 288 15>, <&k3_clks 288 3>;
		clock-names = "usb2_refclk", "lpm_clk";
		assigned-clocks = <&k3_clks 288 15>;	/* USB2_REFCLK */
		assigned-clock-parents = <&k3_clks 288 16>; /* HFOSC0 */
		#address-cells = <2>;
		#size-cells = <2>;
		ranges;

		phy@4108000 {
			compatible = "ti,j721e-usb2-phy";
			reg = <0x00 0x4108000 0x00 0x400>;
		};

		usb0: usb@6000000 {
			compatible = "cdns,usb3-1.0.1";
			reg = <0x00 0x6000000 0x00 0x10000>,
			      <0x00 0x6010000 0x00 0x10000>,
			      <0x00 0x6020000 0x00 0x10000>;
			reg-names = "otg", "xhci", "dev";
			interrupts = <GIC_SPI 96 IRQ_TYPE_LEVEL_HIGH>,	/* irq.0 */
				     <GIC_SPI 102 IRQ_TYPE_LEVEL_HIGH>,	/* irq.6 */
				     <GIC_SPI 120 IRQ_TYPE_LEVEL_HIGH>;	/* otgirq.0 */
			interrupt-names = "host",
					  "peripheral",
					  "otg";
			maximum-speed = "super-speed";
			dr_mode = "otg";
		};
	};
```

## Documentation/devicetree/bindings/usb/cdns-usb3.txt
```
Binding for the Cadence USBSS-DRD controller

Required properties:
  - reg: Physical base address and size of the controller's register areas.
	 Controller has 3 different regions:
	 region 1 - HOST registers area
	 region 2 - DEVICE registers area
	 region 3 - OTG/DRD registers area
  - reg-names - register memory area names:
	"xhci" - for HOST registers space
	"dev" - for DEVICE registers space
	"otg" - for OTG/DRD registers space
  - compatible: Should contain: "cdns,usb3-1.0.0" or "cdns,usb3-1.0.1"
  - interrupts: Interrupts used by cdns3 controller.

Optional properties:
 - maximum-speed : valid arguments are "super-speed", "high-speed" and
                   "full-speed"; refer to usb/generic.txt
 - dr_mode: Should be one of "host", "peripheral" or "otg".
 - phys: reference to the USB PHY

Example:
	usb@f3000000 {
		compatible = "cdns,usb3-1.0.1";
		interrupts = <USB_IRQ  7 IRQ_TYPE_LEVEL_HIGH>;
		reg = <0xf3000000 0x10000	/* memory area for HOST registers */
			0xf3010000 0x10000	/* memory area for DEVICE registers */
			0xf3020000 0x10000>;	/* memory area for OTG/DRD registers */
		reg-names = "xhci", "dev", "otg";
	};
```

## Documentation/devicetree/bindings/usb/omap-usb.txt
```
OMAP GLUE AND OTHER OMAP SPECIFIC COMPONENTS

OMAP MUSB GLUE
 - compatible : Should be "ti,omap4-musb" or "ti,omap3-musb"
 - ti,hwmods : must be "usb_otg_hs"
 - ti,has_mailbox : to specify that omap uses an external mailbox
   (in control module) to communicate with the musb core during device connect
   and disconnect.
 - multipoint : Should be "1" indicating the musb controller supports
   multipoint. This is a MUSB configuration-specific setting.
 - num_eps : Specifies the number of endpoints. This is also a
   MUSB configuration-specific setting. Should be set to "16"
 - ram_bits : Specifies the ram address size. Should be set to "12"
 - interface_type : This is a board specific setting to describe the type of
   interface between the controller and the phy. It should be "0" or "1"
   specifying ULPI and UTMI respectively.
 - mode : Should be "3" to represent OTG. "1" signifies HOST and "2"
   represents PERIPHERAL.
 - power : Should be "50". This signifies the controller can supply upto
   100mA when operating in host mode.

SOC specific device node entry
usb_otg_hs: usb_otg_hs@4a0ab000 {
	compatible = "ti,omap4-musb";
	ti,hwmods = "usb_otg_hs";
	ti,has_mailbox;
	multipoint = <1>;
	num_eps = <16>;
	ram_bits = <12>;
};

Board specific device node entry
&usb_otg_hs {
	interface_type = <1>;
	mode = <3>;
	power = <50>;
};

OMAP CONTROL USB

Required properties:
 - compatible: Should be "ti,omap-control-usb"
 - reg : Address and length of the register set for the device. It contains
   the address of "control_dev_conf" and "otghs_control".
 - reg-names: The names of the register addresses corresponding to the registers
   filled in "reg".
 - ti,has_mailbox: This is used to specify if the platform uses mailbox in
   control module.

omap_control_usb@4a002300 {
	compatible = "ti,omap-control-usb";
	reg = <0x4a002300 0x4>,
	      <0x4a00233c 0x4>;
	reg-names = "control_dev_conf", "otghs_control";
	ti,has_mailbox;
};
```

## Documentation/devicetree/bindings/usb/ti,am654-dwc3.txt
```
TI AM654 SoC's SuperSpeed DWC3 USB controller

Required properties:
- compatible: should contain "ti,am654-dwc3"
- reg: address and length of the register set for this device
- interrupts: interrupt line for the device
- power-domains: should contain the phandle to the power domain controller
		 and the power domain ID for the USB controller.

Optional properties:
- syscon-usbctrl: phandle to system controller node for access to
		  USB control register.

Required child node:
A child node must exist to represent the core DWC3 IP block. The name of
the node is not important. The content of the node is defined in dwc3.txt.

Example device nodes:

	dwc3_0: dwc3@4000000 {
		compatible = "ti,am654-dwc3";
		reg = <0x0 0x4000000 0x0 0x4000>;
		#address-cells = <1>;
		#size-cells = <1>;
		ranges = <0x0 0x0 0x4000000 0x20000>;
		interrupts = <GIC_SPI 97 IRQ_TYPE_LEVEL_HIGH>;
		dma-coherent;
		status = "disabled";
		power-domains = <&k3_pds 151>;
		syscon-usbctrl = <&scm_conf 0x4000>;

		usb0_phy: phy {
			compatible = "usb-nop-xceiv";
		};

		usb0: usb@10000 {
			compatible = "snps,dwc3";
			reg = <0x10000 0x10000>;
			interrupts = <GIC_SPI 100 IRQ_TYPE_LEVEL_HIGH>,
			     <GIC_SPI 100 IRQ_TYPE_LEVEL_HIGH>,
				     <GIC_SPI 96 IRQ_TYPE_LEVEL_HIGH>;
			interrupt-names = "peripheral",
					  "host",
					  "otg";
			maximum-speed = "high-speed";
			dr_mode = "otg";
			usb-phy = <&usb0_phy>;
		};
	};
```
