/* SPDX-License-Identifier: GPL-2.0 */
/*
 * Copyright (C) 2021 Alibaba Group Holding Limited.
 */

#include "light-fm-emu.dts"

/ {
	model = "T-HEAD Light FM EMU GPU FPGA board";
	compatible = "thead,light-fm-emu-gpu", "thead,light";

	chosen {
		linux,initrd-end = <0x0 0x18000000>;
	};
};

&gpu {
	status = "okay";
};

