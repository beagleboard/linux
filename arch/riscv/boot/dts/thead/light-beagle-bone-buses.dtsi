// SPDX-License-Identifier: GPL-2.0
/*
 * Copyright (C) 2022 BeagleBoard.org - https://beagleboard.org/
 */

#include <dt-bindings/gpio/gpio.h>
#include <dt-bindings/board/light-fm-bone-pins.h>

/********/
/* LEDs */
/********/
&{/} {
	gpio-leds {
		compatible = "gpio-leds";
		pinctrl-names = "default";

		/* macro: BONE_LED(<headerpin>) */
		#define BONE_LED(YY)\
			bone_led_##YY##: led_##YY {\
				status = "disabled";\
				linux,default-trigger = "default-off";\
				gpios = <gpio_##YY GPIO_ACTIVE_HIGH>;\
				pinctrl-0 = < &##YY##_gpio_pin >;\
			};

		/*P8 header Bone LEDs*/
		BONE_LED(P8_03)
		BONE_LED(P8_04)
		BONE_LED(P8_05)
		BONE_LED(P8_06)
		BONE_LED(P8_07)
		BONE_LED(P8_08)
		BONE_LED(P8_09)
		BONE_LED(P8_10)
		BONE_LED(P8_11)
		BONE_LED(P8_12)
		BONE_LED(P8_13)
		BONE_LED(P8_14)
		BONE_LED(P8_15)
		BONE_LED(P8_16)
		BONE_LED(P8_17)
		BONE_LED(P8_18)
		BONE_LED(P8_19)
		BONE_LED(P8_20)
		BONE_LED(P8_21)
		BONE_LED(P8_22)
		BONE_LED(P8_23)
		BONE_LED(P8_24)
		BONE_LED(P8_25)
		BONE_LED(P8_26)
		BONE_LED(P8_27)
		BONE_LED(P8_28)
		BONE_LED(P8_29)
		BONE_LED(P8_30)
		BONE_LED(P8_31)
		BONE_LED(P8_32)
		BONE_LED(P8_33)
		BONE_LED(P8_34)
		BONE_LED(P8_35)
		BONE_LED(P8_36)
		BONE_LED(P8_37)
		BONE_LED(P8_38)
		BONE_LED(P8_39)
		BONE_LED(P8_40)
		BONE_LED(P8_41)
		BONE_LED(P8_42)
		BONE_LED(P8_43)
		BONE_LED(P8_44)
		BONE_LED(P8_45)
		BONE_LED(P8_46)

		/*P9 header Bone LEDs*/
		BONE_LED(P9_11)
		BONE_LED(P9_12)
		BONE_LED(P9_13)
		BONE_LED(P9_14)
		BONE_LED(P9_15)
		BONE_LED(P9_16)
		BONE_LED(P9_17)
		BONE_LED(P9_18)
		BONE_LED(P9_19)
		BONE_LED(P9_20)
		BONE_LED(P9_21)
		BONE_LED(P9_22)
		BONE_LED(P9_23)
		BONE_LED(P9_24)
		BONE_LED(P9_25)
		BONE_LED(P9_26)
		BONE_LED(P9_27)
		BONE_LED(P9_28)
		BONE_LED(P9_29)
		BONE_LED(P9_30)
		BONE_LED(P9_31)
		BONE_LED(P9_41)
		BONE_LED(P9_42)

		/*mikroBus*/
		BONE_LED(mb_pwm)
		BONE_LED(mb_rst)
		BONE_LED(mb_int)
		BONE_LED(mb_rxd)
		BONE_LED(mb_txd)
		BONE_LED(mb_cs)
		BONE_LED(mb_sck)
		BONE_LED(mb_mosi)
		BONE_LED(mb_miso)
		BONE_LED(mb_scl)
		BONE_LED(mb_sda)

		/*AP6203BM*/
		BONE_LED(bt_shutdown)
		BONE_LED(bt_device_wakeup)
		BONE_LED(bt_host_wakeup)
	};

	/* Dummy driver to request setup for cape header pins */
	cape_header: pinmux_dummy {
		compatible = "gpio-leds";
		pinctrl-names = "default";
		status = "okay";
		pinctrl-0 = <
			&P8_03_gpio_pin
			&P8_04_gpio_pin
			&P8_05_gpio_pin
			&P8_06_gpio_pin
			&P8_07_gpio_pin
			&P8_08_gpio_pin
			&P8_09_gpio_pin
			&P8_10_gpio_pin
			&P8_11_gpio_pin
			&P8_12_gpio_pin
			&P8_13_gpio_pin
			&P8_14_gpio_pin
			&P8_15_gpio_pin
			&P8_16_gpio_pin
			&P8_17_gpio_pin
			&P8_18_gpio_pin
			&P8_19_gpio_pin
			&P8_20_gpio_pin
			&P8_21_gpio_pin
			&P8_22_gpio_pin
			&P8_23_gpio_pin
			&P8_24_gpio_pin
			&P8_25_gpio_pin
			&P8_26_gpio_pin
			&P8_27_gpio_pin
			&P8_28_gpio_pin
			&P8_29_gpio_pin
			&P8_30_gpio_pin
			&P8_31_gpio_pin
			&P8_32_gpio_pin
			&P8_33_gpio_pin
			&P8_34_gpio_pin
			&P8_35_gpio_pin
			&P8_36_gpio_pin
			&P8_37_gpio_pin
			&P8_38_gpio_pin
			&P8_39_gpio_pin
			&P8_40_gpio_pin
			&P8_41_gpio_pin
			&P8_42_gpio_pin
			&P8_43_gpio_pin
			&P8_44_gpio_pin
			&P8_45_gpio_pin
			&P8_46_gpio_pin

			&P9_11_gpio_pin
			&P9_12_gpio_pin
			&P9_13_gpio_pin
			&P9_14_gpio_pin
			&P9_15_gpio_pin
			&P9_16_gpio_pin
			&P9_17_gpio_pin
			&P9_18_gpio_pin
			&P9_19_gpio_pin
			&P9_20_gpio_pin
			&P9_21_gpio_pin
			&P9_22_gpio_pin
			&P9_23_gpio_pin
			&P9_24_gpio_pin
			&P9_25_gpio_pin
			&P9_26_gpio_pin
			&P9_27_gpio_pin
			&P9_28_gpio_pin
			&P9_29_gpio_pin
			&P9_30_gpio_pin
			&P9_31_gpio_pin
			&P9_41_gpio_pin
			&P9_42_gpio_pin

			&mb_pwm_gpio_pin
			&mb_rst_gpio_pin
			&mb_int_gpio_pin
			&mb_rxd_gpio_pin
			&mb_txd_gpio_pin
			&mb_cs_gpio_pin
			//&mb_sck_gpio_pin
			//&mb_mosi_gpio_pin
			//&mb_miso_gpio_pin
			&mb_scl_gpio_pin
			&mb_sda_gpio_pin

			&bt_shutdown_gpio_pin
			&bt_device_wakeup_gpio_pin
			&bt_host_wakeup_gpio_pin
		>;
	};
};

/* macro: BONE_PIN( <pin>, <mode_name>, <register_value_macro(s)> ) */
#define BONE_PIN(XX,ZZ,QQ) \
	padctrl_##XX { \
		XX##_##ZZ##_pin: pinmux_##XX##_##ZZ##_pin \
		{ thead,pins = < QQ >; }; \
	};

/* Full P8/P9 header mode definitions */

/* P8_01 - GND */
/* P8_02 - GND */

/* P8_03 (Ball:J34) GPIO1_21_MUX*/
BONE_PIN(P8_03, default, P8_03(MUX_MODE3, (PIN_INPUT | STRENGTH_MID)))
BONE_PIN(P8_03, gpio, P8_03(MUX_MODE3, (PIN_INPUT | STRENGTH_MID)))
BONE_PIN(P8_03, gpio_pu, P8_03(MUX_MODE3, (PIN_INPUT_PULLUP | STRENGTH_MID)))
BONE_PIN(P8_03, gpio_pd, P8_03(MUX_MODE3, (PIN_INPUT_PULLDOWN | STRENGTH_MID)))

/* P8_04 (Ball:J35) GPIO1_22_MUX*/
BONE_PIN(P8_04, default, P8_04(MUX_MODE3, (PIN_INPUT | STRENGTH_MID)))
BONE_PIN(P8_04, gpio, P8_04(MUX_MODE3, (PIN_INPUT | STRENGTH_MID)))
BONE_PIN(P8_04, gpio_pu, P8_04(MUX_MODE3, (PIN_INPUT_PULLUP | STRENGTH_MID)))
BONE_PIN(P8_04, gpio_pd, P8_04(MUX_MODE3, (PIN_INPUT_PULLDOWN | STRENGTH_MID)))

/* P8_05 (Ball:K32) GPIO1_23_MUX*/
BONE_PIN(P8_05, default, P8_05(MUX_MODE3, (PIN_INPUT | STRENGTH_MID)))
BONE_PIN(P8_05, gpio, P8_05(MUX_MODE3, (PIN_INPUT | STRENGTH_MID)))
BONE_PIN(P8_05, gpio_pu, P8_05(MUX_MODE3, (PIN_INPUT_PULLUP | STRENGTH_MID)))
BONE_PIN(P8_05, gpio_pd, P8_05(MUX_MODE3, (PIN_INPUT_PULLDOWN | STRENGTH_MID)))

/* P8_06 (Ball:K33) GPIO1_24_MUX*/
BONE_PIN(P8_06, default, P8_06(MUX_MODE3, (PIN_INPUT | STRENGTH_MID)))
BONE_PIN(P8_06, gpio, P8_06(MUX_MODE3, (PIN_INPUT | STRENGTH_MID)))
BONE_PIN(P8_06, gpio_pu, P8_06(MUX_MODE3, (PIN_INPUT_PULLUP | STRENGTH_MID)))
BONE_PIN(P8_06, gpio_pd, P8_06(MUX_MODE3, (PIN_INPUT_PULLDOWN | STRENGTH_MID)))

/* P8_07 (Ball:K34) GPIO1_25_MUX*/
BONE_PIN(P8_07, default, P8_07(MUX_MODE3, (PIN_INPUT | STRENGTH_MID)))
BONE_PIN(P8_07, gpio, P8_07(MUX_MODE3, (PIN_INPUT | STRENGTH_MID)))
BONE_PIN(P8_07, gpio_pu, P8_07(MUX_MODE3, (PIN_INPUT_PULLUP | STRENGTH_MID)))
BONE_PIN(P8_07, gpio_pd, P8_07(MUX_MODE3, (PIN_INPUT_PULLDOWN | STRENGTH_MID)))

/* P8_08 (Ball:K35) GPIO1_26_MUX*/
BONE_PIN(P8_08, default, P8_08(MUX_MODE0, (PIN_INPUT | STRENGTH_MID)))
BONE_PIN(P8_08, gpio, P8_08(MUX_MODE0, (PIN_INPUT | STRENGTH_MID)))
BONE_PIN(P8_08, gpio_pu, P8_08(MUX_MODE0, (PIN_INPUT_PULLUP | STRENGTH_MID)))
BONE_PIN(P8_08, gpio_pd, P8_08(MUX_MODE0, (PIN_INPUT_PULLDOWN | STRENGTH_MID)))

/* P8_09 (Ball:K36) GPIO1_27_MUX*/
BONE_PIN(P8_09, default, P8_09(MUX_MODE0, (PIN_INPUT | STRENGTH_MID)))
BONE_PIN(P8_09, gpio, P8_09(MUX_MODE0, (PIN_INPUT | STRENGTH_MID)))
BONE_PIN(P8_09, gpio_pu, P8_09(MUX_MODE0, (PIN_INPUT_PULLUP | STRENGTH_MID)))
BONE_PIN(P8_09, gpio_pd, P8_09(MUX_MODE0, (PIN_INPUT_PULLDOWN | STRENGTH_MID)))

/* P8_10 (Ball:K37) GPIO1_28_MUX*/
BONE_PIN(P8_10, default, P8_10(MUX_MODE0, (PIN_INPUT | STRENGTH_MID)))
BONE_PIN(P8_10, gpio, P8_10(MUX_MODE0, (PIN_INPUT | STRENGTH_MID)))
BONE_PIN(P8_10, gpio_pu, P8_10(MUX_MODE0, (PIN_INPUT_PULLUP | STRENGTH_MID)))
BONE_PIN(P8_10, gpio_pd, P8_10(MUX_MODE0, (PIN_INPUT_PULLDOWN | STRENGTH_MID)))

/* P8_11 (Ball:L32) GPIO1_29_MUX*/
BONE_PIN(P8_11, default, P8_11(MUX_MODE0, (PIN_INPUT | STRENGTH_MID)))
BONE_PIN(P8_11, gpio, P8_11(MUX_MODE0, (PIN_INPUT | STRENGTH_MID)))
BONE_PIN(P8_11, gpio_pu, P8_11(MUX_MODE0, (PIN_INPUT_PULLUP | STRENGTH_MID)))
BONE_PIN(P8_11, gpio_pd, P8_11(MUX_MODE0, (PIN_INPUT_PULLDOWN | STRENGTH_MID)))

/* P8_12 (Ball:L33) GPIO1_30_MUX*/
BONE_PIN(P8_12, default, P8_12(MUX_MODE0, (PIN_INPUT | STRENGTH_MID)))
BONE_PIN(P8_12, gpio, P8_12(MUX_MODE0, (PIN_INPUT | STRENGTH_MID)))
BONE_PIN(P8_12, gpio_pu, P8_12(MUX_MODE0, (PIN_INPUT_PULLUP | STRENGTH_MID)))
BONE_PIN(P8_12, gpio_pd, P8_12(MUX_MODE0, (PIN_INPUT_PULLDOWN | STRENGTH_MID)))

/* P8_13 (Ball:C6) GPIO3_2_MUX*/
BONE_PIN(P8_13, default, P8_13(MUX_MODE0, (PIN_INPUT | STRENGTH_MID)))
BONE_PIN(P8_13, gpio, P8_13(MUX_MODE0, (PIN_INPUT | STRENGTH_MID)))
BONE_PIN(P8_13, gpio_pu, P8_13(MUX_MODE0, (PIN_INPUT_PULLUP | STRENGTH_MID)))
BONE_PIN(P8_13, gpio_pd, P8_13(MUX_MODE0, (PIN_INPUT_PULLDOWN | STRENGTH_MID)))
BONE_PIN(P8_13, pwm, P8_13(MUX_MODE1, (PIN_OUTPUT | STRENGTH_MID)))

/* P8_14 (Ball:E29) CLK_OUT_3_MUX*/
BONE_PIN(P8_14, default, P8_14(MUX_MODE3, (PIN_INPUT | STRENGTH_MID)))
BONE_PIN(P8_14, gpio, P8_14(MUX_MODE3, (PIN_INPUT | STRENGTH_MID)))
BONE_PIN(P8_14, gpio_pu, P8_14(MUX_MODE3, (PIN_INPUT_PULLUP | STRENGTH_MID)))
BONE_PIN(P8_14, gpio_pd, P8_14(MUX_MODE3, (PIN_INPUT_PULLDOWN | STRENGTH_MID)))

/* P8_15 (Ball:A6) GPIO3_0_MUX*/
BONE_PIN(P8_15, default, P8_15(MUX_MODE0, (PIN_INPUT | STRENGTH_MID)))
BONE_PIN(P8_15, gpio, P8_15(MUX_MODE0, (PIN_INPUT | STRENGTH_MID)))
BONE_PIN(P8_15, gpio_pu, P8_15(MUX_MODE0, (PIN_INPUT_PULLUP | STRENGTH_MID)))
BONE_PIN(P8_15, gpio_pd, P8_15(MUX_MODE0, (PIN_INPUT_PULLDOWN | STRENGTH_MID)))

/* P8_16 (Ball:F34) GPIO0_20_MUX*/
BONE_PIN(P8_16, default, P8_16(MUX_MODE0, (PIN_INPUT | STRENGTH_MID)))
BONE_PIN(P8_16, gpio, P8_16(MUX_MODE0, (PIN_INPUT | STRENGTH_MID)))
BONE_PIN(P8_16, gpio_pu, P8_16(MUX_MODE0, (PIN_INPUT_PULLUP | STRENGTH_MID)))
BONE_PIN(P8_16, gpio_pd, P8_16(MUX_MODE0, (PIN_INPUT_PULLDOWN | STRENGTH_MID)))
BONE_PIN(P8_16, uart, P8_16(MUX_MODE1, (PIN_OUTPUT | STRENGTH_MID)))

/* P8_17 (Ball:B6) GPIO3_1_MUX*/
BONE_PIN(P8_17, default, P8_17(MUX_MODE0, (PIN_INPUT | STRENGTH_MID)))
BONE_PIN(P8_17, gpio, P8_17(MUX_MODE0, (PIN_INPUT | STRENGTH_MID)))
BONE_PIN(P8_17, gpio_pu, P8_17(MUX_MODE0, (PIN_INPUT_PULLUP | STRENGTH_MID)))
BONE_PIN(P8_17, gpio_pd, P8_17(MUX_MODE0, (PIN_INPUT_PULLDOWN | STRENGTH_MID)))

/* P8_18 (Ball:B34) GPIO1_5_MUX*/
BONE_PIN(P8_18, default, P8_18(MUX_MODE0, (PIN_INPUT | STRENGTH_MID)))
BONE_PIN(P8_18, gpio, P8_18(MUX_MODE0, (PIN_INPUT | STRENGTH_MID)))
BONE_PIN(P8_18, gpio_pu, P8_18(MUX_MODE0, (PIN_INPUT_PULLUP | STRENGTH_MID)))
BONE_PIN(P8_18, gpio_pd, P8_18(MUX_MODE0, (PIN_INPUT_PULLDOWN | STRENGTH_MID)))

/* P8_19 (Ball:D6) GPIO3_3_MUX*/
BONE_PIN(P8_19, default, P8_19(MUX_MODE0, (PIN_INPUT | STRENGTH_MID)))
BONE_PIN(P8_19, gpio, P8_19(MUX_MODE0, (PIN_INPUT | STRENGTH_MID)))
BONE_PIN(P8_19, gpio_pu, P8_19(MUX_MODE0, (PIN_INPUT_PULLUP | STRENGTH_MID)))
BONE_PIN(P8_19, gpio_pd, P8_19(MUX_MODE0, (PIN_INPUT_PULLDOWN | STRENGTH_MID)))
BONE_PIN(P8_19, pwm, P8_19(MUX_MODE1, (PIN_OUTPUT | STRENGTH_MID)))

/* P8_20 (Ball:C34) GPIO1_6_MUX*/
BONE_PIN(P8_20, default, P8_20(MUX_MODE0, (PIN_INPUT | STRENGTH_MID)))
BONE_PIN(P8_20, gpio, P8_20(MUX_MODE0, (PIN_INPUT | STRENGTH_MID)))
BONE_PIN(P8_20, gpio_pu, P8_20(MUX_MODE0, (PIN_INPUT_PULLUP | STRENGTH_MID)))
BONE_PIN(P8_20, gpio_pd, P8_20(MUX_MODE0, (PIN_INPUT_PULLDOWN | STRENGTH_MID)))

/* P8_21 (Ball:D34) GPIO1_7_MUX*/
BONE_PIN(P8_21, default, P8_21(MUX_MODE0, (PIN_INPUT | STRENGTH_MID)))
BONE_PIN(P8_21, gpio, P8_21(MUX_MODE0, (PIN_INPUT | STRENGTH_MID)))
BONE_PIN(P8_21, gpio_pu, P8_21(MUX_MODE0, (PIN_INPUT_PULLUP | STRENGTH_MID)))
BONE_PIN(P8_21, gpio_pd, P8_21(MUX_MODE0, (PIN_INPUT_PULLDOWN | STRENGTH_MID)))
BONE_PIN(P8_21, spi, P8_21(MUX_MODE1, (PIN_OUTPUT | STRENGTH_MID)))

/* P8_22 (Ball:B35) GPIO1_8_MUX*/
BONE_PIN(P8_22, default, P8_22(MUX_MODE0, (PIN_INPUT | STRENGTH_MID)))
BONE_PIN(P8_22, gpio, P8_22(MUX_MODE0, (PIN_INPUT | STRENGTH_MID)))
BONE_PIN(P8_22, gpio_pu, P8_22(MUX_MODE0, (PIN_INPUT_PULLUP | STRENGTH_MID)))
BONE_PIN(P8_22, gpio_pd, P8_22(MUX_MODE0, (PIN_INPUT_PULLDOWN | STRENGTH_MID)))
BONE_PIN(P8_22, spi, P8_22(MUX_MODE1, (PIN_OUTPUT | STRENGTH_MID)))

/* P8_23 (Ball:A36) GPIO1_9_MUX*/
BONE_PIN(P8_23, default, P8_23(MUX_MODE0, (PIN_INPUT | STRENGTH_MID)))
BONE_PIN(P8_23, gpio, P8_23(MUX_MODE0, (PIN_INPUT | STRENGTH_MID)))
BONE_PIN(P8_23, gpio_pu, P8_23(MUX_MODE0, (PIN_INPUT_PULLUP | STRENGTH_MID)))
BONE_PIN(P8_23, gpio_pd, P8_23(MUX_MODE0, (PIN_INPUT_PULLDOWN | STRENGTH_MID)))
BONE_PIN(P8_23, spi, P8_23(MUX_MODE1, (PIN_OUTPUT | STRENGTH_MID)))

/* P8_24 (Ball:B36) GPIO1_10_MUX*/
BONE_PIN(P8_24, default, P8_24(MUX_MODE0, (PIN_INPUT | STRENGTH_MID)))
BONE_PIN(P8_24, gpio, P8_24(MUX_MODE0, (PIN_INPUT | STRENGTH_MID)))
BONE_PIN(P8_24, gpio_pu, P8_24(MUX_MODE0, (PIN_INPUT_PULLUP | STRENGTH_MID)))
BONE_PIN(P8_24, gpio_pd, P8_24(MUX_MODE0, (PIN_INPUT_PULLDOWN | STRENGTH_MID)))
BONE_PIN(P8_24, spi, P8_24(MUX_MODE1, (PIN_INPUT | STRENGTH_MID)))

/* P8_25 (Ball:B37) GPIO1_11_MUX*/
BONE_PIN(P8_25, default, P8_25(MUX_MODE0, (PIN_INPUT | STRENGTH_MID)))
BONE_PIN(P8_25, gpio, P8_25(MUX_MODE0, (PIN_INPUT | STRENGTH_MID)))
BONE_PIN(P8_25, gpio_pu, P8_25(MUX_MODE0, (PIN_INPUT_PULLUP | STRENGTH_MID)))
BONE_PIN(P8_25, gpio_pd, P8_25(MUX_MODE0, (PIN_INPUT_PULLDOWN | STRENGTH_MID)))

/* P8_26 (Ball:C36) GPIO1_12_MUX*/
BONE_PIN(P8_26, default, P8_26(MUX_MODE0, (PIN_INPUT | STRENGTH_MID)))
BONE_PIN(P8_26, gpio, P8_26(MUX_MODE0, (PIN_INPUT | STRENGTH_MID)))
BONE_PIN(P8_26, gpio_pu, P8_26(MUX_MODE0, (PIN_INPUT_PULLUP | STRENGTH_MID)))
BONE_PIN(P8_26, gpio_pd, P8_26(MUX_MODE0, (PIN_INPUT_PULLDOWN | STRENGTH_MID)))

/* P8_27 (Ball:D37) GPIO1_15_MUX*/
BONE_PIN(P8_27, default, P8_27(MUX_MODE0, (PIN_INPUT | STRENGTH_MID)))
BONE_PIN(P8_27, gpio, P8_27(MUX_MODE0, (PIN_INPUT | STRENGTH_MID)))
BONE_PIN(P8_27, gpio_pu, P8_27(MUX_MODE0, (PIN_INPUT_PULLUP | STRENGTH_MID)))
BONE_PIN(P8_27, gpio_pd, P8_27(MUX_MODE0, (PIN_INPUT_PULLDOWN | STRENGTH_MID)))

/* P8_28 (Ball:E34) GPIO1_16_MUX*/
BONE_PIN(P8_28, default, P8_28(MUX_MODE0, (PIN_INPUT | STRENGTH_MID)))
BONE_PIN(P8_28, gpio, P8_28(MUX_MODE0, (PIN_INPUT | STRENGTH_MID)))
BONE_PIN(P8_28, gpio_pu, P8_28(MUX_MODE0, (PIN_INPUT_PULLUP | STRENGTH_MID)))
BONE_PIN(P8_28, gpio_pd, P8_28(MUX_MODE0, (PIN_INPUT_PULLDOWN | STRENGTH_MID)))

/* P8_29 (Ball:D36) GPIO1_14_MUX*/
BONE_PIN(P8_29, default, P8_29(MUX_MODE0, (PIN_INPUT | STRENGTH_MID)))
BONE_PIN(P8_29, gpio, P8_29(MUX_MODE0, (PIN_INPUT | STRENGTH_MID)))
BONE_PIN(P8_29, gpio_pu, P8_29(MUX_MODE0, (PIN_INPUT_PULLUP | STRENGTH_MID)))
BONE_PIN(P8_29, gpio_pd, P8_29(MUX_MODE0, (PIN_INPUT_PULLDOWN | STRENGTH_MID)))
BONE_PIN(P8_29, uart, P8_29(MUX_MODE1, (PIN_INPUT | STRENGTH_MID)))

/* P8_30 (Ball:D35) GPIO1_13_MUX*/
BONE_PIN(P8_30, default, P8_30(MUX_MODE0, (PIN_INPUT | STRENGTH_MID)))
BONE_PIN(P8_30, gpio, P8_30(MUX_MODE0, (PIN_INPUT | STRENGTH_MID)))
BONE_PIN(P8_30, gpio_pu, P8_30(MUX_MODE0, (PIN_INPUT_PULLUP | STRENGTH_MID)))
BONE_PIN(P8_30, gpio_pd, P8_30(MUX_MODE0, (PIN_INPUT_PULLDOWN | STRENGTH_MID)))
BONE_PIN(P8_30, uart, P8_30(MUX_MODE1, (PIN_OUTPUT | STRENGTH_MID)))

/* P8_31 (Ball:D33) GPIO1_3_MUX*/
BONE_PIN(P8_31, default, P8_31(MUX_MODE0, (PIN_INPUT | STRENGTH_MID)))
BONE_PIN(P8_31, gpio, P8_31(MUX_MODE0, (PIN_INPUT | STRENGTH_MID)))
BONE_PIN(P8_31, gpio_pu, P8_31(MUX_MODE0, (PIN_INPUT_PULLUP | STRENGTH_MID)))
BONE_PIN(P8_31, gpio_pd, P8_31(MUX_MODE0, (PIN_INPUT_PULLDOWN | STRENGTH_MID)))

/* P8_32 (Ball:A34) GPIO1_4_MUX*/
BONE_PIN(P8_32, default, P8_32(MUX_MODE0, (PIN_INPUT | STRENGTH_MID)))
BONE_PIN(P8_32, gpio, P8_32(MUX_MODE0, (PIN_INPUT | STRENGTH_MID)))
BONE_PIN(P8_32, gpio_pu, P8_32(MUX_MODE0, (PIN_INPUT_PULLUP | STRENGTH_MID)))
BONE_PIN(P8_32, gpio_pd, P8_32(MUX_MODE0, (PIN_INPUT_PULLDOWN | STRENGTH_MID)))

/* P8_33 (Ball:C33) GPIO1_2_MUX*/
BONE_PIN(P8_33, default, P8_33(MUX_MODE0, (PIN_INPUT | STRENGTH_MID)))
BONE_PIN(P8_33, gpio, P8_33(MUX_MODE0, (PIN_INPUT | STRENGTH_MID)))
BONE_PIN(P8_33, gpio_pu, P8_33(MUX_MODE0, (PIN_INPUT_PULLUP | STRENGTH_MID)))
BONE_PIN(P8_33, gpio_pd, P8_33(MUX_MODE0, (PIN_INPUT_PULLDOWN | STRENGTH_MID)))

/* P8_34 (Ball:E32) GPIO1_0_MUX*/
BONE_PIN(P8_34, default, P8_34(MUX_MODE0, (PIN_INPUT | STRENGTH_MID)))
BONE_PIN(P8_34, gpio, P8_34(MUX_MODE0, (PIN_INPUT | STRENGTH_MID)))
BONE_PIN(P8_34, gpio_pu, P8_34(MUX_MODE0, (PIN_INPUT_PULLUP | STRENGTH_MID)))
BONE_PIN(P8_34, gpio_pd, P8_34(MUX_MODE0, (PIN_INPUT_PULLDOWN | STRENGTH_MID)))

/* P8_35 (Ball:A32) GPIO1_1_MUX*/
BONE_PIN(P8_35, default, P8_35(MUX_MODE0, (PIN_INPUT | STRENGTH_MID)))
BONE_PIN(P8_35, gpio, P8_35(MUX_MODE0, (PIN_INPUT | STRENGTH_MID)))
BONE_PIN(P8_35, gpio_pu, P8_35(MUX_MODE0, (PIN_INPUT_PULLUP | STRENGTH_MID)))
BONE_PIN(P8_35, gpio_pd, P8_35(MUX_MODE0, (PIN_INPUT_PULLDOWN | STRENGTH_MID)))

/* P8_36 (Ball:D32) GPIO0_31_MUX*/
BONE_PIN(P8_36, default, P8_36(MUX_MODE0, (PIN_INPUT | STRENGTH_MID)))
BONE_PIN(P8_36, gpio, P8_36(MUX_MODE0, (PIN_INPUT | STRENGTH_MID)))
BONE_PIN(P8_36, gpio_pu, P8_36(MUX_MODE0, (PIN_INPUT_PULLUP | STRENGTH_MID)))
BONE_PIN(P8_36, gpio_pd, P8_36(MUX_MODE0, (PIN_INPUT_PULLDOWN | STRENGTH_MID)))

/* P8_37 (Ball:B32) GPIO0_29_MUX*/
BONE_PIN(P8_37, default, P8_37(MUX_MODE0, (PIN_INPUT | STRENGTH_MID)))
BONE_PIN(P8_37, gpio, P8_37(MUX_MODE0, (PIN_INPUT | STRENGTH_MID)))
BONE_PIN(P8_37, gpio_pu, P8_37(MUX_MODE0, (PIN_INPUT_PULLUP | STRENGTH_MID)))
BONE_PIN(P8_37, gpio_pd, P8_37(MUX_MODE0, (PIN_INPUT_PULLDOWN | STRENGTH_MID)))

/* P8_38 (Ball:C32) GPIO0_30_MUX*/
BONE_PIN(P8_38, default, P8_38(MUX_MODE0, (PIN_INPUT | STRENGTH_MID)))
BONE_PIN(P8_38, gpio, P8_38(MUX_MODE0, (PIN_INPUT | STRENGTH_MID)))
BONE_PIN(P8_38, gpio_pu, P8_38(MUX_MODE0, (PIN_INPUT_PULLUP | STRENGTH_MID)))
BONE_PIN(P8_38, gpio_pd, P8_38(MUX_MODE0, (PIN_INPUT_PULLDOWN | STRENGTH_MID)))

/* P8_39 (Ball:D31) GPIO0_27_MUX*/
BONE_PIN(P8_39, default, P8_39(MUX_MODE0, (PIN_INPUT | STRENGTH_MID)))
BONE_PIN(P8_39, gpio, P8_39(MUX_MODE0, (PIN_INPUT | STRENGTH_MID)))
BONE_PIN(P8_39, gpio_pu, P8_39(MUX_MODE0, (PIN_INPUT_PULLUP | STRENGTH_MID)))
BONE_PIN(P8_39, gpio_pd, P8_39(MUX_MODE0, (PIN_INPUT_PULLDOWN | STRENGTH_MID)))
BONE_PIN(P8_39, i2c, P8_39(MUX_MODE2, (PIN_OUTPUT | STRENGTH_MID)))

/* P8_40 (Ball:E31) GPIO0_28_MUX*/
BONE_PIN(P8_40, default, P8_40(MUX_MODE0, (PIN_INPUT | STRENGTH_MID)))
BONE_PIN(P8_40, gpio, P8_40(MUX_MODE0, (PIN_INPUT | STRENGTH_MID)))
BONE_PIN(P8_40, gpio_pu, P8_40(MUX_MODE0, (PIN_INPUT_PULLUP | STRENGTH_MID)))
BONE_PIN(P8_40, gpio_pd, P8_40(MUX_MODE0, (PIN_INPUT_PULLDOWN | STRENGTH_MID)))
BONE_PIN(P8_40, i2c, P8_40(MUX_MODE2, (PIN_INPUT | STRENGTH_MID)))

/* P8_41 (Ball:F30) GPIO0_25_MUX*/
BONE_PIN(P8_41, default, P8_41(MUX_MODE0, (PIN_INPUT | STRENGTH_MID)))
BONE_PIN(P8_41, gpio, P8_41(MUX_MODE0, (PIN_INPUT | STRENGTH_MID)))	
BONE_PIN(P8_41, gpio_pu, P8_41(MUX_MODE0, (PIN_INPUT_PULLUP | STRENGTH_MID)))
BONE_PIN(P8_41, gpio_pd, P8_41(MUX_MODE0, (PIN_INPUT_PULLDOWN | STRENGTH_MID)))

/* P8_42 (Ball:C31) GPIO0_26_MUX*/
BONE_PIN(P8_42, default, P8_42(MUX_MODE0, (PIN_INPUT | STRENGTH_MID)))
BONE_PIN(P8_42, gpio, P8_42(MUX_MODE0, (PIN_INPUT | STRENGTH_MID)))
BONE_PIN(P8_42, gpio_pu, P8_42(MUX_MODE0, (PIN_INPUT_PULLUP | STRENGTH_MID)))
BONE_PIN(P8_42, gpio_pd, P8_42(MUX_MODE0, (PIN_INPUT_PULLDOWN | STRENGTH_MID)))

/* P8_43 (Ball:C30) GPIO0_23_MUX*/
BONE_PIN(P8_43, default, P8_43(MUX_MODE0, (PIN_INPUT | STRENGTH_MID)))
BONE_PIN(P8_43, gpio, P8_43(MUX_MODE0, (PIN_INPUT | STRENGTH_MID)))
BONE_PIN(P8_43, gpio_pu, P8_43(MUX_MODE0, (PIN_INPUT_PULLUP | STRENGTH_MID)))
BONE_PIN(P8_43, gpio_pd, P8_43(MUX_MODE0, (PIN_INPUT_PULLDOWN | STRENGTH_MID)))
BONE_PIN(P8_43, i2c, P8_43(MUX_MODE2, (PIN_OUTPUT | STRENGTH_MID)))

/* P8_44 (Ball:D30) GPIO0_24_MUX*/
BONE_PIN(P8_44, default, P8_44(MUX_MODE0, (PIN_INPUT | STRENGTH_MID)))
BONE_PIN(P8_44, gpio, P8_44(MUX_MODE0, (PIN_INPUT | STRENGTH_MID)))
BONE_PIN(P8_44, gpio_pu, P8_44(MUX_MODE0, (PIN_INPUT_PULLUP | STRENGTH_MID)))
BONE_PIN(P8_44, gpio_pd, P8_44(MUX_MODE0, (PIN_INPUT_PULLDOWN | STRENGTH_MID)))

/* P8_45 (Ball:F36) GPIO0_21_MUX*/
BONE_PIN(P8_45, default, P8_45(MUX_MODE0, (PIN_INPUT | STRENGTH_MID)))
BONE_PIN(P8_45, gpio, P8_45(MUX_MODE0, (PIN_INPUT | STRENGTH_MID)))
BONE_PIN(P8_45, gpio_pu, P8_45(MUX_MODE0, (PIN_INPUT_PULLUP | STRENGTH_MID)))
BONE_PIN(P8_45, gpio_pd, P8_45(MUX_MODE0, (PIN_INPUT_PULLDOWN | STRENGTH_MID)))
BONE_PIN(P8_45, uart, P8_45(MUX_MODE1, (PIN_INPUT | STRENGTH_MID)))

/* P8_46 (Ball:D29) GPIO0_22_MUX*/
BONE_PIN(P8_46, default, P8_46(MUX_MODE0, (PIN_INPUT | STRENGTH_MID)))
BONE_PIN(P8_46, gpio, P8_46(MUX_MODE0, (PIN_INPUT | STRENGTH_MID)))
BONE_PIN(P8_46, gpio_pu, P8_46(MUX_MODE0, (PIN_INPUT_PULLUP | STRENGTH_MID)))
BONE_PIN(P8_46, gpio_pd, P8_46(MUX_MODE0, (PIN_INPUT_PULLDOWN | STRENGTH_MID)))
BONE_PIN(P8_46, i2c, P8_46(MUX_MODE2, (PIN_OUTPUT | STRENGTH_MID)))

/* Full P9 header mode definitions */
/* P9_01 - GND */
/* P9_02 - GND */
/* P9_03 - VOUT_3V3 */
/* P9_04 - VOUT_3V3 */
/* P9_05 - VIN */
/* P9_06 - VIN */
/* P9_07 - VOUT_SYS */
/* P9_08 - VOUT_SYS */
/* P9_09 - ONKEY# */
/* P9_10 - RESET# */

/* P9_11 (Ball:M32) UART1_TXD_MUX*/
BONE_PIN(P9_11, default, P9_11(MUX_MODE3, (PIN_INPUT | STRENGTH_MID)))
BONE_PIN(P9_11, gpio, P9_11(MUX_MODE3, (PIN_INPUT | STRENGTH_MID)))
BONE_PIN(P9_11, gpio_pu, P9_11(MUX_MODE3, (PIN_INPUT_PULLUP | STRENGTH_MID)))
BONE_PIN(P9_11, gpio_pd, P9_11(MUX_MODE3, (PIN_INPUT_PULLDOWN | STRENGTH_MID)))
BONE_PIN(P9_11, uart, P9_11(MUX_MODE0, (PIN_INPUT | STRENGTH_MID)))

/* P9_12 (Ball:H1) QSPI0_CSN0_MUX*/
BONE_PIN(P9_12, default, P9_12(MUX_MODE3, (PIN_INPUT | STRENGTH_MID)))
BONE_PIN(P9_12, gpio, P9_12(MUX_MODE3, (PIN_INPUT | STRENGTH_MID)))
BONE_PIN(P9_12, gpio_pu, P9_12(MUX_MODE3, (PIN_INPUT_PULLUP | STRENGTH_MID)))
BONE_PIN(P9_12, gpio_pd, P9_12(MUX_MODE3, (PIN_INPUT_PULLDOWN | STRENGTH_MID)))
BONE_PIN(P9_12, pwm, P9_12(MUX_MODE1, (PIN_OUTPUT| STRENGTH_MID)))
BONE_PIN(P9_12, i2c, P9_12(MUX_MODE2, (PIN_INPUT | STRENGTH_MID)))

/* P9_13 (Ball:M33) UART1_RXD_MUX*/
BONE_PIN(P9_13, default, P9_13(MUX_MODE3, (PIN_INPUT | STRENGTH_MID)))
BONE_PIN(P9_13, gpio, P9_13(MUX_MODE3, (PIN_INPUT | STRENGTH_MID)))
BONE_PIN(P9_13, gpio_pu, P9_13(MUX_MODE3, (PIN_INPUT_PULLUP | STRENGTH_MID)))
BONE_PIN(P9_13, gpio_pd, P9_13(MUX_MODE3, (PIN_INPUT_PULLDOWN | STRENGTH_MID)))
BONE_PIN(P9_13, uart, P9_13(MUX_MODE0, (PIN_INPUT | STRENGTH_MID)))

/* P9_14 (Ball:K3) QSPI0_D1_MISO_MUX*/
BONE_PIN(P9_14, default, P9_14(MUX_MODE3, (PIN_INPUT | STRENGTH_MID)))
BONE_PIN(P9_14, gpio, P9_14(MUX_MODE3, (PIN_INPUT | STRENGTH_MID)))
BONE_PIN(P9_14, gpio_pu, P9_14(MUX_MODE3, (PIN_INPUT_PULLUP | STRENGTH_MID)))
BONE_PIN(P9_14, gpio_pd, P9_14(MUX_MODE3, (PIN_INPUT_PULLDOWN | STRENGTH_MID)))
BONE_PIN(P9_14, pwm, P9_14(MUX_MODE1, (PIN_OUTPUT | STRENGTH_MID)))

/* P9_15 (Ball:K2) QSPI0_D2_WP_MUX*/
BONE_PIN(P9_15, default, P9_15(MUX_MODE3, (PIN_INPUT | STRENGTH_MID)))
BONE_PIN(P9_15, gpio, P9_15(MUX_MODE3, (PIN_INPUT | STRENGTH_MID)))
BONE_PIN(P9_15, gpio_pu, P9_15(MUX_MODE3, (PIN_INPUT_PULLUP | STRENGTH_MID)))
BONE_PIN(P9_15, gpio_pd, P9_15(MUX_MODE3, (PIN_INPUT_PULLDOWN | STRENGTH_MID)))
BONE_PIN(P9_15, pwm, P9_15(MUX_MODE1, (PIN_OUTPUT | STRENGTH_MID)))

/* P9_16 (Ball:J3) QSPI0_D0_MOSI_MUX*/
BONE_PIN(P9_16, default, P9_16(MUX_MODE3, (PIN_INPUT | STRENGTH_MID)))
BONE_PIN(P9_16, gpio, P9_16(MUX_MODE3, (PIN_INPUT | STRENGTH_MID)))
BONE_PIN(P9_16, gpio_pu, P9_16(MUX_MODE3, (PIN_INPUT_PULLUP | STRENGTH_MID)))
BONE_PIN(P9_16, gpio_pd, P9_16(MUX_MODE3, (PIN_INPUT_PULLDOWN | STRENGTH_MID)))
BONE_PIN(P9_16, pwm, P9_16(MUX_MODE1, (PIN_OUTPUT | STRENGTH_MID)))

/* P9_17 (Ball:H32) QSPI1_CSN0_MUX*/
BONE_PIN(P9_17, default, P9_17(MUX_MODE3, (PIN_INPUT | STRENGTH_MID)))
BONE_PIN(P9_17, gpio, P9_17(MUX_MODE3, (PIN_INPUT | STRENGTH_MID)))
BONE_PIN(P9_17, gpio_pu, P9_17(MUX_MODE3, (PIN_INPUT_PULLUP | STRENGTH_MID)))
BONE_PIN(P9_17, gpio_pd, P9_17(MUX_MODE3, (PIN_INPUT_PULLDOWN | STRENGTH_MID)))

/* P9_18 (Ball:G35) QSPI1_D0_MOSI_MUX*/
BONE_PIN(P9_18, default, P9_18(MUX_MODE3, (PIN_INPUT | STRENGTH_MID)))
BONE_PIN(P9_18, gpio, P9_18(MUX_MODE3, (PIN_INPUT | STRENGTH_MID)))
BONE_PIN(P9_18, gpio_pu, P9_18(MUX_MODE3, (PIN_INPUT_PULLUP | STRENGTH_MID)))
BONE_PIN(P9_18, gpio_pd, P9_18(MUX_MODE3, (PIN_INPUT_PULLDOWN | STRENGTH_MID)))
BONE_PIN(P9_18, i2c, P9_18(MUX_MODE2, (PIN_INPUT | STRENGTH_MID)))

/* P9_19 (Ball:G4) I2C2_SCL_MUX*/
BONE_PIN(P9_19, default, P9_19(MUX_MODE3, (PIN_INPUT | STRENGTH_MID)))
BONE_PIN(P9_19, gpio, P9_19(MUX_MODE3, (PIN_INPUT | STRENGTH_MID)))
BONE_PIN(P9_19, gpio_pu, P9_19(MUX_MODE3, (PIN_INPUT_PULLUP | STRENGTH_MID)))
BONE_PIN(P9_19, gpio_pd, P9_19(MUX_MODE3, (PIN_INPUT_PULLDOWN | STRENGTH_MID)))
BONE_PIN(P9_19, i2c, P9_19(MUX_MODE0, (PIN_OUTPUT | STRENGTH_MID)))
BONE_PIN(P9_19, uart, P9_19(MUX_MODE1, (PIN_OUTPUT | STRENGTH_MID)))

/* P9_20 (Ball:G3) I2C2_SDA_MUX*/
BONE_PIN(P9_20, default, P9_20(MUX_MODE3, (PIN_INPUT | STRENGTH_MID)))
BONE_PIN(P9_20, gpio, P9_20(MUX_MODE3, (PIN_INPUT | STRENGTH_MID)))
BONE_PIN(P9_20, gpio_pu, P9_20(MUX_MODE3, (PIN_INPUT_PULLUP | STRENGTH_MID)))
BONE_PIN(P9_20, gpio_pd, P9_20(MUX_MODE3, (PIN_INPUT_PULLDOWN | STRENGTH_MID)))
BONE_PIN(P9_20, i2c, P9_20(MUX_MODE0, (PIN_INPUT | STRENGTH_MID)))
BONE_PIN(P9_20, uart, P9_20(MUX_MODE1, (PIN_INPUT | STRENGTH_MID)))

/* P9_21 (Ball:G34) QSPI1_D1_MISO_MUX*/
BONE_PIN(P9_21, default, P9_21(MUX_MODE3, (PIN_INPUT | STRENGTH_MID)))
BONE_PIN(P9_21, gpio, P9_21(MUX_MODE3, (PIN_INPUT | STRENGTH_MID)))
BONE_PIN(P9_21, gpio_pu, P9_21(MUX_MODE3, (PIN_INPUT_PULLUP | STRENGTH_MID)))
BONE_PIN(P9_21, gpio_pd, P9_21(MUX_MODE3, (PIN_INPUT_PULLDOWN | STRENGTH_MID)))

/* P9_22 (Ball:H34) QSPI1_SCLK_MUX*/
BONE_PIN(P9_22, default, P9_22(MUX_MODE3, (PIN_INPUT | STRENGTH_MID)))
BONE_PIN(P9_22, gpio, P9_22(MUX_MODE3, (PIN_INPUT | STRENGTH_MID)))
BONE_PIN(P9_22, gpio_pu, P9_22(MUX_MODE3, (PIN_INPUT_PULLUP | STRENGTH_MID)))
BONE_PIN(P9_22, gpio_pd, P9_22(MUX_MODE3, (PIN_INPUT_PULLDOWN | STRENGTH_MID)))

/* P9_23 (Ball:K1) QSPI0_D3_HOLD_MUX*/
BONE_PIN(P9_23, default, P9_23(MUX_MODE3, (PIN_INPUT | STRENGTH_MID)))
BONE_PIN(P9_23, gpio, P9_23(MUX_MODE3, (PIN_INPUT | STRENGTH_MID)))
BONE_PIN(P9_23, gpio_pu, P9_23(MUX_MODE3, (PIN_INPUT_PULLUP | STRENGTH_MID)))
BONE_PIN(P9_23, gpio_pd, P9_23(MUX_MODE3, (PIN_INPUT_PULLDOWN | STRENGTH_MID)))

/* P9_24 (Ball:G33) QSPI1_D2_WP_MUX*/
BONE_PIN(P9_24, default, P9_24(MUX_MODE3, (PIN_INPUT | STRENGTH_MID)))
BONE_PIN(P9_24, gpio, P9_24(MUX_MODE3, (PIN_INPUT | STRENGTH_MID)))
BONE_PIN(P9_24, gpio_pu, P9_24(MUX_MODE3, (PIN_INPUT_PULLUP | STRENGTH_MID)))
BONE_PIN(P9_24, gpio_pd, P9_24(MUX_MODE3, (PIN_INPUT_PULLDOWN | STRENGTH_MID)))
BONE_PIN(P9_24, uart, P9_24(MUX_MODE2, (PIN_OUTPUT | STRENGTH_MID)))

/* P9_25 (Ball:F5) GPIO2_18_MUX*/
BONE_PIN(P9_25, default, P9_25(MUX_MODE0, (PIN_INPUT | STRENGTH_MID)))
BONE_PIN(P9_25, gpio, P9_25(MUX_MODE0, (PIN_INPUT | STRENGTH_MID)))
BONE_PIN(P9_25, gpio_pu, P9_25(MUX_MODE0, (PIN_INPUT_PULLUP | STRENGTH_MID)))
BONE_PIN(P9_25, gpio_pd, P9_25(MUX_MODE0, (PIN_INPUT_PULLDOWN | STRENGTH_MID)))

/* P9_26 (Ball:F37) QSPI1_D3_HOLD_MUX*/
BONE_PIN(P9_26, default, P9_26(MUX_MODE3, (PIN_INPUT | STRENGTH_MID)))
BONE_PIN(P9_26, gpio, P9_26(MUX_MODE3, (PIN_INPUT | STRENGTH_MID)))
BONE_PIN(P9_26, gpio_pu, P9_26(MUX_MODE3, (PIN_INPUT_PULLUP | STRENGTH_MID)))
BONE_PIN(P9_26, gpio_pd, P9_26(MUX_MODE3, (PIN_INPUT_PULLDOWN | STRENGTH_MID)))
BONE_PIN(P9_26, uart, P9_26(MUX_MODE2, (PIN_INPUT | STRENGTH_MID)))

/* P9_27 (Ball:E4) GPIO2_19_MUX*/
BONE_PIN(P9_27, default, P9_27(MUX_MODE0, (PIN_INPUT | STRENGTH_MID)))
BONE_PIN(P9_27, gpio, P9_27(MUX_MODE0, (PIN_INPUT | STRENGTH_MID)))
BONE_PIN(P9_27, gpio_pu, P9_27(MUX_MODE0, (PIN_INPUT_PULLUP | STRENGTH_MID)))
BONE_PIN(P9_27, gpio_pd, P9_27(MUX_MODE0, (PIN_INPUT_PULLDOWN | STRENGTH_MID)))

/* P9_28 (Ball:E3) SPI_CSN_MUX*/
BONE_PIN(P9_28, default, P9_28(MUX_MODE3, (PIN_INPUT | STRENGTH_MID)))
BONE_PIN(P9_28, gpio, P9_28(MUX_MODE3, (PIN_INPUT | STRENGTH_MID)))
BONE_PIN(P9_28, gpio_pu, P9_28(MUX_MODE3, (PIN_INPUT_PULLUP | STRENGTH_MID)))
BONE_PIN(P9_28, gpio_pd, P9_28(MUX_MODE3, (PIN_INPUT_PULLDOWN | STRENGTH_MID)))
BONE_PIN(P9_28, uart, P9_28(MUX_MODE1, (PIN_INPUT | STRENGTH_MID)))

/* P9_29 (Ball:F1) SPI_MISO_MUX*/
BONE_PIN(P9_29, default, P9_29(MUX_MODE3, (PIN_INPUT | STRENGTH_MID)))
BONE_PIN(P9_29, gpio, P9_29(MUX_MODE3, (PIN_INPUT | STRENGTH_MID)))
BONE_PIN(P9_29, gpio_pu, P9_29(MUX_MODE3, (PIN_INPUT_PULLUP | STRENGTH_MID)))
BONE_PIN(P9_29, gpio_pd, P9_29(MUX_MODE3, (PIN_INPUT_PULLDOWN | STRENGTH_MID)))
BONE_PIN(P9_29, spi, P9_29(MUX_MODE0, (PIN_INPUT | STRENGTH_MID)))

/* P9_30 (Ball:F2) SPI_MOSI_MUX*/
BONE_PIN(P9_30, default, P9_30(MUX_MODE3, (PIN_INPUT | STRENGTH_MID)))
BONE_PIN(P9_30, gpio, P9_30(MUX_MODE3, (PIN_INPUT | STRENGTH_MID)))
BONE_PIN(P9_30, gpio_pu, P9_30(MUX_MODE3, (PIN_INPUT_PULLUP | STRENGTH_MID)))
BONE_PIN(P9_30, gpio_pd, P9_30(MUX_MODE3, (PIN_INPUT_PULLDOWN | STRENGTH_MID)))
BONE_PIN(P9_30, spi, P9_30(MUX_MODE0, (PIN_OUTPUT | STRENGTH_MID)))

/* P9_31 (Ball:D3) SPI_SCLK_MUX*/
BONE_PIN(P9_31, default, P9_31(MUX_MODE3, (PIN_INPUT | STRENGTH_MID)))
BONE_PIN(P9_31, gpio, P9_31(MUX_MODE3, (PIN_INPUT | STRENGTH_MID)))
BONE_PIN(P9_31, gpio_pu, P9_31(MUX_MODE3, (PIN_INPUT_PULLUP | STRENGTH_MID)))
BONE_PIN(P9_31, gpio_pd, P9_31(MUX_MODE3, (PIN_INPUT_PULLDOWN | STRENGTH_MID)))
BONE_PIN(P9_31, spi, P9_31(MUX_MODE0, (PIN_OUTPUT_PULLDOWN | STRENGTH_MID)))
BONE_PIN(P9_31, uart, P9_31(MUX_MODE1, (PIN_OUTPUT_PULLDOWN | STRENGTH_MID)))

/* P9_32 - GND */
/* P9_33 - ADC_VIN_CH4 */
/* P9_34 - GND */
/* P9_35 - ADC_VIN_CH6 */
/* P9_36 - ADC_VIN_CH5 */
/* P9_37 - ADC_VIN_CH2 */
/* P9_38 - ADC_VIN_CH3 */
/* P9_39 - ADC_VIN_CH0 */
/* P9_39 - ADC_VIN_CH1 */

/* P9_41 (Ball:D2) GPIO2_13_MUX*/
BONE_PIN(P9_41, default, P9_41(MUX_MODE0, (PIN_INPUT | STRENGTH_MID)))
BONE_PIN(P9_41, gpio, P9_41(MUX_MODE0, (PIN_INPUT | STRENGTH_MID)))
BONE_PIN(P9_41, gpio_pu, P9_41(MUX_MODE0, (PIN_INPUT_PULLUP | STRENGTH_MID)))
BONE_PIN(P9_41, gpio_pd, P9_41(MUX_MODE0, (PIN_INPUT_PULLDOWN | STRENGTH_MID)))

/* P9_42 (Ball:H3) QSPI0_SCLK_MUX*/
BONE_PIN(P9_42, default, P9_42(MUX_MODE3, (PIN_INPUT | STRENGTH_MID)))
BONE_PIN(P9_42, gpio, P9_42(MUX_MODE3, (PIN_INPUT | STRENGTH_MID)))
BONE_PIN(P9_42, gpio_pu, P9_42(MUX_MODE3, (PIN_INPUT_PULLUP | STRENGTH_MID)))
BONE_PIN(P9_42, gpio_pd, P9_42(MUX_MODE3, (PIN_INPUT_PULLDOWN | STRENGTH_MID)))
BONE_PIN(P9_42, pwm, P9_42(MUX_MODE1, (PIN_OUTPUT_PULLDOWN | STRENGTH_MID)))

/* P9_43 - GND */
/* P9_44 - GND */
/* P9_45 - GND */
/* P9_46 - GND */

/* mikroBus port*/

/*PWM*/
BONE_PIN(mb_pwm, gpio, mb_pwm(MUX_MODE3, (PIN_INPUT | STRENGTH_MID)))
BONE_PIN(mb_pwm, pwm, mb_pwm(MUX_MODE1, (PIN_OUTPUT | STRENGTH_MID)))

/*GPIO*/
BONE_PIN(mb_rst, gpio, mb_rst(MUX_MODE3, (PIN_INPUT | STRENGTH_MID)))
BONE_PIN(mb_int, gpio, mb_int(MUX_MODE0, (PIN_INPUT | STRENGTH_MID)))

/*UART*/
BONE_PIN(mb_rxd, gpio, mb_rxd(MUX_MODE3, (PIN_INPUT | STRENGTH_MID)))
BONE_PIN(mb_txd, gpio, mb_txd(MUX_MODE3, (PIN_INPUT | STRENGTH_MID)))

BONE_PIN(mb_rxd, uart, mb_rxd(MUX_MODE1, (PIN_INPUT | STRENGTH_MID)))
BONE_PIN(mb_txd, uart, mb_txd(MUX_MODE1, (PIN_INPUT | STRENGTH_MID)))

/*SPI*/
BONE_PIN(mb_cs, gpio, mb_cs(MUX_MODE0, (PIN_INPUT | STRENGTH_MID)))
BONE_PIN(mb_sck, gpio, mb_sck(MUX_MODE3, (PIN_INPUT | STRENGTH_MID)))
BONE_PIN(mb_mosi, gpio, mb_mosi(MUX_MODE3, (PIN_INPUT | STRENGTH_MID)))
BONE_PIN(mb_miso, gpio, mb_miso(MUX_MODE3, (PIN_INPUT | STRENGTH_MID)))

BONE_PIN(mb_cs, spi, mb_cs(MUX_MODE0, (PIN_OUTPUT | STRENGTH_MID)))
BONE_PIN(mb_sck, spi, mb_sck(MUX_MODE0, (PIN_INPUT | STRENGTH_MID)))
BONE_PIN(mb_mosi, spi, mb_mosi(MUX_MODE0, (PIN_INPUT | STRENGTH_MID)))
BONE_PIN(mb_miso, spi, mb_miso(MUX_MODE0, (PIN_INPUT | STRENGTH_MID)))

/*I2C*/
BONE_PIN(mb_scl, gpio, mb_scl(MUX_MODE0, (PIN_INPUT | STRENGTH_MID)))
BONE_PIN(mb_sda, gpio, mb_sda(MUX_MODE0, (PIN_INPUT | STRENGTH_MID)))

BONE_PIN(mb_scl, i2c, mb_scl(MUX_MODE1, (PIN_INPUT | STRENGTH_MID)))
BONE_PIN(mb_sda, i2c, mb_sda(MUX_MODE1, (PIN_INPUT | STRENGTH_MID)))

&{/} {
	aliases {
		mikrobus0 = &bone_mikrobus0;
	};

	bone_mikrobus0: linux-mikrobus {
		compatible = "linux,mikrobus";
		status = "disabled";
		pinctrl-names = "default", "pwm_default", "pwm_gpio",
				"uart_default", "uart_gpio", "i2c_default",
				"i2c_gpio", "spi_default", "spi_gpio";
		pinctrl-0 = <
			&mb_rst_gpio_pin
			&mb_int_gpio_pin
		>;
		pinctrl-1 = <&mb_pwm_pwm_pin>;
		pinctrl-2 = <&mb_pwm_gpio_pin>;
		pinctrl-3 = <
			&mb_txd_uart_pin
			&mb_rxd_uart_pin
		>;
		pinctrl-4 = <
			&mb_txd_gpio_pin
			&mb_rxd_gpio_pin
		>;
		pinctrl-5 = <
			&mb_scl_i2c_pin
			&mb_sda_i2c_pin
		>;
		pinctrl-6 = <
			&mb_scl_gpio_pin
			&mb_sda_gpio_pin
		>;
		pinctrl-7 = <
			&mb_cs_spi_pin
			&mb_sck_spi_pin
			&mb_mosi_spi_pin
			&mb_miso_spi_pin
		>;
		pinctrl-8 = <
			&mb_cs_gpio_pin
			&mb_sck_gpio_pin
			&mb_mosi_gpio_pin
			&mb_miso_gpio_pin
		>;

		i2c-adaptor = <&i2c4>;
		spi-master = <0>;
		spi-cs = <0 1>;
		uart = <&uart3>;
		pwms = <&pwm 2 5000000>;
		mikrobus-gpios = <gpio_mb_pwm	GPIO_ACTIVE_HIGH>,  /*mb_pwm*/
						 <gpio_mb_rst	GPIO_ACTIVE_HIGH>,  /*mb_rst*/
						 <gpio_mb_int	GPIO_ACTIVE_HIGH>,  /*mb_int*/
						 <gpio_mb_rxd	GPIO_ACTIVE_HIGH>,  /*mb_rxd*/
						 <gpio_mb_txd	GPIO_ACTIVE_HIGH>,  /*mb_txd*/
						 <gpio_mb_cs	GPIO_ACTIVE_HIGH>,  /*mb_cs*/ 
						 <gpio_mb_sck	GPIO_ACTIVE_HIGH>,  /*mb_sck*/
						 <gpio_mb_mosi	GPIO_ACTIVE_HIGH>,  /*mb_mosi*/
						 <gpio_mb_miso	GPIO_ACTIVE_HIGH>,  /*mb_miso*/
						 <gpio_mb_scl	GPIO_ACTIVE_HIGH>,  /*mb_scl*/
						 <gpio_mb_sda	GPIO_ACTIVE_HIGH>;  /*mb_sda*/
	};
};


/*AP6203BM*/

BONE_PIN(bt_shutdown, gpio, bt_shutdown(MUX_MODE3, (PIN_INPUT | STRENGTH_MID)))
BONE_PIN(bt_device_wakeup, gpio, bt_device_wakeup(MUX_MODE3, (PIN_INPUT | STRENGTH_MID)))
BONE_PIN(bt_host_wakeup, gpio, bt_host_wakeup(MUX_MODE0, (PIN_INPUT | STRENGTH_MID)))

/* pinmux helper */

&soc {
	/* P8_01 - GND */
	/* P8_02 - GND */
	/* P8_03 (Ball:J34) GPIO1_21_MUX*/
	P8_03_pinmux {
		status = "okay";
		pinctrl-names = "default", "gpio", "gpio_pu", "gpio_pd";
		pinctrl-0 = <&P8_03_default_pin>;
		pinctrl-1 = <&P8_03_gpio_pin>;
		pinctrl-2 = <&P8_03_gpio_pu_pin>;
		pinctrl-3 = <&P8_03_gpio_pd_pin>;
	};

	/* P8_04 (Ball:J35) GPIO1_22_MUX*/
	P8_04_pinmux {
		status = "okay";
		pinctrl-names = "default", "gpio", "gpio_pu", "gpio_pd";
		pinctrl-0 = <&P8_04_default_pin>;
		pinctrl-1 = <&P8_04_gpio_pin>;
		pinctrl-2 = <&P8_04_gpio_pu_pin>;
		pinctrl-3 = <&P8_04_gpio_pd_pin>;
	};

	/* P8_05 (Ball:K32) GPIO1_23_MUX*/
	P8_05_pinmux {
		status = "okay";
		pinctrl-names = "default", "gpio", "gpio_pu", "gpio_pd";
		pinctrl-0 = <&P8_05_default_pin>;
		pinctrl-1 = <&P8_05_gpio_pin>;
		pinctrl-2 = <&P8_05_gpio_pu_pin>;
		pinctrl-3 = <&P8_05_gpio_pd_pin>;
	};

	/* P8_06 (Ball:K33) GPIO1_24_MUX*/
	P8_06_pinmux {
		status = "okay";
		pinctrl-names = "default", "gpio", "gpio_pu", "gpio_pd";
		pinctrl-0 = <&P8_06_default_pin>;
		pinctrl-1 = <&P8_06_gpio_pin>;
		pinctrl-2 = <&P8_06_gpio_pu_pin>;
		pinctrl-3 = <&P8_06_gpio_pd_pin>;
	};

	/* P8_07 (Ball:K34) GPIO1_25_MUX*/
	P8_07_pinmux {
		status = "okay";
		pinctrl-names = "default", "gpio", "gpio_pu", "gpio_pd";
		pinctrl-0 = <&P8_07_default_pin>;
		pinctrl-1 = <&P8_07_gpio_pin>;
		pinctrl-2 = <&P8_07_gpio_pu_pin>;
		pinctrl-3 = <&P8_07_gpio_pd_pin>;
	};

	/* P8_08 (Ball:K35) GPIO1_26_MUX*/
	P8_08_pinmux {
		status = "okay";
		pinctrl-names = "default", "gpio", "gpio_pu", "gpio_pd";
		pinctrl-0 = <&P8_08_default_pin>;
		pinctrl-1 = <&P8_08_gpio_pin>;
		pinctrl-2 = <&P8_08_gpio_pu_pin>;
		pinctrl-3 = <&P8_08_gpio_pd_pin>;
	};

	/* P8_09 (Ball:K36) GPIO1_27_MUX*/
	P8_09_pinmux {
		status = "okay";
		pinctrl-names = "default", "gpio", "gpio_pu", "gpio_pd";
		pinctrl-0 = <&P8_09_default_pin>;
		pinctrl-1 = <&P8_09_gpio_pin>;
		pinctrl-2 = <&P8_09_gpio_pu_pin>;
		pinctrl-3 = <&P8_09_gpio_pd_pin>;
	};

	/* P8_10 (Ball:K37) GPIO1_28_MUX*/
	P8_10_pinmux {
		status = "okay";
		pinctrl-names = "default", "gpio", "gpio_pu", "gpio_pd";
		pinctrl-0 = <&P8_10_default_pin>;
		pinctrl-1 = <&P8_10_gpio_pin>;
		pinctrl-2 = <&P8_10_gpio_pu_pin>;
		pinctrl-3 = <&P8_10_gpio_pd_pin>;
	};

	/* P8_11 (Ball:L32) GPIO1_29_MUX*/
	P8_11_pinmux {
		status = "okay";
		pinctrl-names = "default", "gpio", "gpio_pu", "gpio_pd";
		pinctrl-0 = <&P8_11_default_pin>;
		pinctrl-1 = <&P8_11_gpio_pin>;
		pinctrl-2 = <&P8_11_gpio_pu_pin>;
		pinctrl-3 = <&P8_11_gpio_pd_pin>;
	};

	/* P8_12 (Ball:L33) GPIO1_30_MUX*/
	P8_12_pinmux {
		status = "okay";
		pinctrl-names = "default", "gpio", "gpio_pu", "gpio_pd";
		pinctrl-0 = <&P8_12_default_pin>;
		pinctrl-1 = <&P8_12_gpio_pin>;
		pinctrl-2 = <&P8_12_gpio_pu_pin>;
		pinctrl-3 = <&P8_12_gpio_pd_pin>;
	};

	/* P8_13 (Ball:C6) GPIO3_2_MUX*/
	P8_13_pinmux {
		status = "okay";
		pinctrl-names = "default", "gpio", "gpio_pu", "gpio_pd";
		pinctrl-0 = <&P8_13_default_pin>;
		pinctrl-1 = <&P8_13_gpio_pin>;
		pinctrl-2 = <&P8_13_gpio_pu_pin>;
		pinctrl-3 = <&P8_13_gpio_pd_pin>;
	};

	/* P8_14 (Ball:E29) CLK_OUT_3_MUX*/
	P8_14_pinmux {
		status = "okay";
		pinctrl-names = "default", "gpio", "gpio_pu", "gpio_pd";
		pinctrl-0 = <&P8_14_default_pin>;
		pinctrl-1 = <&P8_14_gpio_pin>;
		pinctrl-2 = <&P8_14_gpio_pu_pin>;
		pinctrl-3 = <&P8_14_gpio_pd_pin>;
	};

	/* P8_15 (Ball:A6) GPIO3_0_MUX*/
	P8_15_pinmux {
		status = "okay";
		pinctrl-names = "default", "gpio", "gpio_pu", "gpio_pd";
		pinctrl-0 = <&P8_15_default_pin>;
		pinctrl-1 = <&P8_15_gpio_pin>;
		pinctrl-2 = <&P8_15_gpio_pu_pin>;
		pinctrl-3 = <&P8_15_gpio_pd_pin>;
	};

	/* P8_16 (Ball:F34) GPIO0_20_MUX*/
	P8_16_pinmux {
		status = "okay";
		pinctrl-names = "default", "gpio", "gpio_pu", "gpio_pd";
		pinctrl-0 = <&P8_16_default_pin>;
		pinctrl-1 = <&P8_16_gpio_pin>;
		pinctrl-2 = <&P8_16_gpio_pu_pin>;
		pinctrl-3 = <&P8_16_gpio_pd_pin>;
	};

	/* P8_17 (Ball:B6) GPIO3_1_MUX*/
	P8_17_pinmux {
		status = "okay";
		pinctrl-names = "default", "gpio", "gpio_pu", "gpio_pd";
		pinctrl-0 = <&P8_17_default_pin>;
		pinctrl-1 = <&P8_17_gpio_pin>;
		pinctrl-2 = <&P8_17_gpio_pu_pin>;
		pinctrl-3 = <&P8_17_gpio_pd_pin>;
	};

	/* P8_18 (Ball:B34) GPIO1_5_MUX*/
	P8_18_pinmux {
		status = "okay";
		pinctrl-names = "default", "gpio", "gpio_pu", "gpio_pd";
		pinctrl-0 = <&P8_18_default_pin>;
		pinctrl-1 = <&P8_18_gpio_pin>;
		pinctrl-2 = <&P8_18_gpio_pu_pin>;
		pinctrl-3 = <&P8_18_gpio_pd_pin>;
	};

	/* P8_19 (Ball:D6) GPIO3_3_MUX*/
	P8_19_pinmux {
		status = "okay";
		pinctrl-names = "default", "gpio", "gpio_pu", "gpio_pd";
		pinctrl-0 = <&P8_19_default_pin>;
		pinctrl-1 = <&P8_19_gpio_pin>;
		pinctrl-2 = <&P8_19_gpio_pu_pin>;
		pinctrl-3 = <&P8_19_gpio_pd_pin>;
	};

	/* P8_20 (Ball:C34) GPIO1_6_MUX*/
	P8_20_pinmux {
		status = "okay";
		pinctrl-names = "default", "gpio", "gpio_pu", "gpio_pd";
		pinctrl-0 = <&P8_20_default_pin>;
		pinctrl-1 = <&P8_20_gpio_pin>;
		pinctrl-2 = <&P8_20_gpio_pu_pin>;
		pinctrl-3 = <&P8_20_gpio_pd_pin>;
	};

	/* P8_21 (Ball:D34) GPIO1_7_MUX*/
	P8_21_pinmux {
		status = "okay";
		pinctrl-names = "default", "gpio", "gpio_pu", "gpio_pd";
		pinctrl-0 = <&P8_21_default_pin>;
		pinctrl-1 = <&P8_21_gpio_pin>;
		pinctrl-2 = <&P8_21_gpio_pu_pin>;
		pinctrl-3 = <&P8_21_gpio_pd_pin>;
	};

	/* P8_22 (Ball:B35) GPIO1_8_MUX*/
	P8_22_pinmux {
		status = "okay";
		pinctrl-names = "default", "gpio", "gpio_pu", "gpio_pd";
		pinctrl-0 = <&P8_22_default_pin>;
		pinctrl-1 = <&P8_22_gpio_pin>;
		pinctrl-2 = <&P8_22_gpio_pu_pin>;
		pinctrl-3 = <&P8_22_gpio_pd_pin>;
	};

	/* P8_23 (Ball:A36) GPIO1_9_MUX*/
	P8_23_pinmux {
		status = "okay";
		pinctrl-names = "default", "gpio", "gpio_pu", "gpio_pd";
		pinctrl-0 = <&P8_23_default_pin>;
		pinctrl-1 = <&P8_23_gpio_pin>;
		pinctrl-2 = <&P8_23_gpio_pu_pin>;
		pinctrl-3 = <&P8_23_gpio_pd_pin>;
	};

	/* P8_24 (Ball:B36) GPIO1_10_MUX*/
	P8_24_pinmux {
		status = "okay";
		pinctrl-names = "default", "gpio", "gpio_pu", "gpio_pd";
		pinctrl-0 = <&P8_24_default_pin>;
		pinctrl-1 = <&P8_24_gpio_pin>;
		pinctrl-2 = <&P8_24_gpio_pu_pin>;
		pinctrl-3 = <&P8_24_gpio_pd_pin>;
	};

	/* P8_25 (Ball:B37) GPIO1_11_MUX*/
	P8_25_pinmux {
		status = "okay";
		pinctrl-names = "default", "gpio", "gpio_pu", "gpio_pd";
		pinctrl-0 = <&P8_25_default_pin>;
		pinctrl-1 = <&P8_25_gpio_pin>;
		pinctrl-2 = <&P8_25_gpio_pu_pin>;
		pinctrl-3 = <&P8_25_gpio_pd_pin>;
	};

	/* P8_26 (Ball:C36) GPIO1_12_MUX*/
	P8_26_pinmux {
		status = "okay";
		pinctrl-names = "default", "gpio", "gpio_pu", "gpio_pd";
		pinctrl-0 = <&P8_26_default_pin>;
		pinctrl-1 = <&P8_26_gpio_pin>;
		pinctrl-2 = <&P8_26_gpio_pu_pin>;
		pinctrl-3 = <&P8_26_gpio_pd_pin>;
	};

	/* P8_27 (Ball:D37) GPIO1_15_MUX*/
	P8_27_pinmux {
		status = "okay";
		pinctrl-names = "default", "gpio", "gpio_pu", "gpio_pd";
		pinctrl-0 = <&P8_27_default_pin>;
		pinctrl-1 = <&P8_27_gpio_pin>;
		pinctrl-2 = <&P8_27_gpio_pu_pin>;
		pinctrl-3 = <&P8_27_gpio_pd_pin>;
	};

	/* P8_28 (Ball:E34) GPIO1_16_MUX*/
	P8_28_pinmux {
		status = "okay";
		pinctrl-names = "default", "gpio", "gpio_pu", "gpio_pd";
		pinctrl-0 = <&P8_28_default_pin>;
		pinctrl-1 = <&P8_28_gpio_pin>;
		pinctrl-2 = <&P8_28_gpio_pu_pin>;
		pinctrl-3 = <&P8_28_gpio_pd_pin>;
	};

	/* P8_29 (Ball:D36) GPIO1_14_MUX*/
	P8_29_pinmux {
		status = "okay";
		pinctrl-names = "default", "gpio", "gpio_pu", "gpio_pd";
		pinctrl-0 = <&P8_29_default_pin>;
		pinctrl-1 = <&P8_29_gpio_pin>;
		pinctrl-2 = <&P8_29_gpio_pu_pin>;
		pinctrl-3 = <&P8_29_gpio_pd_pin>;
	};

	/* P8_30 (Ball:D35) GPIO1_13_MUX*/
	P8_30_pinmux {
		status = "okay";
		pinctrl-names = "default", "gpio", "gpio_pu", "gpio_pd";
		pinctrl-0 = <&P8_30_default_pin>;
		pinctrl-1 = <&P8_30_gpio_pin>;
		pinctrl-2 = <&P8_30_gpio_pu_pin>;
		pinctrl-3 = <&P8_30_gpio_pd_pin>;
	};

	/* P8_31 (Ball:D33) GPIO1_3_MUX*/
	P8_31_pinmux {
		status = "okay";
		pinctrl-names = "default", "gpio", "gpio_pu", "gpio_pd";
		pinctrl-0 = <&P8_31_default_pin>;
		pinctrl-1 = <&P8_31_gpio_pin>;
		pinctrl-2 = <&P8_31_gpio_pu_pin>;
		pinctrl-3 = <&P8_31_gpio_pd_pin>;
	};

	/* P8_32 (Ball:A34) GPIO1_4_MUX*/
	P8_32_pinmux {
		status = "okay";
		pinctrl-names = "default", "gpio", "gpio_pu", "gpio_pd";
		pinctrl-0 = <&P8_32_default_pin>;
		pinctrl-1 = <&P8_32_gpio_pin>;
		pinctrl-2 = <&P8_32_gpio_pu_pin>;
		pinctrl-3 = <&P8_32_gpio_pd_pin>;
	};

	/* P8_33 (Ball:C33) GPIO1_2_MUX*/
	P8_33_pinmux {
		status = "okay";
		pinctrl-names = "default", "gpio", "gpio_pu", "gpio_pd";
		pinctrl-0 = <&P8_33_default_pin>;
		pinctrl-1 = <&P8_33_gpio_pin>;
		pinctrl-2 = <&P8_33_gpio_pu_pin>;
		pinctrl-3 = <&P8_33_gpio_pd_pin>;
	};

	/* P8_34 (Ball:E32) GPIO1_0_MUX*/
	P8_34_pinmux {
		status = "okay";
		pinctrl-names = "default", "gpio", "gpio_pu", "gpio_pd";
		pinctrl-0 = <&P8_34_default_pin>;
		pinctrl-1 = <&P8_34_gpio_pin>;
		pinctrl-2 = <&P8_34_gpio_pu_pin>;
		pinctrl-3 = <&P8_34_gpio_pd_pin>;
	};

	/* P8_35 (Ball:A32) GPIO1_1_MUX*/
	P8_35_pinmux {
		status = "okay";
		pinctrl-names = "default", "gpio", "gpio_pu", "gpio_pd";
		pinctrl-0 = <&P8_35_default_pin>;
		pinctrl-1 = <&P8_35_gpio_pin>;
		pinctrl-2 = <&P8_35_gpio_pu_pin>;
		pinctrl-3 = <&P8_35_gpio_pd_pin>;
	};

	/* P8_36 (Ball:D32) GPIO0_31_MUX*/
	P8_36_pinmux {
		status = "okay";
		pinctrl-names = "default", "gpio", "gpio_pu", "gpio_pd";
		pinctrl-0 = <&P8_36_default_pin>;
		pinctrl-1 = <&P8_36_gpio_pin>;
		pinctrl-2 = <&P8_36_gpio_pu_pin>;
		pinctrl-3 = <&P8_36_gpio_pd_pin>;
	};

	/* P8_37 (Ball:B32) GPIO0_29_MUX*/
	P8_37_pinmux {
		status = "okay";
		pinctrl-names = "default", "gpio", "gpio_pu", "gpio_pd";
		pinctrl-0 = <&P8_37_default_pin>;
		pinctrl-1 = <&P8_37_gpio_pin>;
		pinctrl-2 = <&P8_37_gpio_pu_pin>;
		pinctrl-3 = <&P8_37_gpio_pd_pin>;
	};

	/* P8_38 (Ball:C32) GPIO0_30_MUX*/
	P8_38_pinmux {
		status = "okay";
		pinctrl-names = "default", "gpio", "gpio_pu", "gpio_pd";
		pinctrl-0 = <&P8_38_default_pin>;
		pinctrl-1 = <&P8_38_gpio_pin>;
		pinctrl-2 = <&P8_38_gpio_pu_pin>;
		pinctrl-3 = <&P8_38_gpio_pd_pin>;
	};

	/* P8_39 (Ball:D31) GPIO0_27_MUX*/
	P8_39_pinmux {
		status = "okay";
		pinctrl-names = "default", "gpio", "gpio_pu", "gpio_pd";
		pinctrl-0 = <&P8_39_default_pin>;
		pinctrl-1 = <&P8_39_gpio_pin>;
		pinctrl-2 = <&P8_39_gpio_pu_pin>;
		pinctrl-3 = <&P8_39_gpio_pd_pin>;
	};

	/* P8_40 (Ball:E31) GPIO0_28_MUX*/
	P8_40_pinmux {
		status = "okay";
		pinctrl-names = "default", "gpio", "gpio_pu", "gpio_pd";
		pinctrl-0 = <&P8_40_default_pin>;
		pinctrl-1 = <&P8_40_gpio_pin>;
		pinctrl-2 = <&P8_40_gpio_pu_pin>;
		pinctrl-3 = <&P8_40_gpio_pd_pin>;
	};

	/* P8_41 (Ball:F30) GPIO0_25_MUX*/
	P8_41_pinmux {
		status = "okay";
		pinctrl-names = "default", "gpio", "gpio_pu", "gpio_pd";
		pinctrl-0 = <&P8_41_default_pin>;
		pinctrl-1 = <&P8_41_gpio_pin>;
		pinctrl-2 = <&P8_41_gpio_pu_pin>;
		pinctrl-3 = <&P8_41_gpio_pd_pin>;
	};

	/* P8_42 (Ball:C31) GPIO0_26_MUX*/
	P8_42_pinmux {
		status = "okay";
		pinctrl-names = "default", "gpio", "gpio_pu", "gpio_pd";
		pinctrl-0 = <&P8_42_default_pin>;
		pinctrl-1 = <&P8_42_gpio_pin>;
		pinctrl-2 = <&P8_42_gpio_pu_pin>;
		pinctrl-3 = <&P8_42_gpio_pd_pin>;
	};

	/* P8_43 (Ball:C30) GPIO0_23_MUX*/
	P8_43_pinmux {
		status = "okay";
		pinctrl-names = "default", "gpio", "gpio_pu", "gpio_pd";
		pinctrl-0 = <&P8_43_default_pin>;
		pinctrl-1 = <&P8_43_gpio_pin>;
		pinctrl-2 = <&P8_43_gpio_pu_pin>;
		pinctrl-3 = <&P8_43_gpio_pd_pin>;
	};

	/* P8_44 (Ball:D30) GPIO0_24_MUX*/
	P8_44_pinmux {
		status = "okay";
		pinctrl-names = "default", "gpio", "gpio_pu", "gpio_pd";
		pinctrl-0 = <&P8_44_default_pin>;
		pinctrl-1 = <&P8_44_gpio_pin>;
		pinctrl-2 = <&P8_44_gpio_pu_pin>;
		pinctrl-3 = <&P8_44_gpio_pd_pin>;
	};

	/* P8_45 (Ball:F36) GPIO0_21_MUX*/
	P8_45_pinmux {
		status = "okay";
		pinctrl-names = "default", "gpio", "gpio_pu", "gpio_pd";
		pinctrl-0 = <&P8_45_default_pin>;
		pinctrl-1 = <&P8_45_gpio_pin>;
		pinctrl-2 = <&P8_45_gpio_pu_pin>;
		pinctrl-3 = <&P8_45_gpio_pd_pin>;
	};

	/* P8_46 (Ball:D29) GPIO0_22_MUX*/
	P8_46_pinmux {
		status = "okay";
		pinctrl-names = "default", "gpio", "gpio_pu", "gpio_pd";
		pinctrl-0 = <&P8_46_default_pin>;
		pinctrl-1 = <&P8_46_gpio_pin>;
		pinctrl-2 = <&P8_46_gpio_pu_pin>;
		pinctrl-3 = <&P8_46_gpio_pd_pin>;
	};

	/* P9_01 - GND */
	/* P9_02 - GND */
	/* P9_03 - VOUT_3V3 */
	/* P9_04 - VOUT_3V3 */
	/* P9_05 - VIN */
	/* P9_06 - VIN */
	/* P9_07 - VOUT_SYS */
	/* P9_08 - VOUT_SYS */
	/* P9_09 - ONKEY# */
	/* P9_10 - RESET# */
	/* P9_11 (Ball:M32) UART1_TXD_MUX*/
	P9_11_pinmux {
		status = "okay";
		pinctrl-names = "default", "gpio", "gpio_pu", "gpio_pd";
		pinctrl-0 = <&P9_11_default_pin>;
		pinctrl-1 = <&P9_11_gpio_pin>;
		pinctrl-2 = <&P9_11_gpio_pu_pin>;
		pinctrl-3 = <&P9_11_gpio_pd_pin>;
	};

	/* P9_12 (Ball:H1) QSPI0_CSN0_MUX*/
	P9_12_pinmux {
		status = "okay";
		pinctrl-names = "default", "gpio", "gpio_pu", "gpio_pd";
		pinctrl-0 = <&P9_12_default_pin>;
		pinctrl-1 = <&P9_12_gpio_pin>;
		pinctrl-2 = <&P9_12_gpio_pu_pin>;
		pinctrl-3 = <&P9_12_gpio_pd_pin>;
	};

	/* P9_13 (Ball:M33) UART1_RXD_MUX*/
	P9_13_pinmux {
		status = "okay";
		pinctrl-names = "default", "gpio", "gpio_pu", "gpio_pd";
		pinctrl-0 = <&P9_13_default_pin>;
		pinctrl-1 = <&P9_13_gpio_pin>;
		pinctrl-2 = <&P9_13_gpio_pu_pin>;
		pinctrl-3 = <&P9_13_gpio_pd_pin>;
	};

	/* P9_14 (Ball:K3) QSPI0_D1_MISO_MUX*/
	P9_14_pinmux {
		status = "okay";
		pinctrl-names = "default", "gpio", "gpio_pu", "gpio_pd";
		pinctrl-0 = <&P9_14_default_pin>;
		pinctrl-1 = <&P9_14_gpio_pin>;
		pinctrl-2 = <&P9_14_gpio_pu_pin>;
		pinctrl-3 = <&P9_14_gpio_pd_pin>;
	};

	/* P9_15 (Ball:K2) QSPI0_D2_WP_MUX*/
	P9_15_pinmux {
		status = "okay";
		pinctrl-names = "default", "gpio", "gpio_pu", "gpio_pd";
		pinctrl-0 = <&P9_15_default_pin>;
		pinctrl-1 = <&P9_15_gpio_pin>;
		pinctrl-2 = <&P9_15_gpio_pu_pin>;
		pinctrl-3 = <&P9_15_gpio_pd_pin>;
	};

	/* P9_16 (Ball:J3) QSPI0_D0_MOSI_MUX*/
	P9_16_pinmux {
		status = "okay";
		pinctrl-names = "default", "gpio", "gpio_pu", "gpio_pd";
		pinctrl-0 = <&P9_16_default_pin>;
		pinctrl-1 = <&P9_16_gpio_pin>;
		pinctrl-2 = <&P9_16_gpio_pu_pin>;
		pinctrl-3 = <&P9_16_gpio_pd_pin>;
	};

	/* P9_17 (Ball:H32) QSPI1_CSN0_MUX*/
	P9_17_pinmux {
		status = "okay";
		pinctrl-names = "default", "gpio", "gpio_pu", "gpio_pd";
		pinctrl-0 = <&P9_17_default_pin>;
		pinctrl-1 = <&P9_17_gpio_pin>;
		pinctrl-2 = <&P9_17_gpio_pu_pin>;
		pinctrl-3 = <&P9_17_gpio_pd_pin>;
	};

	/* P9_18 (Ball:G35) QSPI1_D0_MOSI_MUX*/
	P9_18_pinmux {
		status = "okay";
		pinctrl-names = "default", "gpio", "gpio_pu", "gpio_pd";
		pinctrl-0 = <&P9_18_default_pin>;
		pinctrl-1 = <&P9_18_gpio_pin>;
		pinctrl-2 = <&P9_18_gpio_pu_pin>;
		pinctrl-3 = <&P9_18_gpio_pd_pin>;
	};

	/* P9_19 (Ball:G4) I2C2_SCL_MUX*/
	P9_19_pinmux {
		status = "okay";
		pinctrl-names = "default", "gpio", "gpio_pu", "gpio_pd";
		pinctrl-0 = <&P9_19_default_pin>;
		pinctrl-1 = <&P9_19_gpio_pin>;
		pinctrl-2 = <&P9_19_gpio_pu_pin>;
		pinctrl-3 = <&P9_19_gpio_pd_pin>;
	};

	/* P9_20 (Ball:G3) I2C2_SDA_MUX*/
	P9_20_pinmux {
		status = "okay";
		pinctrl-names = "default", "gpio", "gpio_pu", "gpio_pd";
		pinctrl-0 = <&P9_20_default_pin>;
		pinctrl-1 = <&P9_20_gpio_pin>;
		pinctrl-2 = <&P9_20_gpio_pu_pin>;
		pinctrl-3 = <&P9_20_gpio_pd_pin>;
	};

	/* P9_21 (Ball:G34) QSPI1_D1_MISO_MUX*/
	P9_21_pinmux {
		status = "okay";
		pinctrl-names = "default", "gpio", "gpio_pu", "gpio_pd";
		pinctrl-0 = <&P9_21_default_pin>;
		pinctrl-1 = <&P9_21_gpio_pin>;
		pinctrl-2 = <&P9_21_gpio_pu_pin>;
		pinctrl-3 = <&P9_21_gpio_pd_pin>;
	};

	/* P9_22 (Ball:H34) QSPI1_SCLK_MUX*/
	P9_22_pinmux {
		status = "okay";
		pinctrl-names = "default", "gpio", "gpio_pu", "gpio_pd";
		pinctrl-0 = <&P9_22_default_pin>;
		pinctrl-1 = <&P9_22_gpio_pin>;
		pinctrl-2 = <&P9_22_gpio_pu_pin>;
		pinctrl-3 = <&P9_22_gpio_pd_pin>;
	};

	/* P9_23 (Ball:K1) QSPI0_D3_HOLD_MUX*/
	P9_23_pinmux {
		status = "okay";
		pinctrl-names = "default", "gpio", "gpio_pu", "gpio_pd";
		pinctrl-0 = <&P9_23_default_pin>;
		pinctrl-1 = <&P9_23_gpio_pin>;
		pinctrl-2 = <&P9_23_gpio_pu_pin>;
		pinctrl-3 = <&P9_23_gpio_pd_pin>;
	};

	/* P9_24 (Ball:G33) QSPI1_D2_WP_MUX*/
	P9_24_pinmux {
		status = "okay";
		pinctrl-names = "default", "gpio", "gpio_pu", "gpio_pd";
		pinctrl-0 = <&P9_24_default_pin>;
		pinctrl-1 = <&P9_24_gpio_pin>;
		pinctrl-2 = <&P9_24_gpio_pu_pin>;
		pinctrl-3 = <&P9_24_gpio_pd_pin>;
	};

	/* P9_25 (Ball:F5) GPIO2_18_MUX*/
	P9_25_pinmux {
		status = "okay";
		pinctrl-names = "default", "gpio", "gpio_pu", "gpio_pd";
		pinctrl-0 = <&P9_25_default_pin>;
		pinctrl-1 = <&P9_25_gpio_pin>;
		pinctrl-2 = <&P9_25_gpio_pu_pin>;
		pinctrl-3 = <&P9_25_gpio_pd_pin>;
	};

	/* P9_26 (Ball:F37) QSPI1_D3_HOLD_MUX*/
	P9_26_pinmux {
		status = "okay";
		pinctrl-names = "default", "gpio", "gpio_pu", "gpio_pd";
		pinctrl-0 = <&P9_26_default_pin>;
		pinctrl-1 = <&P9_26_gpio_pin>;
		pinctrl-2 = <&P9_26_gpio_pu_pin>;
		pinctrl-3 = <&P9_26_gpio_pd_pin>;
	};

	/* P9_27 (Ball:E4) GPIO2_19_MUX*/
	P9_27_pinmux {
		status = "okay";
		pinctrl-names = "default", "gpio", "gpio_pu", "gpio_pd";
		pinctrl-0 = <&P9_27_default_pin>;
		pinctrl-1 = <&P9_27_gpio_pin>;
		pinctrl-2 = <&P9_27_gpio_pu_pin>;
		pinctrl-3 = <&P9_27_gpio_pd_pin>;
	};

	/* P9_28 (Ball:E3) SPI_CSN_MUX*/
	P9_28_pinmux {
		status = "okay";
		pinctrl-names = "default", "gpio", "gpio_pu", "gpio_pd";
		pinctrl-0 = <&P9_28_default_pin>;
		pinctrl-1 = <&P9_28_gpio_pin>;
		pinctrl-2 = <&P9_28_gpio_pu_pin>;
		pinctrl-3 = <&P9_28_gpio_pd_pin>;
	};

	/* P9_29 (Ball:F1) SPI_MISO_MUX*/
	P9_29_pinmux {
		status = "okay";
		pinctrl-names = "default", "gpio", "gpio_pu", "gpio_pd";
		pinctrl-0 = <&P9_29_default_pin>;
		pinctrl-1 = <&P9_29_gpio_pin>;
		pinctrl-2 = <&P9_29_gpio_pu_pin>;
		pinctrl-3 = <&P9_29_gpio_pd_pin>;
	};

	/* P9_30 (Ball:F2) SPI_MOSI_MUX*/
	P9_30_pinmux {
		status = "okay";
		pinctrl-names = "default", "gpio", "gpio_pu", "gpio_pd";
		pinctrl-0 = <&P9_30_default_pin>;
		pinctrl-1 = <&P9_30_gpio_pin>;
		pinctrl-2 = <&P9_30_gpio_pu_pin>;
		pinctrl-3 = <&P9_30_gpio_pd_pin>;
	};

	/* P9_31 (Ball:D3) SPI_SCLK_MUX*/
	P9_31_pinmux {
		status = "okay";
		pinctrl-names = "default", "gpio", "gpio_pu", "gpio_pd";
		pinctrl-0 = <&P9_31_default_pin>;
		pinctrl-1 = <&P9_31_gpio_pin>;
		pinctrl-2 = <&P9_31_gpio_pu_pin>;
		pinctrl-3 = <&P9_31_gpio_pd_pin>;
	};

	/* P9_32 - GND */
	/* P9_33 - ADC_VIN_CH4 */
	/* P9_34 - GND */
	/* P9_35 - ADC_VIN_CH6 */
	/* P9_36 - ADC_VIN_CH5 */
	/* P9_37 - ADC_VIN_CH2 */
	/* P9_38 - ADC_VIN_CH3 */
	/* P9_39 - ADC_VIN_CH0 */
	/* P9_39 - ADC_VIN_CH1 */
	/* P9_41 (Ball:D2) GPIO2_13_MUX*/
	P9_41_pinmux {
		status = "okay";
		pinctrl-names = "default", "gpio", "gpio_pu", "gpio_pd";
		pinctrl-0 = <&P9_41_default_pin>;
		pinctrl-1 = <&P9_41_gpio_pin>;
		pinctrl-2 = <&P9_41_gpio_pu_pin>;
		pinctrl-3 = <&P9_41_gpio_pd_pin>;
	};

	/* P9_42 (Ball:H3) QSPI0_SCLK_MUX*/
	P9_42_pinmux {
		status = "okay";
		pinctrl-names = "default", "gpio", "gpio_pu", "gpio_pd";
		pinctrl-0 = <&P9_42_default_pin>;
		pinctrl-1 = <&P9_42_gpio_pin>;
		pinctrl-2 = <&P9_42_gpio_pu_pin>;
		pinctrl-3 = <&P9_42_gpio_pd_pin>;
	};

	/* P9_43 - GND */
	/* P9_44 - GND */
	/* P9_45 - GND */
	/* P9_46 - GND */
};