/* SPDX-License-Identifier: GPL-2.0 */
/*
 * Copyright (C) 2021 Alibaba Group Holding Limited.
 */

/dts-v1/;

#include "light-a-val.dts"

&c910_0 {
	operating-points = <
		/* kHz    uV */
		55000	600000
		65000	600000
		75000	600000
		85000	600000
		95000	600000
		105000	600000
		115000	600000
		125000	600000
		128000	600000
		136000	600000
		144000	600000
		152000	600000
		160000	600000
		168000	600000
		176000	600000
		184000	600000
		192000	600000
		200000	600000
		204000	600000
		216000	600000
		228000	600000
		240000	600000
		252000	600000
		264000	600000
		276000	600000
		288000	600000
		300000	600000
		304000	700000
		312000	700000
		320000	700000
		328000	700000
		336000	700000
		344000	700000
		352000	700000
		360000	700000
		368000	700000
		376000	700000
		384000	700000
		392000	700000
		400000	700000
		412000	700000
		420000	700000
		428000	700000
		436000	700000
		444000	700000
		452000	700000
		460000	700000
		468000	700000
		476000	700000
		484000	700000
		492000	700000
		500000	700000
		504000	700000
		513600	700000
		523200	700000
		532800	700000
		542400	700000
		552000	700000
		561600	700000
		571200	700000
		580800	700000
		590400	700000
		600000	700000
		606000	700000
		618000	700000
		630000	700000
		642000	700000
		654000	700000
		666000	700000
		678000	700000
		690000	700000
		702000	700000
		712000	700000
		720000	700000
		728000	700000
		736000	700000
		744000	700000
		752000	700000
		760000	700000
		768000	700000
		776000	700000
		784000	700000
		792000	700000
		800000	700000
		808000	800000
		816000	800000
		824000	800000
		832000	800000
		840000	800000
		848000	800000
		856000	800000
		864000	800000
		872000	800000
		880000	800000
		888000	800000
		896000	800000
		900000	800000
		904000	800000
		912000	800000
		920000	800000
		928000	800000
		936000	800000
		944000	800000
		952000	800000
		960000	800000
		968000	800000
		976000	800000
		984000	800000
		992000	800000
		1000000	800000
		1008000	800000
		1020000	800000
		1032000	800000
		1044000	800000
		1056000	800000
		1068000	800000
		1080000	800000
		1092000	800000
		1104000	800000
		1116000	800000
		1128000	800000
		1140000	800000
		1152000	800000
		1164000	800000
		1176000	800000
		1188000	800000
		1200000	800000
		1212000	800000
		1224000	800000
		1236000	800000
		1248000	800000
		1260000	800000
		1272000	800000
		1284000	800000
		1296000	800000
		1308000	800000
		1320000	800000
		1332000	800000
		1344000	800000
		1356000	800000
		1368000	800000
		1380000	800000
		1392000	800000
		1404000	800000
		1416000	800000
		1428000	800000
		1440000	800000
		1452000	800000
		1464000	800000
		1476000	800000
		1488000	800000
		1500000	800000
		1512000	1000000
		1536000	1000000
		1560000	1000000
		1584000	1000000
		1608000	1000000
		1632000	1000000
		1656000	1000000
		1680000	1000000
		1704000	1000000
		1728000	1000000
		1752000	1000000
		1776000	1000000
		1800000	1000000
		1824000	1000000
		1848000	1000000
		1872000	1100000
		1896000	1100000
		1920000	1100000
		1944000	1100000
		1968000	1100000
		1992000	1100000
		2016000	1100000
		2040000	1100000
		2064000	1100000
		2088000	1100000
		2112000	1100000
		2136000	1100000
		2160000	1100000
		2184000	1100000
		2208000	1100000
		2232000	1100000
		2256000	1100000
		2280000	1100000
		2304000	1100000
		2328000	1100000
		2352000	1100000
		2376000	1100000
		2400000	1100000
		2424000	1100000
		2448000	1100000
		2472000	1100000
		2496000	1100000
		2520000	1100000
		2544000	1100000
		2568000	1100000
		2592000	1100000
		2616000	1100000
	>;
	light,dvddm-operating-points = <
		/* kHz   uV */
		55000	600000
		65000	600000
		75000	600000
		85000	600000
		95000	600000
		105000	600000
		115000	600000
		125000	600000
		128000	600000
		136000	600000
		144000	600000
		152000	600000
		160000	600000
		168000	600000
		176000	600000
		184000	600000
		192000	600000
		200000	600000
		204000	600000
		216000	600000
		228000	600000
		240000	600000
		252000	600000
		264000	600000
		276000	600000
		288000	600000
		300000	600000
		304000	700000
		312000	700000
		320000	700000
		328000	700000
		336000	700000
		344000	700000
		352000	700000
		360000	700000
		368000	700000
		376000	700000
		384000	700000
		392000	700000
		400000	700000
		412000	700000
		420000	700000
		428000	700000
		436000	700000
		444000	700000
		452000	700000
		460000	700000
		468000	700000
		476000	700000
		484000	700000
		492000	700000
		500000	700000
		504000	700000
		513600	700000
		523200	700000
		532800	700000
		542400	700000
		552000	700000
		561600	700000
		571200	700000
		580800	700000
		590400	700000
		600000	700000
		606000	700000
		618000	700000
		630000	700000
		642000	700000
		654000	700000
		666000	700000
		678000	700000
		690000	700000
		702000	700000
		712000	700000
		720000	700000
		728000	700000
		736000	700000
		744000	700000
		752000	700000
		760000	700000
		768000	700000
		776000	700000
		784000	700000
		792000	700000
		800000	700000
		808000	800000
		816000	800000
		824000	800000
		832000	800000
		840000	800000
		848000	800000
		856000	800000
		864000	800000
		872000	800000
		880000	800000
		888000	800000
		896000	800000
		900000	800000
		904000	800000
		912000	800000
		920000	800000
		928000	800000
		936000	800000
		944000	800000
		952000	800000
		960000	800000
		968000	800000
		976000	800000
		984000	800000
		992000	800000
		1000000	800000
		1008000	800000
		1020000	800000
		1032000	800000
		1044000	800000
		1056000	800000
		1068000	800000
		1080000	800000
		1092000	800000
		1104000	800000
		1116000	800000
		1128000	800000
		1140000	800000
		1152000	800000
		1164000	800000
		1176000	800000
		1188000	800000
		1200000	800000
		1212000	800000
		1224000	800000
		1236000	800000
		1248000	800000
		1260000	800000
		1272000	800000
		1284000	800000
		1296000	800000
		1308000	800000
		1320000	800000
		1332000	800000
		1344000	800000
		1356000	800000
		1368000	800000
		1380000	800000
		1392000	800000
		1404000	800000
		1416000	800000
		1428000	800000
		1440000	800000
		1452000	800000
		1464000	800000
		1476000	800000
		1488000	800000
		1500000	800000
		1512000	1000000
		1536000	1000000
		1560000	1000000
		1584000	1000000
		1608000	1000000
		1632000	1000000
		1656000	1000000
		1680000	1000000
		1704000	1000000
		1728000	1000000
		1752000	1000000
		1776000	1000000
		1800000	1000000
		1824000	1000000
		1848000	1000000
		1872000	1100000
		1896000	1100000
		1920000	1100000
		1944000	1100000
		1968000	1100000
		1992000	1100000
		2016000	1100000
		2040000	1100000
		2064000	1100000
		2088000	1100000
		2112000	1100000
		2136000	1100000
		2160000	1100000
		2184000	1100000
		2208000	1100000
		2232000	1100000
		2256000	1100000
		2280000	1100000
		2304000	1100000
		2328000	1100000
		2352000	1100000
		2376000	1100000
		2400000	1100000
		2424000	1100000
		2448000	1100000
		2472000	1100000
		2496000	1100000
		2520000	1100000
		2544000	1100000
		2568000	1100000
		2592000	1100000
		2616000	1100000
	>;
	dvfs_sv;
};

&c910_1 {
	operating-points = <
		/* kHz    uV */
		55000	600000
		65000	600000
		75000	600000
		85000	600000
		95000	600000
		105000	600000
		115000	600000
		125000	600000
		128000	600000
		136000	600000
		144000	600000
		152000	600000
		160000	600000
		168000	600000
		176000	600000
		184000	600000
		192000	600000
		200000	600000
		204000	600000
		216000	600000
		228000	600000
		240000	600000
		252000	600000
		264000	600000
		276000	600000
		288000	600000
		300000	600000
		304000	700000
		312000	700000
		320000	700000
		328000	700000
		336000	700000
		344000	700000
		352000	700000
		360000	700000
		368000	700000
		376000	700000
		384000	700000
		392000	700000
		400000	700000
		412000	700000
		420000	700000
		428000	700000
		436000	700000
		444000	700000
		452000	700000
		460000	700000
		468000	700000
		476000	700000
		484000	700000
		492000	700000
		500000	700000
		504000	700000
		513600	700000
		523200	700000
		532800	700000
		542400	700000
		552000	700000
		561600	700000
		571200	700000
		580800	700000
		590400	700000
		600000	700000
		606000	700000
		618000	700000
		630000	700000
		642000	700000
		654000	700000
		666000	700000
		678000	700000
		690000	700000
		702000	700000
		712000	700000
		720000	700000
		728000	700000
		736000	700000
		744000	700000
		752000	700000
		760000	700000
		768000	700000
		776000	700000
		784000	700000
		792000	700000
		800000	700000
		808000	800000
		816000	800000
		824000	800000
		832000	800000
		840000	800000
		848000	800000
		856000	800000
		864000	800000
		872000	800000
		880000	800000
		888000	800000
		896000	800000
		900000	800000
		904000	800000
		912000	800000
		920000	800000
		928000	800000
		936000	800000
		944000	800000
		952000	800000
		960000	800000
		968000	800000
		976000	800000
		984000	800000
		992000	800000
		1000000	800000
		1008000	800000
		1020000	800000
		1032000	800000
		1044000	800000
		1056000	800000
		1068000	800000
		1080000	800000
		1092000	800000
		1104000	800000
		1116000	800000
		1128000	800000
		1140000	800000
		1152000	800000
		1164000	800000
		1176000	800000
		1188000	800000
		1200000	800000
		1212000	800000
		1224000	800000
		1236000	800000
		1248000	800000
		1260000	800000
		1272000	800000
		1284000	800000
		1296000	800000
		1308000	800000
		1320000	800000
		1332000	800000
		1344000	800000
		1356000	800000
		1368000	800000
		1380000	800000
		1392000	800000
		1404000	800000
		1416000	800000
		1428000	800000
		1440000	800000
		1452000	800000
		1464000	800000
		1476000	800000
		1488000	800000
		1500000	800000
		1512000	1000000
		1536000	1000000
		1560000	1000000
		1584000	1000000
		1608000	1000000
		1632000	1000000
		1656000	1000000
		1680000	1000000
		1704000	1000000
		1728000	1000000
		1752000	1000000
		1776000	1000000
		1800000	1000000
		1824000	1000000
		1848000	1000000
		1872000	1100000
		1896000	1100000
		1920000	1100000
		1944000	1100000
		1968000	1100000
		1992000	1100000
		2016000	1100000
		2040000	1100000
		2064000	1100000
		2088000	1100000
		2112000	1100000
		2136000	1100000
		2160000	1100000
		2184000	1100000
		2208000	1100000
		2232000	1100000
		2256000	1100000
		2280000	1100000
		2304000	1100000
		2328000	1100000
		2352000	1100000
		2376000	1100000
		2400000	1100000
		2424000	1100000
		2448000	1100000
		2472000	1100000
		2496000	1100000
		2520000	1100000
		2544000	1100000
		2568000	1100000
		2592000	1100000
		2616000	1100000
	>;
	light,dvddm-operating-points = <
		/* kHz   uV */
		55000	600000
		65000	600000
		75000	600000
		85000	600000
		95000	600000
		105000	600000
		115000	600000
		125000	600000
		128000	600000
		136000	600000
		144000	600000
		152000	600000
		160000	600000
		168000	600000
		176000	600000
		184000	600000
		192000	600000
		200000	600000
		204000	600000
		216000	600000
		228000	600000
		240000	600000
		252000	600000
		264000	600000
		276000	600000
		288000	600000
		300000	600000
		304000	700000
		312000	700000
		320000	700000
		328000	700000
		336000	700000
		344000	700000
		352000	700000
		360000	700000
		368000	700000
		376000	700000
		384000	700000
		392000	700000
		400000	700000
		412000	700000
		420000	700000
		428000	700000
		436000	700000
		444000	700000
		452000	700000
		460000	700000
		468000	700000
		476000	700000
		484000	700000
		492000	700000
		500000	700000
		504000	700000
		513600	700000
		523200	700000
		532800	700000
		542400	700000
		552000	700000
		561600	700000
		571200	700000
		580800	700000
		590400	700000
		600000	700000
		606000	700000
		618000	700000
		630000	700000
		642000	700000
		654000	700000
		666000	700000
		678000	700000
		690000	700000
		702000	700000
		712000	700000
		720000	700000
		728000	700000
		736000	700000
		744000	700000
		752000	700000
		760000	700000
		768000	700000
		776000	700000
		784000	700000
		792000	700000
		800000	700000
		808000	800000
		816000	800000
		824000	800000
		832000	800000
		840000	800000
		848000	800000
		856000	800000
		864000	800000
		872000	800000
		880000	800000
		888000	800000
		896000	800000
		900000	800000
		904000	800000
		912000	800000
		920000	800000
		928000	800000
		936000	800000
		944000	800000
		952000	800000
		960000	800000
		968000	800000
		976000	800000
		984000	800000
		992000	800000
		1000000	800000
		1008000	800000
		1020000	800000
		1032000	800000
		1044000	800000
		1056000	800000
		1068000	800000
		1080000	800000
		1092000	800000
		1104000	800000
		1116000	800000
		1128000	800000
		1140000	800000
		1152000	800000
		1164000	800000
		1176000	800000
		1188000	800000
		1200000	800000
		1212000	800000
		1224000	800000
		1236000	800000
		1248000	800000
		1260000	800000
		1272000	800000
		1284000	800000
		1296000	800000
		1308000	800000
		1320000	800000
		1332000	800000
		1344000	800000
		1356000	800000
		1368000	800000
		1380000	800000
		1392000	800000
		1404000	800000
		1416000	800000
		1428000	800000
		1440000	800000
		1452000	800000
		1464000	800000
		1476000	800000
		1488000	800000
		1500000	800000
		1512000	1000000
		1536000	1000000
		1560000	1000000
		1584000	1000000
		1608000	1000000
		1632000	1000000
		1656000	1000000
		1680000	1000000
		1704000	1000000
		1728000	1000000
		1752000	1000000
		1776000	1000000
		1800000	1000000
		1824000	1000000
		1848000	1000000
		1872000	1100000
		1896000	1100000
		1920000	1100000
		1944000	1100000
		1968000	1100000
		1992000	1100000
		2016000	1100000
		2040000	1100000
		2064000	1100000
		2088000	1100000
		2112000	1100000
		2136000	1100000
		2160000	1100000
		2184000	1100000
		2208000	1100000
		2232000	1100000
		2256000	1100000
		2280000	1100000
		2304000	1100000
		2328000	1100000
		2352000	1100000
		2376000	1100000
		2400000	1100000
		2424000	1100000
		2448000	1100000
		2472000	1100000
		2496000	1100000
		2520000	1100000
		2544000	1100000
		2568000	1100000
		2592000	1100000
		2616000	1100000
	>;
	dvfs_sv;
};

&c910_2 {
	operating-points = <
		/* kHz    uV */
		55000	600000
		65000	600000
		75000	600000
		85000	600000
		95000	600000
		105000	600000
		115000	600000
		125000	600000
		128000	600000
		136000	600000
		144000	600000
		152000	600000
		160000	600000
		168000	600000
		176000	600000
		184000	600000
		192000	600000
		200000	600000
		204000	600000
		216000	600000
		228000	600000
		240000	600000
		252000	600000
		264000	600000
		276000	600000
		288000	600000
		300000	600000
		304000	700000
		312000	700000
		320000	700000
		328000	700000
		336000	700000
		344000	700000
		352000	700000
		360000	700000
		368000	700000
		376000	700000
		384000	700000
		392000	700000
		400000	700000
		412000	700000
		420000	700000
		428000	700000
		436000	700000
		444000	700000
		452000	700000
		460000	700000
		468000	700000
		476000	700000
		484000	700000
		492000	700000
		500000	700000
		504000	700000
		513600	700000
		523200	700000
		532800	700000
		542400	700000
		552000	700000
		561600	700000
		571200	700000
		580800	700000
		590400	700000
		600000	700000
		606000	700000
		618000	700000
		630000	700000
		642000	700000
		654000	700000
		666000	700000
		678000	700000
		690000	700000
		702000	700000
		712000	700000
		720000	700000
		728000	700000
		736000	700000
		744000	700000
		752000	700000
		760000	700000
		768000	700000
		776000	700000
		784000	700000
		792000	700000
		800000	700000
		808000	800000
		816000	800000
		824000	800000
		832000	800000
		840000	800000
		848000	800000
		856000	800000
		864000	800000
		872000	800000
		880000	800000
		888000	800000
		896000	800000
		900000	800000
		904000	800000
		912000	800000
		920000	800000
		928000	800000
		936000	800000
		944000	800000
		952000	800000
		960000	800000
		968000	800000
		976000	800000
		984000	800000
		992000	800000
		1000000	800000
		1008000	800000
		1020000	800000
		1032000	800000
		1044000	800000
		1056000	800000
		1068000	800000
		1080000	800000
		1092000	800000
		1104000	800000
		1116000	800000
		1128000	800000
		1140000	800000
		1152000	800000
		1164000	800000
		1176000	800000
		1188000	800000
		1200000	800000
		1212000	800000
		1224000	800000
		1236000	800000
		1248000	800000
		1260000	800000
		1272000	800000
		1284000	800000
		1296000	800000
		1308000	800000
		1320000	800000
		1332000	800000
		1344000	800000
		1356000	800000
		1368000	800000
		1380000	800000
		1392000	800000
		1404000	800000
		1416000	800000
		1428000	800000
		1440000	800000
		1452000	800000
		1464000	800000
		1476000	800000
		1488000	800000
		1500000	800000
		1512000	1000000
		1536000	1000000
		1560000	1000000
		1584000	1000000
		1608000	1000000
		1632000	1000000
		1656000	1000000
		1680000	1000000
		1704000	1000000
		1728000	1000000
		1752000	1000000
		1776000	1000000
		1800000	1000000
		1824000	1000000
		1848000	1000000
		1872000	1100000
		1896000	1100000
		1920000	1100000
		1944000	1100000
		1968000	1100000
		1992000	1100000
		2016000	1100000
		2040000	1100000
		2064000	1100000
		2088000	1100000
		2112000	1100000
		2136000	1100000
		2160000	1100000
		2184000	1100000
		2208000	1100000
		2232000	1100000
		2256000	1100000
		2280000	1100000
		2304000	1100000
		2328000	1100000
		2352000	1100000
		2376000	1100000
		2400000	1100000
		2424000	1100000
		2448000	1100000
		2472000	1100000
		2496000	1100000
		2520000	1100000
		2544000	1100000
		2568000	1100000
		2592000	1100000
		2616000	1100000
	>;
	light,dvddm-operating-points = <
		/* kHz   uV */
		55000	600000
		65000	600000
		75000	600000
		85000	600000
		95000	600000
		105000	600000
		115000	600000
		125000	600000
		128000	600000
		136000	600000
		144000	600000
		152000	600000
		160000	600000
		168000	600000
		176000	600000
		184000	600000
		192000	600000
		200000	600000
		204000	600000
		216000	600000
		228000	600000
		240000	600000
		252000	600000
		264000	600000
		276000	600000
		288000	600000
		300000	600000
		304000	700000
		312000	700000
		320000	700000
		328000	700000
		336000	700000
		344000	700000
		352000	700000
		360000	700000
		368000	700000
		376000	700000
		384000	700000
		392000	700000
		400000	700000
		412000	700000
		420000	700000
		428000	700000
		436000	700000
		444000	700000
		452000	700000
		460000	700000
		468000	700000
		476000	700000
		484000	700000
		492000	700000
		500000	700000
		504000	700000
		513600	700000
		523200	700000
		532800	700000
		542400	700000
		552000	700000
		561600	700000
		571200	700000
		580800	700000
		590400	700000
		600000	700000
		606000	700000
		618000	700000
		630000	700000
		642000	700000
		654000	700000
		666000	700000
		678000	700000
		690000	700000
		702000	700000
		712000	700000
		720000	700000
		728000	700000
		736000	700000
		744000	700000
		752000	700000
		760000	700000
		768000	700000
		776000	700000
		784000	700000
		792000	700000
		800000	700000
		808000	800000
		816000	800000
		824000	800000
		832000	800000
		840000	800000
		848000	800000
		856000	800000
		864000	800000
		872000	800000
		880000	800000
		888000	800000
		896000	800000
		900000	800000
		904000	800000
		912000	800000
		920000	800000
		928000	800000
		936000	800000
		944000	800000
		952000	800000
		960000	800000
		968000	800000
		976000	800000
		984000	800000
		992000	800000
		1000000	800000
		1008000	800000
		1020000	800000
		1032000	800000
		1044000	800000
		1056000	800000
		1068000	800000
		1080000	800000
		1092000	800000
		1104000	800000
		1116000	800000
		1128000	800000
		1140000	800000
		1152000	800000
		1164000	800000
		1176000	800000
		1188000	800000
		1200000	800000
		1212000	800000
		1224000	800000
		1236000	800000
		1248000	800000
		1260000	800000
		1272000	800000
		1284000	800000
		1296000	800000
		1308000	800000
		1320000	800000
		1332000	800000
		1344000	800000
		1356000	800000
		1368000	800000
		1380000	800000
		1392000	800000
		1404000	800000
		1416000	800000
		1428000	800000
		1440000	800000
		1452000	800000
		1464000	800000
		1476000	800000
		1488000	800000
		1500000	800000
		1512000	1000000
		1536000	1000000
		1560000	1000000
		1584000	1000000
		1608000	1000000
		1632000	1000000
		1656000	1000000
		1680000	1000000
		1704000	1000000
		1728000	1000000
		1752000	1000000
		1776000	1000000
		1800000	1000000
		1824000	1000000
		1848000	1000000
		1872000	1100000
		1896000	1100000
		1920000	1100000
		1944000	1100000
		1968000	1100000
		1992000	1100000
		2016000	1100000
		2040000	1100000
		2064000	1100000
		2088000	1100000
		2112000	1100000
		2136000	1100000
		2160000	1100000
		2184000	1100000
		2208000	1100000
		2232000	1100000
		2256000	1100000
		2280000	1100000
		2304000	1100000
		2328000	1100000
		2352000	1100000
		2376000	1100000
		2400000	1100000
		2424000	1100000
		2448000	1100000
		2472000	1100000
		2496000	1100000
		2520000	1100000
		2544000	1100000
		2568000	1100000
		2592000	1100000
		2616000	1100000
	>;
	dvfs_sv;
};

&c910_3 {
	operating-points = <
		/* kHz    uV */
		55000	600000
		65000	600000
		75000	600000
		85000	600000
		95000	600000
		105000	600000
		115000	600000
		125000	600000
		128000	600000
		136000	600000
		144000	600000
		152000	600000
		160000	600000
		168000	600000
		176000	600000
		184000	600000
		192000	600000
		200000	600000
		204000	600000
		216000	600000
		228000	600000
		240000	600000
		252000	600000
		264000	600000
		276000	600000
		288000	600000
		300000	600000
		304000	700000
		312000	700000
		320000	700000
		328000	700000
		336000	700000
		344000	700000
		352000	700000
		360000	700000
		368000	700000
		376000	700000
		384000	700000
		392000	700000
		400000	700000
		412000	700000
		420000	700000
		428000	700000
		436000	700000
		444000	700000
		452000	700000
		460000	700000
		468000	700000
		476000	700000
		484000	700000
		492000	700000
		500000	700000
		504000	700000
		513600	700000
		523200	700000
		532800	700000
		542400	700000
		552000	700000
		561600	700000
		571200	700000
		580800	700000
		590400	700000
		600000	700000
		606000	700000
		618000	700000
		630000	700000
		642000	700000
		654000	700000
		666000	700000
		678000	700000
		690000	700000
		702000	700000
		712000	700000
		720000	700000
		728000	700000
		736000	700000
		744000	700000
		752000	700000
		760000	700000
		768000	700000
		776000	700000
		784000	700000
		792000	700000
		800000	700000
		808000	800000
		816000	800000
		824000	800000
		832000	800000
		840000	800000
		848000	800000
		856000	800000
		864000	800000
		872000	800000
		880000	800000
		888000	800000
		896000	800000
		900000	800000
		904000	800000
		912000	800000
		920000	800000
		928000	800000
		936000	800000
		944000	800000
		952000	800000
		960000	800000
		968000	800000
		976000	800000
		984000	800000
		992000	800000
		1000000	800000
		1008000	800000
		1020000	800000
		1032000	800000
		1044000	800000
		1056000	800000
		1068000	800000
		1080000	800000
		1092000	800000
		1104000	800000
		1116000	800000
		1128000	800000
		1140000	800000
		1152000	800000
		1164000	800000
		1176000	800000
		1188000	800000
		1200000	800000
		1212000	800000
		1224000	800000
		1236000	800000
		1248000	800000
		1260000	800000
		1272000	800000
		1284000	800000
		1296000	800000
		1308000	800000
		1320000	800000
		1332000	800000
		1344000	800000
		1356000	800000
		1368000	800000
		1380000	800000
		1392000	800000
		1404000	800000
		1416000	800000
		1428000	800000
		1440000	800000
		1452000	800000
		1464000	800000
		1476000	800000
		1488000	800000
		1500000	800000
		1512000	1000000
		1536000	1000000
		1560000	1000000
		1584000	1000000
		1608000	1000000
		1632000	1000000
		1656000	1000000
		1680000	1000000
		1704000	1000000
		1728000	1000000
		1752000	1000000
		1776000	1000000
		1800000	1000000
		1824000	1000000
		1848000	1000000
		1872000	1100000
		1896000	1100000
		1920000	1100000
		1944000	1100000
		1968000	1100000
		1992000	1100000
		2016000	1100000
		2040000	1100000
		2064000	1100000
		2088000	1100000
		2112000	1100000
		2136000	1100000
		2160000	1100000
		2184000	1100000
		2208000	1100000
		2232000	1100000
		2256000	1100000
		2280000	1100000
		2304000	1100000
		2328000	1100000
		2352000	1100000
		2376000	1100000
		2400000	1100000
		2424000	1100000
		2448000	1100000
		2472000	1100000
		2496000	1100000
		2520000	1100000
		2544000	1100000
		2568000	1100000
		2592000	1100000
		2616000	1100000
	>;
	light,dvddm-operating-points = <
		/* kHz   uV */
		55000	600000
		65000	600000
		75000	600000
		85000	600000
		95000	600000
		105000	600000
		115000	600000
		125000	600000
		128000	600000
		136000	600000
		144000	600000
		152000	600000
		160000	600000
		168000	600000
		176000	600000
		184000	600000
		192000	600000
		200000	600000
		204000	600000
		216000	600000
		228000	600000
		240000	600000
		252000	600000
		264000	600000
		276000	600000
		288000	600000
		300000	600000
		304000	700000
		312000	700000
		320000	700000
		328000	700000
		336000	700000
		344000	700000
		352000	700000
		360000	700000
		368000	700000
		376000	700000
		384000	700000
		392000	700000
		400000	700000
		412000	700000
		420000	700000
		428000	700000
		436000	700000
		444000	700000
		452000	700000
		460000	700000
		468000	700000
		476000	700000
		484000	700000
		492000	700000
		500000	700000
		504000	700000
		513600	700000
		523200	700000
		532800	700000
		542400	700000
		552000	700000
		561600	700000
		571200	700000
		580800	700000
		590400	700000
		600000	700000
		606000	700000
		618000	700000
		630000	700000
		642000	700000
		654000	700000
		666000	700000
		678000	700000
		690000	700000
		702000	700000
		712000	700000
		720000	700000
		728000	700000
		736000	700000
		744000	700000
		752000	700000
		760000	700000
		768000	700000
		776000	700000
		784000	700000
		792000	700000
		800000	700000
		808000	800000
		816000	800000
		824000	800000
		832000	800000
		840000	800000
		848000	800000
		856000	800000
		864000	800000
		872000	800000
		880000	800000
		888000	800000
		896000	800000
		900000	800000
		904000	800000
		912000	800000
		920000	800000
		928000	800000
		936000	800000
		944000	800000
		952000	800000
		960000	800000
		968000	800000
		976000	800000
		984000	800000
		992000	800000
		1000000	800000
		1008000	800000
		1020000	800000
		1032000	800000
		1044000	800000
		1056000	800000
		1068000	800000
		1080000	800000
		1092000	800000
		1104000	800000
		1116000	800000
		1128000	800000
		1140000	800000
		1152000	800000
		1164000	800000
		1176000	800000
		1188000	800000
		1200000	800000
		1212000	800000
		1224000	800000
		1236000	800000
		1248000	800000
		1260000	800000
		1272000	800000
		1284000	800000
		1296000	800000
		1308000	800000
		1320000	800000
		1332000	800000
		1344000	800000
		1356000	800000
		1368000	800000
		1380000	800000
		1392000	800000
		1404000	800000
		1416000	800000
		1428000	800000
		1440000	800000
		1452000	800000
		1464000	800000
		1476000	800000
		1488000	800000
		1500000	800000
		1512000	1000000
		1536000	1000000
		1560000	1000000
		1584000	1000000
		1608000	1000000
		1632000	1000000
		1656000	1000000
		1680000	1000000
		1704000	1000000
		1728000	1000000
		1752000	1000000
		1776000	1000000
		1800000	1000000
		1824000	1000000
		1848000	1000000
		1872000	1100000
		1896000	1100000
		1920000	1100000
		1944000	1100000
		1968000	1100000
		1992000	1100000
		2016000	1100000
		2040000	1100000
		2064000	1100000
		2088000	1100000
		2112000	1100000
		2136000	1100000
		2160000	1100000
		2184000	1100000
		2208000	1100000
		2232000	1100000
		2256000	1100000
		2280000	1100000
		2304000	1100000
		2328000	1100000
		2352000	1100000
		2376000	1100000
		2400000	1100000
		2424000	1100000
		2448000	1100000
		2472000	1100000
		2496000	1100000
		2520000	1100000
		2544000	1100000
		2568000	1100000
		2592000	1100000
		2616000	1100000
	>;
	dvfs_sv;
};
