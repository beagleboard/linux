/* SPDX-License-Identifier: GPL-2.0 */
/*
 * Copyright (C) 2021 Alibaba Group Holding Limited.
 */

/dts-v1/;

#include "light-b-product.dts"



&light_iopmp {
        status = "disabled";
};

&qspi1 {
        status = "disabled";
};
