// SPDX-License-Identifier: GPL-2.0-only OR MIT
/*
 *
 * Copyright (C) 2023 Texas Instruments Incorporated - https://www.ti.com/
 *
 */

/dts-v1/;
/plugin/;

#include <dt-bindings/gpio/gpio.h>
#include "k3-pinctrl.h"

/*
 * Helper to show loaded overlays under: /proc/device-tree/chosen/overlays/
*/
&{/chosen} {
	overlays {
		k3-am67a-beagley-ai-pps-gpio18.kernel = __TIMESTAMP__;
	};
};

&{/} {
	pps {
		compatible = "pps-gpio";
		pinctrl-names = "default";
		pinctrl-0 = <&hat_12_gpio>;

		gpios = <&main_gpio1 11 GPIO_ACTIVE_HIGH>;
	};
};
