// SPDX-License-Identifier: GPL-2.0
/*
 * Copyright (C) 2022 Texas Instruments Incorporated - https://www.ti.com/
 */

/dts-v1/;
/plugin/;

/*
 * Helper to show loaded overlays under: /proc/device-tree/chosen/overlays/
 */
&{/chosen} {
	overlays {
		k3-am625-beaglemod-external-eeprom.kernel = __TIMESTAMP__;
	};
};

&main_i2c1 {
	status = "okay";
	#address-cells = <1>;
	#size-cells = <0>;

	eeprom1: eeprom@57 {
		compatible = "atmel,24c256";
		reg = <0x57>;
	};
};
