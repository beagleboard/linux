// SPDX-License-Identifier: GPL-2.0

#include <dt-bindings/thermal/thermal.h>

thermal_zones: thermal-zones {
	main0_thermal: main0-thermal {
		polling-delay-passive = <250>;	/* milliSeconds */
		polling-delay = <500>;		/* milliSeconds */
		thermal-sensors = <&wkup_vtm0 0>;

		trips {
			main0_crit: main0-crit {
				temperature = <125000>;	/* milliCelsius */
				hysteresis = <2000>;	/* milliCelsius */
				type = "critical";
			};
		};
	};
};
