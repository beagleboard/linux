// SPDX-License-Identifier: GPL-2.0
/*
 * vision-apps: device-tree overlay
 *
 * Copyright (C) 2019 - 2021 Texas Instruments Incorporated - http://www.ti.com/
 */

/dts-v1/;
/plugin/;

#include "k3-j722s-rtos-memory-map.dtsi"
