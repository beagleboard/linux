// SPDX-License-Identifier: GPL-2.0-only OR MIT
/*
 * DT Overlay for /dev/ttyAMA0 uart pins within the expansion header.
 *
 * Copyright (C) 2023 Texas Instruments Incorporated - https://www.ti.com/
 *
 */

/dts-v1/;
/plugin/;

#include <dt-bindings/gpio/gpio.h>
#include "k3-pinctrl.h"

/*
 * Helper to show loaded overlays under: /proc/device-tree/chosen/overlays/
*/
&{/chosen} {
	overlays {
		k3-am67a-beagley-ai-uart-ttyama0.kernel = __TIMESTAMP__;
	};
};

&main_uart1 {
	symlink = "ttyAMA0";
	pinctrl-names = "default";
	pinctrl-0 = <&main_uart1_pins_default>;
	status = "okay";
};
