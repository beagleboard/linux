/dts-v1/;
/plugin/;

#include <dt-bindings/interrupt-controller/arm-gic.h>
#include <dt-bindings/interrupt-controller/irq.h>

/*
 * Helper to show loaded overlays under: /proc/device-tree/chosen/overlays/
 */
&{/chosen} {
	overlays {
		J721E-PRU-UIO-00A0.kernel = __TIMESTAMP__;
	};
};

&icssg0 {
	compatible = "ti,pruss-v2";
	ti,pintc-offset = <0x20000>;
	interrupts = <GIC_SPI 254 IRQ_TYPE_LEVEL_HIGH>,
		     <GIC_SPI 255 IRQ_TYPE_LEVEL_HIGH>,
		     <GIC_SPI 256 IRQ_TYPE_LEVEL_HIGH>,
		     <GIC_SPI 257 IRQ_TYPE_LEVEL_HIGH>,
		     <GIC_SPI 258 IRQ_TYPE_LEVEL_HIGH>,
		     <GIC_SPI 259 IRQ_TYPE_LEVEL_HIGH>,
		     <GIC_SPI 260 IRQ_TYPE_LEVEL_HIGH>,
		     <GIC_SPI 261 IRQ_TYPE_LEVEL_HIGH>;
	pruss-instance = "pruss0";
};

&icssg1 {
	compatible = "ti,pruss-v2";
	ti,pintc-offset = <0x20000>;
	interrupts = <GIC_SPI 262 IRQ_TYPE_LEVEL_HIGH>,
		     <GIC_SPI 263 IRQ_TYPE_LEVEL_HIGH>,
		     <GIC_SPI 264 IRQ_TYPE_LEVEL_HIGH>,
		     <GIC_SPI 265 IRQ_TYPE_LEVEL_HIGH>,
		     <GIC_SPI 266 IRQ_TYPE_LEVEL_HIGH>,
		     <GIC_SPI 267 IRQ_TYPE_LEVEL_HIGH>,
		     <GIC_SPI 268 IRQ_TYPE_LEVEL_HIGH>,
		     <GIC_SPI 269 IRQ_TYPE_LEVEL_HIGH>;
	pruss-instance = "pruss1";
};
