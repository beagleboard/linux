// SPDX-License-Identifier: GPL-2.0
/*
 * Copyright (C) 2022 BeagleBoard.org - https://beagleboard.org/
 *
 * https://elinux.org/Beagleboard:BeagleBone_cape_interface_spec#I2C
 */

/dts-v1/;
/plugin/;

/*
 * Helper to show loaded overlays under: /proc/device-tree/chosen/overlays/
 */
&{/chosen} {
	overlays {
		BONE-I2C3.kernel = __TIMESTAMP__;
	};
};

&main_i2c4 {
	pinctrl-names = "default";
	pinctrl-0 = <
		     &P9_26_i2c_pin /* i2c4_sda */
		     &P9_24_i2c_pin /* i2c4_scl */
		    >;
	clock-frequency = <100000>;

	status = "okay";
	symlink = "bone/i2c/3";
};
