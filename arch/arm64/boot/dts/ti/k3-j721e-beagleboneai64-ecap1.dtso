// SPDX-License-Identifier: GPL-2.0-only OR MIT
/*
 * Copyright (C) 2026 Pranav Raja
 * DT Overlay for ECAP1
 * P9.30 - ECAP1_IN
 */

/dts-v1/;
/plugin/;

#include <dt-bindings/interrupt-controller/arm-gic.h>
#include <dt-bindings/soc/ti,sci_pm_domain.h>
#include "k3-pinctrl.h"

&main_pmx0 {
	ecap1_pins_default: ecap1-pins-default {
		pinctrl-single,pins = <
		J721E_IOPAD(0x238, PIN_INPUT, 1) /* P9_30 - ECAP1_IN */
		>;
	};
};

&cbass_main {
	#address-cells = <2>;
	#size-cells = <2>;

	cap1: capture@3110000 {
		compatible = "ti,am62-ecap-capture";
		reg = <0x0 0x03110000 0x0 0x100>;
		interrupt-parent = <&gic500>;
		interrupts = <GIC_SPI 326 IRQ_TYPE_EDGE_RISING>;
		power-domains = <&k3_pds 81 TI_SCI_PD_SHARED>;
		clocks = <&k3_clks 81 0>;
		clock-names = "fck";
		pinctrl-names = "default";
		pinctrl-0 = <&ecap1_pins_default>;
		status = "okay";
		label = "capture1";
	};
};
