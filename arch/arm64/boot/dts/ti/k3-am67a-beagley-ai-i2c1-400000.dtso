// SPDX-License-Identifier: GPL-2.0-only OR MIT
/*
 * Copyright (C) BeagleBoard.org Foundation
 */

/dts-v1/;
/plugin/;

/*
 * Helper to show loaded overlays under: /proc/device-tree/chosen/overlays/
 */
&{/chosen} {
	overlays {
		k3-am67a-beagley-ai-i2c1-400000.kernel = __TIMESTAMP__;
	};
};

&mcu_i2c0 {
	status = "okay";
	clock-frequency = <400000>;

	#address-cells = <1>;
	#size-cells = <0>;
};
