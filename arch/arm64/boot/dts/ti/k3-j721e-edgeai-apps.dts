// SPDX-License-Identifier: GPL-2.0
/*
 * edgeai-apps: device-tree overlay
 *
 * Copyright (C) 2019 - 2021 Texas Instruments Incorporated - http://www.ti.com/
 */

#include "k3-j721e-rtos-memory-map.dtsi"

