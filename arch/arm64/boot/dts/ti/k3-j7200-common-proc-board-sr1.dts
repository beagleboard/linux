// SPDX-License-Identifier: GPL-2.0
/*
 * Device Tree Overlay for K3 J7200 board with SR1.0
 *
 * Copyright (C) 2022 Texas Instruments Incorporated - https://www.ti.com/
 */

#include "k3-j7200-sr1.dts"
