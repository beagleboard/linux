// SPDX-License-Identifier: GPL-2.0
/**
 * DT Overlay for enabling ECAP capture mode on AM625-SK board.
 *
 * Copyright (C) 2022 Texas Instruments Incorporated - https://www.ti.com/
 */

/dts-v1/;
/plugin/;

#include <dt-bindings/pinctrl/k3.h>

&main_pmx0 {
	main_ecap2_capture_pins_default: main-ecap2-capture-pins-default {
		pinctrl-single,pins = <
			AM62X_IOPAD(0x01a4, PIN_INPUT, 2) /* (B20) MCASP0_ACLKX.ECAP2_IN_APWM_OUT */
		>;
	};
};

&ecap2_pwm {
	status = "disabled";
};

&ecap2_capture {
	pinctrl-names = "default";
	pinctrl-0 = <&main_ecap2_capture_pins_default>;
	status = "okay";
};
