// SPDX-License-Identifier: GPL-2.0-only
/*
 * Copyright (C) 2012 Texas Instruments Incorporated - https://www.ti.com/
 */

#include <dt-bindings/board/am335x-bbw-bbb-base.h>
#include "am335x-peripheral-can0.dtsi"

/* cape universal */

/*
 *&ocp {
 *	P9_19_pinmux {
 *		mode = "can";
 *	};
 *	P9_20_pinmux {
 *		mode = "can";
 *	};
 *};
 *
 *&dcan0 {
 *	pinctrl-0 = <>;
 *};
 *
 */

/* standard */

&am33xx_pinmux {
	dcan0_pins: pinmux_dcan0_pins {
		pinctrl-single,pins = <
			/* P9_20: uart1_ctsn.d_can0_tx */
			BONE_P9_20 (PIN_OUTPUT_PULLUP | MUX_MODE2)
			/* P9_19: uart1_rtsn.d_can0_rx */
			BONE_P9_19 (PIN_INPUT_PULLUP | MUX_MODE2)
		>;
	};
};

&dcan0 {
	pinctrl-0 = <&dcan0_pins>;
};
