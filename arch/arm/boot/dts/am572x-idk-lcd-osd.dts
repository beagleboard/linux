/*
 * Copyright (C) 2015 Texas Instruments Incorporated - http://www.ti.com/
 *
 * This program is free software; you can redistribute it and/or modify
 * it under the terms of the GNU General Public License version 2 as
 * published by the Free Software Foundation.
 */

#include "am572x-idk.dts"
#include "am57xx-idk-lcd-osd.dtsi"

/ {
	model = "TI AM572x IDK-LCD-OSD-Display";
};

&touchscreen {
	interrupt-parent = <&gpio3>;
	interrupts = <14 IRQ_TYPE_EDGE_FALLING>;
};
