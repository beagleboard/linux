/*
 * Copyright (C) 2016 Texas Instruments Incorporated - http://www.ti.com/
 *
 * This program is free software; you can redistribute it and/or modify
 * it under the terms of the GNU General Public License version 2 as
 * published by the Free Software Foundation.
 */

#include "dra7-evm-lcd-osd.dts"

&lcd {
	compatible = "osd,osd101t2587-53ts", "panel-dpi";

	panel-timing {
		clock-frequency = <164400000>;
		hactive = <1920>;
		vactive = <1200>;

		hfront-porch = <152>;
		hback-porch = <20>;
		hsync-len = <52>;

		vfront-porch = <24>;
		vback-porch = <48>;
		vsync-len = <6>;

		hsync-active = <0>;
		vsync-active = <0>;
		de-active = <1>;
		pixelclk-active = <1>;
	};
};
