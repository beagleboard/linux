/*
 * Copyright (C) 2015-2016 Texas Instruments Incorporated - http://www.ti.com/
 *
 * This program is free software; you can redistribute it and/or modify
 * it under the terms of the GNU General Public License version 2 as
 * published by the Free Software Foundation.
 */

#include "am57xx-beagle-x15.dts"
#include "am57xx-evm-common.dtsi"
#include "am57xx-commercial-grade.dtsi"
#include "am57xx-cmem.dtsi"

/ {
	model = "TI AM5728 EVM";
};

&mmc3 {
	pinctrl-names = "default", "hs", "sdr12", "sdr25", "sdr50";
	pinctrl-0 = <&mmc3_pins_default>;
	pinctrl-1 = <&mmc3_pins_hs>;
	pinctrl-2 = <&mmc3_pins_sdr12>;
	pinctrl-3 = <&mmc3_pins_sdr25>;
	pinctrl-4 = <&mmc3_pins_sdr50 &mmc3_iodelay_manual1_rev11_conf>;
};
