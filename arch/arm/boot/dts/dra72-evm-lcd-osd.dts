/*
 * Copyright (C) 2016 Texas Instruments Incorporated - http://www.ti.com/
 *
 * This program is free software; you can redistribute it and/or modify
 * it under the terms of the GNU General Public License version 2 as
 * published by the Free Software Foundation.
 */

#include "dra72-evm.dts"
#include "dra7x-evm-lcd-osd.dtsi"

&touchscreen {
	interrupt-parent = <&gpio1>;
	interrupts = <15 IRQ_TYPE_EDGE_FALLING>;
};
