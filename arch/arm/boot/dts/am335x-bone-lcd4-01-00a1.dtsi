/*
 * Copyright (C) 2012 Texas Instruments Incorporated - http://www.ti.com/
 *
 * This program is free software; you can redistribute it and/or modify
 * it under the terms of the GNU General Public License version 2 as
 * published by the Free Software Foundation.
 */

/ {
	backlight {
		status = "okay";
		compatible = "gpio-backlight";
		pinctrl-names = "default";
		pinctrl-0 = <&bbcape_backlight_pins>;
		gpios = <&gpio1 18 GPIO_ACTIVE_HIGH>;
		default-on;
	};
};

#include "am335x-bone-ti-tscadc-4-wire.dtsi"
#include "am335x-bone-lcd4.dtsi"
