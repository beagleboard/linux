/*
 * Copyright (C) 2012 Texas Instruments Incorporated - http://www.ti.com/
 *
 * This program is free software; you can redistribute it and/or modify
 * it under the terms of the GNU General Public License version 2 as
 * published by the Free Software Foundation.
 */

#include "am335x-ttyO2.dtsi"

&ocp {
	P9_21_pinmux {
		mode = "uart";
	};
	P9_22_pinmux {
		mode = "uart";
	};
};
