/*
 * Device Tree Source for AM33xx Overlay EDMA fixes
 *
 * Copyright (C) 2015 Robert Nelson <robertcnelson@gmail.com>
 *
 * This program is free software; you can redistribute it and/or modify
 * it under the terms of the GNU General Public License version 2 as
 * published by the Free Software Foundation.
 */

&spi0 {
	status = "okay";
};

&spi1 {
	status = "okay";
};

&mcasp0 {
	status = "okay";
};

&mcasp1 {
	status = "okay";
};
