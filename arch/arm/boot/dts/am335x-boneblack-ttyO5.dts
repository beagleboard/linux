/*
 * Copyright (C) 2012 Texas Instruments Incorporated - http://www.ti.com/
 *
 * This program is free software; you can redistribute it and/or modify
 * it under the terms of the GNU General Public License version 2 as
 * published by the Free Software Foundation.
 */
/dts-v1/;

#include "am33xx.dtsi"
#include "am335x-bone-common.dtsi"
#include "am335x-bone-common-pinmux.dtsi"

&ldo3_reg {
	regulator-min-microvolt = <1800000>;
	regulator-max-microvolt = <1800000>;
	regulator-always-on;
};

&mmc1 {
	vmmc-supply = <&vmmcsd_fixed>;
};

&am33xx_pinmux {
	pinctrl-names = "default";
	pinctrl-0 = <&clkout2_pin>;
};

/* spi0: P9.17, P9.18, P9.21, P9.22 */
/* #include "am335x-bone-spi0-spidev.dtsi" */

/* uart1: P9.24, P9.26 */
/* #include "am335x-bone-ttyO1.dtsi" */
/* uart2: P9.21, P9.22 */
/* #include "am335x-bone-ttyO2.dtsi" */
/* uart4: P9.11, P9.13 */
/* #include "am335x-bone-ttyO4.dtsi" */
/* uart5: P8.37, P8.38 am335x-boneblack: hdmi has to be disabled for ttyO5 */
/* #include "am335x-bone-ttyO5.dtsi" */

#include "am335x-boneblack-emmc.dtsi"

/* Display */
/* #include "am335x-boneblack-nxp-hdmi.dtsi" */

/* Capes */
/* http://elinux.org/CircuitCo:Audio_Cape_RevB */
/* Pins: P9.24, P9.28, P9.29, P9.31, P9.30 */
/* #include "am335x-bone-audio.dtsi" */

/* http://elinux.org/CircuitCo:BeagleBone_LCD3 */
/* #include "am335x-bone-lcd3-01-00a2.dtsi" */

/* http://elinux.org/CircuitCo:BeagleBone_LCD4 */
/* #include "am335x-bone-lcd4-01-00a1.dtsi" */

/* http://elinux.org/CircuitCo:BeagleBone_LCD7 */
/* am335x-boneblack: emmc has to be disabled for lcd7-01-00a2 */
/* #include "am335x-bone-lcd7-01-00a2.dtsi" */
/* #include "am335x-bone-lcd7-01-00a3.dtsi" */
/* #include "am335x-bone-lcd7-01-00a4.dtsi" */

#include "am335x-bone-ttyO5.dtsi"
