/*
 * Copyright (C) 2012 Texas Instruments Incorporated - http://www.ti.com/
 *
 * This program is free software; you can redistribute it and/or modify
 * it under the terms of the GNU General Public License version 2 as
 * published by the Free Software Foundation.
 */

#include "am335x-can0.dtsi"

&ocp {
	P9_19_pinmux {
		mode = "can";
	};
	P9_20_pinmux {
		mode = "can";
	};
};
