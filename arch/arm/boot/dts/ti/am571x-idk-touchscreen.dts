// SPDX-License-Identifier: GPL-2.0
/*
 * Copyright (C) 2019 Texas Instruments Incorporated - http://www.ti.com/
 */

/dts-v1/;
/plugin/;
#include <dt-bindings/interrupt-controller/irq.h>

&touchscreen {
	interrupt-parent = <&gpio5>;
	interrupts = <6 IRQ_TYPE_EDGE_FALLING>;
};
