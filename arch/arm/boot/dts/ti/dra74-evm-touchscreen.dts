// SPDX-License-Identifier: GPL-2.0
/*
 * Copyright (C) 2019 Texas Instruments Incorporated - http://www.ti.com/
 */

/dts-v1/;
/plugin/;
#include <dt-bindings/interrupt-controller/irq.h>

&touchscreen {
	interrupt-parent = <&gpio1>;
	interrupts = <2 IRQ_TYPE_EDGE_FALLING>;
};
