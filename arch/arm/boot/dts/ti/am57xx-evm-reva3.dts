// SPDX-License-Identifier: GPL-2.0
/dts-v1/;
/plugin/;

&mmc3 {
	pinctrl-names = "default", "hs", "sdr12", "sdr25", "sdr50";
	pinctrl-0 = <&mmc3_pins_default>;
	pinctrl-1 = <&mmc3_pins_hs>;
	pinctrl-2 = <&mmc3_pins_sdr12>;
	pinctrl-3 = <&mmc3_pins_sdr25>;
	pinctrl-4 = <&mmc3_pins_sdr50 &mmc3_iodelay_manual1_rev20_conf>;
};
