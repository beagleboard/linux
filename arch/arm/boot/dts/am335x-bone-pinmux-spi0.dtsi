// SPDX-License-Identifier: GPL-2.0-only
/*
 * Copyright (C) 2012 Texas Instruments Incorporated - https://www.ti.com/
 */

#include <dt-bindings/board/am335x-bbw-bbb-base.h>
#include "am335x-peripheral-spi0.dtsi"

/* cape universal */

/*
 *&ocp {
 *	P9_17_pinmux {
 *		status = "disabled";
 *	};
 *	P9_18_pinmux {
 *		status = "disabled";
 *	};
 *	P9_21_pinmux {
 *		status = "disabled";
 *	};
 *	P9_22_pinmux {
 *		status = "disabled";
 *	};
 *};
 *
 *&spi0 {
 *	pinctrl-0 = <>;
 *};
 *
 */

/* standard */

&am33xx_pinmux {
	spi0_pins: pinmux_spi0_pins {
		pinctrl-single,pins = <
			0x150 (PIN_INPUT_PULLUP | MUX_MODE0)	/* spi0_sclk.spi0_sclk */
			0x154 (PIN_INPUT_PULLUP | MUX_MODE0)	/* spi0_d0.spi0_d0 */
			0x158 (PIN_OUTPUT_PULLUP | MUX_MODE0)	/* spi0_d1.spi0_d1 */
			0x15c (PIN_OUTPUT_PULLUP | MUX_MODE0)	/* spi0_cs0.spi0_cs0 */
		>;
	};
};

&spi0 {
	pinctrl-0 = <&spi0_pins>;
};
