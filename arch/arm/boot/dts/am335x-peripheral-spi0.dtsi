/*
 * Copyright (C) 2012 Texas Instruments Incorporated - http://www.ti.com/
 *
 * This program is free software; you can redistribute it and/or modify
 * it under the terms of the GNU General Public License version 2 as
 * published by the Free Software Foundation.
 */

&spi0 {
	pinctrl-names = "default";

	status = "okay";

	channel@0 {
		compatible = "spidev";
		spi-max-frequency = <16000000>;
		reg = <0>;
		spi-cpha;
	};

	channel@1 {
		compatible = "spidev";
		spi-max-frequency = <16000000>;
		reg = <1>;
	};
};
