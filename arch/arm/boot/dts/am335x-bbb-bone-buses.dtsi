// SPDX-License-Identifier: GPL-2.0-only
/*
 * Copyright (C) 2020 Deepak Khatri <deepaklorkhatri7@gmail.com>
 * Copyright (C) 2021 Robert Nelson <robertcnelson@gmail.com>
 * See Cape Interface Spec page for more info on Bone Buses
 * https://elinux.org/Beagleboard:BeagleBone_cape_interface_spec
 * https://docs.beagleboard.io/latest/boards/capes/cape-interface-spec.html
 */

#include <dt-bindings/board/am335x-bone-pins.h>
#include <dt-bindings/gpio/gpio.h>
#include <dt-bindings/pinctrl/am33xx.h>

/********/
/* LEDs */
/********/
&{/} {
	leds {
		pinctrl-names = "default";
		compatible = "gpio-leds";

		/* macro: BONE_LED(<headerpin>) */
		#define BONE_LED(PX_YY)\
			bone_led_##PX_YY##: led_##PX_YY {\
				status = "disabled";\
				linux,default-trigger = "default-off";\
				gpios = <gpio_##PX_YY GPIO_ACTIVE_HIGH>;\
			};

		BONE_LED(P8_03)
		BONE_LED(P8_04)
		BONE_LED(P8_05)
		BONE_LED(P8_06)
		BONE_LED(P8_07)
		BONE_LED(P8_08)
		BONE_LED(P8_09)
		BONE_LED(P8_10)
		BONE_LED(P8_11)
		BONE_LED(P8_12)
		BONE_LED(P8_13)
		BONE_LED(P8_14)
		BONE_LED(P8_15)
		BONE_LED(P8_16)
		BONE_LED(P8_17)
		BONE_LED(P8_18)
		BONE_LED(P8_19)
		BONE_LED(P8_20)
		BONE_LED(P8_21)
		BONE_LED(P8_22)
		BONE_LED(P8_23)
		BONE_LED(P8_24)
		BONE_LED(P8_25)
		BONE_LED(P8_26)
		BONE_LED(P8_27)
		BONE_LED(P8_28)
		BONE_LED(P8_29)
		BONE_LED(P8_30)
		BONE_LED(P8_31)
		BONE_LED(P8_32)
		BONE_LED(P8_33)
		BONE_LED(P8_34)
		BONE_LED(P8_35)
		BONE_LED(P8_36)
		BONE_LED(P8_37)
		BONE_LED(P8_38)
		BONE_LED(P8_39)
		BONE_LED(P8_40)
		BONE_LED(P8_41)
		BONE_LED(P8_42)
		BONE_LED(P8_43)
		BONE_LED(P8_44)
		BONE_LED(P8_45)
		BONE_LED(P8_46)

		/*P9 header Bone LEDs*/
		BONE_LED(P9_11)
		BONE_LED(P9_12)
		BONE_LED(P9_13)
		BONE_LED(P9_14)
		BONE_LED(P9_15)
		BONE_LED(P9_16)
		BONE_LED(P9_17)
		BONE_LED(P9_18)
		BONE_LED(P9_19)
		BONE_LED(P9_20)
		BONE_LED(P9_21)
		BONE_LED(P9_22)
		BONE_LED(P9_23)
		BONE_LED(P9_24)
		BONE_LED(P9_25)
		BONE_LED(P9_26)
		BONE_LED(P9_27)
		BONE_LED(P9_28)
		BONE_LED(P9_29)
		BONE_LED(P9_30)
		BONE_LED(P9_31)

		BONE_LED(P9_41)
		BONE_LED(P9_91)
		BONE_LED(P9_42)
		BONE_LED(P9_92)

		BONE_LED(A15)
	};
};

// For dummy refrence when peripheral is not available.
&{/} {
	not_available: not_available {
		// Use &not_available when required.
		// This node is responsible to create these entries,
		// /sys/firmware/devicetree/base/__symbols__/not_available
		// /sys/firmware/devicetree/base/not_available
	};
};

// For compatible bone pinmuxing
bone_pinmux: &am33xx_pinmux {
	bborg_comms_can_pins: pinmux_comms_can_pins {
		pinctrl-single,pins = <
			0x184 (PIN_INPUT_PULLUP | MUX_MODE2)	/* P9_24: uart1_txd.d_can1_rx */
			0x180 (PIN_OUTPUT_PULLUP | MUX_MODE2)	/* P9_26: uart1_rxd.d_can1_tx */
		>;
	};

	bborg_comms_rs485_pins: pinmux_comms_rs485_pins {
		pinctrl-single,pins = <
			0x074 (PIN_OUTPUT | MUX_MODE6)	/* P9_13: gpmc_wpn.uart4_txd_mux2 */
			0x070 (PIN_INPUT  | MUX_MODE6)	/* P9_11: gpmc_wait0.uart4_rxd_mux2 */
		>;
	};
};

// ADC
bone_adc: &tscadc {

};

// UART
// https://docs.beagleboard.io/latest/boards/capes/cape-interface-spec.html#uart
bone_uart_4: &uart4 {
	symlink = "bone/uart/4";
	status = "disabled";
	pinctrl-names = "default";
	pinctrl-0 = <&bborg_comms_rs485_pins>;
	//rs485-rts-delay = <0 0>;
	//rts-gpio = <&gpio3 19 1>; /*  GPIO_ACTIVE_HIGH>; */
	//rs485-rts-active-high;
	//linux,rs485-enabled-at-boot-time;
};

// CAN
// https://docs.beagleboard.io/latest/boards/capes/cape-interface-spec.html#can
bone_can_1: &dcan1 {
	symlink = "bone/can/1";
	status = "disabled";
	pinctrl-names = "default";
//	pinctrl-0 = <
//		&P9_26_can_pin /* tx */
//		&P9_24_can_pin /* rx */
//	>;
	pinctrl-0 = <&bborg_comms_can_pins>;
};
