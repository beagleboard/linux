/*
 * Copyright (C) 2013 Texas Instruments Incorporated - http://www.ti.com/
 *
 * This program is free software; you can redistribute it and/or modify
 * it under the terms of the GNU General Public License version 2 as
 * published by the Free Software Foundation.
 */

#include "dra7-evm.dts"
#include "dra7xx-evm-lcd10.dtsi"

&tlv320aic3106 {
	reg = <0x19>;
};
