// SPDX-License-Identifier: GPL-2.0-only
/*
 * Copyright (C) 2012 Texas Instruments Incorporated - https://www.ti.com/
 */

#include <dt-bindings/board/am335x-bone-pins.h>

&am33xx_pinmux {

/* macro: BONE_PIN( <pin>, <mode_name>, <register_value_macro(s)> */
#define BONE_PIN(XX,ZZ,QQ) \
	XX##_##ZZ##_pin: pinmux_##XX##_##ZZ##_pin { pinctrl-single,pins = < QQ >; };

	/************************/
	/* P8 Header */
	/************************/

	/* P8_01                GND */

	/* P8_02                GND */


	/* P8_03 (ZCZ ball R9) gpmc_ad6 (emmc) */
	BONE_PIN(P8_03, default, P8_03(PIN_OUTPUT_PULLDOWN | INPUT_EN | MUX_MODE7))
	BONE_PIN(P8_03, gpio, P8_03(PIN_OUTPUT | INPUT_EN | MUX_MODE7))
	BONE_PIN(P8_03, gpio_pu, P8_03(PIN_OUTPUT_PULLUP | INPUT_EN | MUX_MODE7))
	BONE_PIN(P8_03, gpio_pd, P8_03(PIN_OUTPUT_PULLDOWN | INPUT_EN | MUX_MODE7))

	/* P8_04 (ZCZ ball T9) gpmc_ad7 (emmc) */
	BONE_PIN(P8_04, default, P8_04(PIN_OUTPUT_PULLDOWN | INPUT_EN | MUX_MODE7))
	BONE_PIN(P8_04, gpio, P8_04(PIN_OUTPUT | INPUT_EN | MUX_MODE7))
	BONE_PIN(P8_04, gpio_pu, P8_04(PIN_OUTPUT_PULLUP | INPUT_EN | MUX_MODE7))
	BONE_PIN(P8_04, gpio_pd, P8_04(PIN_OUTPUT_PULLDOWN | INPUT_EN | MUX_MODE7))

	/* P8_05 (ZCZ ball R8) gpmc_ad2 (emmc) */
	BONE_PIN(P8_05, default, P8_05(PIN_OUTPUT_PULLDOWN | INPUT_EN | MUX_MODE7))
	BONE_PIN(P8_05, gpio, P8_05(PIN_OUTPUT | INPUT_EN | MUX_MODE7))
	BONE_PIN(P8_05, gpio_pu, P8_05(PIN_OUTPUT_PULLUP | INPUT_EN | MUX_MODE7))
	BONE_PIN(P8_05, gpio_pd, P8_05(PIN_OUTPUT_PULLDOWN | INPUT_EN | MUX_MODE7))

	/* P8_06 (ZCZ ball T8) gpmc_ad3 (emmc) */
	BONE_PIN(P8_06, default, P8_06(PIN_OUTPUT_PULLDOWN | INPUT_EN | MUX_MODE7))
	BONE_PIN(P8_06, gpio, P8_06(PIN_OUTPUT | INPUT_EN | MUX_MODE7))
	BONE_PIN(P8_06, gpio_pu, P8_06(PIN_OUTPUT_PULLUP | INPUT_EN | MUX_MODE7))
	BONE_PIN(P8_06, gpio_pd, P8_06(PIN_OUTPUT_PULLDOWN | INPUT_EN | MUX_MODE7))

	/* P8_07 (ZCZ ball R7) gpmc_advn_ale (gpio2_2) */
	BONE_PIN(P8_07, default, P8_07(PIN_OUTPUT_PULLUP | INPUT_EN | MUX_MODE7))
	BONE_PIN(P8_07, gpio, P8_07(PIN_OUTPUT | INPUT_EN | MUX_MODE7))
	BONE_PIN(P8_07, gpio_pu, P8_07(PIN_OUTPUT_PULLUP | INPUT_EN | MUX_MODE7))
	BONE_PIN(P8_07, gpio_pd, P8_07(PIN_OUTPUT_PULLDOWN | INPUT_EN | MUX_MODE7))
	BONE_PIN(P8_07, timer, P8_07(PIN_OUTPUT_PULLUP | INPUT_EN | MUX_MODE2))

	/* P8_08 (ZCZ ball T7) gpmc_oen_ren (gpio2_3) */
	BONE_PIN(P8_08, default, P8_08(PIN_OUTPUT_PULLUP | INPUT_EN | MUX_MODE7))
	BONE_PIN(P8_08, gpio, P8_08(PIN_OUTPUT | INPUT_EN | MUX_MODE7))
	BONE_PIN(P8_08, gpio_pu, P8_08(PIN_OUTPUT_PULLUP | INPUT_EN | MUX_MODE7))
	BONE_PIN(P8_08, gpio_pd, P8_08(PIN_OUTPUT_PULLDOWN | INPUT_EN | MUX_MODE7))
	BONE_PIN(P8_08, timer, P8_08(PIN_OUTPUT_PULLUP | INPUT_EN | MUX_MODE2))

	/* P8_09 (ZCZ ball T6) gpmc_be0n_cle (gpio2_5) */
	BONE_PIN(P8_09, default, P8_09(PIN_OUTPUT_PULLUP | INPUT_EN | MUX_MODE7))
	BONE_PIN(P8_09, gpio, P8_09(PIN_OUTPUT | INPUT_EN | MUX_MODE7))
	BONE_PIN(P8_09, gpio_pu, P8_09(PIN_OUTPUT_PULLUP | INPUT_EN | MUX_MODE7))
	BONE_PIN(P8_09, gpio_pd, P8_09(PIN_OUTPUT_PULLDOWN | INPUT_EN | MUX_MODE7))
	BONE_PIN(P8_09, timer, P8_09(PIN_OUTPUT_PULLUP | INPUT_EN | MUX_MODE2))

	/* P8_10 (ZCZ ball U6) gpmc_wen (gpio2_4) */
	BONE_PIN(P8_10, default, P8_10(PIN_OUTPUT_PULLUP | INPUT_EN | MUX_MODE7))
	BONE_PIN(P8_10, gpio, P8_10(PIN_OUTPUT | INPUT_EN | MUX_MODE7))
	BONE_PIN(P8_10, gpio_pu, P8_10(PIN_OUTPUT_PULLUP | INPUT_EN | MUX_MODE7))
	BONE_PIN(P8_10, gpio_pd, P8_10(PIN_OUTPUT_PULLDOWN | INPUT_EN | MUX_MODE7))
	BONE_PIN(P8_10, timer, P8_10(PIN_OUTPUT_PULLUP | INPUT_EN | MUX_MODE2))

	/* P8_11 (ZCZ ball R12) gpmc_ad13 (gpio1_13) */
	BONE_PIN(P8_11, default, P8_11(PIN_OUTPUT_PULLDOWN | INPUT_EN | MUX_MODE7))
	BONE_PIN(P8_11, gpio, P8_11(PIN_OUTPUT | INPUT_EN | MUX_MODE7))
	BONE_PIN(P8_11, gpio_pu, P8_11(PIN_OUTPUT_PULLUP | INPUT_EN | MUX_MODE7))
	BONE_PIN(P8_11, gpio_pd, P8_11(PIN_OUTPUT_PULLDOWN | INPUT_EN | MUX_MODE7))
	BONE_PIN(P8_11, eqep, P8_11(PIN_OUTPUT_PULLUP | INPUT_EN | MUX_MODE4))
	BONE_PIN(P8_11, pruout, P8_11(PIN_OUTPUT_PULLDOWN | INPUT_EN | MUX_MODE6))

	/* P8_12 (ZCZ ball T12) gpmc_ad12 (gpio1_12) */
	BONE_PIN(P8_12, default, P8_12(PIN_OUTPUT_PULLDOWN | INPUT_EN | MUX_MODE7))
	BONE_PIN(P8_12, gpio, P8_12(PIN_OUTPUT | INPUT_EN | MUX_MODE7))
	BONE_PIN(P8_12, gpio_pu, P8_12(PIN_OUTPUT_PULLUP | INPUT_EN | MUX_MODE7))
	BONE_PIN(P8_12, gpio_pd, P8_12(PIN_OUTPUT_PULLDOWN | INPUT_EN | MUX_MODE7))
	BONE_PIN(P8_12, eqep, P8_12(PIN_OUTPUT_PULLUP | INPUT_EN | MUX_MODE4))
	BONE_PIN(P8_12, pruout, P8_12(PIN_OUTPUT_PULLDOWN | INPUT_EN | MUX_MODE6))

	/* P8_13 (ZCZ ball T10) gpmc_ad9 (gpio0_23) */
	BONE_PIN(P8_13, default, P8_13(PIN_OUTPUT_PULLDOWN | INPUT_EN | MUX_MODE7))
	BONE_PIN(P8_13, gpio, P8_13(PIN_OUTPUT | INPUT_EN | MUX_MODE7))
	BONE_PIN(P8_13, gpio_pu, P8_13(PIN_OUTPUT_PULLUP | INPUT_EN | MUX_MODE7))
	BONE_PIN(P8_13, gpio_pd, P8_13(PIN_OUTPUT_PULLDOWN | INPUT_EN | MUX_MODE7))
	BONE_PIN(P8_13, pwm, P8_13(PIN_OUTPUT_PULLDOWN | INPUT_EN | MUX_MODE4))

	/* P8_14 (ZCZ ball T11) wl1835: wl_en */

	/* P8_15 (ZCZ ball U13) gpmc_ad15 (gpio1_15) */
	BONE_PIN(P8_15, default, P8_15(PIN_OUTPUT_PULLDOWN | INPUT_EN | MUX_MODE7))
	BONE_PIN(P8_15, gpio, P8_15(PIN_OUTPUT | INPUT_EN | MUX_MODE7))
	BONE_PIN(P8_15, gpio_pu, P8_15(PIN_OUTPUT_PULLUP | INPUT_EN | MUX_MODE7))
	BONE_PIN(P8_15, gpio_pd, P8_15(PIN_OUTPUT_PULLDOWN | INPUT_EN | MUX_MODE7))
	BONE_PIN(P8_15, eqep, P8_15(PIN_OUTPUT_PULLUP | INPUT_EN | MUX_MODE4))
	BONE_PIN(P8_15, pru_ecap_pwm, P8_15(PIN_OUTPUT_PULLDOWN | INPUT_EN | MUX_MODE5))
	BONE_PIN(P8_15, pruin, P8_15(PIN_INPUT | MUX_MODE6))

	/* P8_16 (ZCZ ball V13) gpmc_ad14 (gpio1_14) */
	BONE_PIN(P8_16, default, P8_16(PIN_OUTPUT_PULLDOWN | INPUT_EN | MUX_MODE7))
	BONE_PIN(P8_16, gpio, P8_16(PIN_OUTPUT | INPUT_EN | MUX_MODE7))
	BONE_PIN(P8_16, gpio_pu, P8_16(PIN_OUTPUT_PULLUP | INPUT_EN | MUX_MODE7))
	BONE_PIN(P8_16, gpio_pd, P8_16(PIN_OUTPUT_PULLDOWN | INPUT_EN | MUX_MODE7))
	BONE_PIN(P8_16, eqep, P8_16(PIN_OUTPUT_PULLUP | INPUT_EN | MUX_MODE4))
	BONE_PIN(P8_16, pruin, P8_16(PIN_INPUT | MUX_MODE6))

	/* P8_17 (ZCZ ball U12) wl1835: wl_irq */

	/* P8_18 (ZCZ ball V12) gpmc_clk (gpio2_1) */
	BONE_PIN(P8_18, default, P8_18(PIN_OUTPUT_PULLDOWN | INPUT_EN | MUX_MODE7))
	BONE_PIN(P8_18, gpio, P8_18(PIN_OUTPUT | INPUT_EN | MUX_MODE7))
	BONE_PIN(P8_18, gpio_pu, P8_18(PIN_OUTPUT_PULLUP | INPUT_EN | MUX_MODE7))
	BONE_PIN(P8_18, gpio_pd, P8_18(PIN_OUTPUT_PULLDOWN | INPUT_EN | MUX_MODE7))

	/* P8_19 (ZCZ ball U10) gpmc_ad8 (gpio0_22) */
	BONE_PIN(P8_19, default, P8_19(PIN_OUTPUT_PULLDOWN | INPUT_EN | MUX_MODE7))
	BONE_PIN(P8_19, gpio, P8_19(PIN_OUTPUT | INPUT_EN | MUX_MODE7))
	BONE_PIN(P8_19, gpio_pu, P8_19(PIN_OUTPUT_PULLUP | INPUT_EN | MUX_MODE7))
	BONE_PIN(P8_19, gpio_pd, P8_19(PIN_OUTPUT_PULLDOWN | INPUT_EN | MUX_MODE7))
	BONE_PIN(P8_19, pwm, P8_19(PIN_OUTPUT_PULLDOWN | INPUT_EN | MUX_MODE4))

	/* P8_20 (ZCZ ball V9) gpmc_csn2 (emmc) */
	BONE_PIN(P8_20, default, P8_20(PIN_OUTPUT_PULLDOWN | INPUT_EN | MUX_MODE7))
	BONE_PIN(P8_20, gpio, P8_20(PIN_OUTPUT | INPUT_EN | MUX_MODE7))
	BONE_PIN(P8_20, gpio_pu, P8_20(PIN_OUTPUT_PULLUP | INPUT_EN | MUX_MODE7))
	BONE_PIN(P8_20, gpio_pd, P8_20(PIN_OUTPUT_PULLDOWN | INPUT_EN | MUX_MODE7))
	BONE_PIN(P8_20, pruout, P8_20(PIN_OUTPUT_PULLDOWN | INPUT_EN | MUX_MODE5))
	BONE_PIN(P8_20, pruin, P8_20(PIN_INPUT | MUX_MODE6))

	/* P8_21 (ZCZ ball U9) gpmc_csn1 (emmc) */
	BONE_PIN(P8_21, default, P8_21(PIN_OUTPUT_PULLDOWN | INPUT_EN | MUX_MODE7))
	BONE_PIN(P8_21, gpio, P8_21(PIN_OUTPUT | INPUT_EN | MUX_MODE7))
	BONE_PIN(P8_21, gpio_pu, P8_21(PIN_OUTPUT_PULLUP | INPUT_EN | MUX_MODE7))
	BONE_PIN(P8_21, gpio_pd, P8_21(PIN_OUTPUT_PULLDOWN | INPUT_EN | MUX_MODE7))
	BONE_PIN(P8_21, pruout, P8_21(PIN_OUTPUT_PULLDOWN | INPUT_EN | MUX_MODE5))
	BONE_PIN(P8_21, pruin, P8_21(PIN_INPUT | MUX_MODE6))

	/* P8_22 (ZCZ ball V8) gpmc_ad5 (emmc) */
	BONE_PIN(P8_22, default, P8_22(PIN_OUTPUT_PULLDOWN | INPUT_EN | MUX_MODE7))
	BONE_PIN(P8_22, gpio, P8_22(PIN_OUTPUT | INPUT_EN | MUX_MODE7))
	BONE_PIN(P8_22, gpio_pu, P8_22(PIN_OUTPUT_PULLUP | INPUT_EN | MUX_MODE7))
	BONE_PIN(P8_22, gpio_pd, P8_22(PIN_OUTPUT_PULLDOWN | INPUT_EN | MUX_MODE7))

	/* P8_23 (ZCZ ball U8) gpmc_ad4 (emmc) */
	BONE_PIN(P8_23, default, P8_23(PIN_OUTPUT_PULLDOWN | INPUT_EN | MUX_MODE7))
	BONE_PIN(P8_23, gpio, P8_23(PIN_OUTPUT | INPUT_EN | MUX_MODE7))
	BONE_PIN(P8_23, gpio_pu, P8_23(PIN_OUTPUT_PULLUP | INPUT_EN | MUX_MODE7))
	BONE_PIN(P8_23, gpio_pd, P8_23(PIN_OUTPUT_PULLDOWN | INPUT_EN | MUX_MODE7))

	/* P8_24 (ZCZ ball V7) gpmc_ad1 (emmc) */
	BONE_PIN(P8_24, default, P8_24(PIN_OUTPUT_PULLDOWN | INPUT_EN | MUX_MODE7))
	BONE_PIN(P8_24, gpio, P8_24(PIN_OUTPUT | INPUT_EN | MUX_MODE7))
	BONE_PIN(P8_24, gpio_pu, P8_24(PIN_OUTPUT_PULLUP | INPUT_EN | MUX_MODE7))
	BONE_PIN(P8_24, gpio_pd, P8_24(PIN_OUTPUT_PULLDOWN | INPUT_EN | MUX_MODE7))

	/* P8_25 (ZCZ ball U7) gpmc_ad0 (emmc) */
	BONE_PIN(P8_25, default, P8_25(PIN_OUTPUT_PULLDOWN | INPUT_EN | MUX_MODE7))
	BONE_PIN(P8_25, gpio, P8_25(PIN_OUTPUT | INPUT_EN | MUX_MODE7))
	BONE_PIN(P8_25, gpio_pu, P8_25(PIN_OUTPUT_PULLUP | INPUT_EN | MUX_MODE7))
	BONE_PIN(P8_25, gpio_pd, P8_25(PIN_OUTPUT_PULLDOWN | INPUT_EN | MUX_MODE7))

	/* P8_26 (ZCZ ball V6) gpio-hog wl1835 */

	/* P8_27 (ZCZ ball U5) lcd_vsync (hdmi) */
	BONE_PIN(P8_27, default, P8_27(PIN_OUTPUT_PULLDOWN | INPUT_EN | MUX_MODE7))
	BONE_PIN(P8_27, gpio, P8_27(PIN_OUTPUT | INPUT_EN | MUX_MODE7))
	BONE_PIN(P8_27, gpio_pu, P8_27(PIN_OUTPUT_PULLUP | INPUT_EN | MUX_MODE7))
	BONE_PIN(P8_27, gpio_pd, P8_27(PIN_OUTPUT_PULLDOWN | INPUT_EN | MUX_MODE7))
	BONE_PIN(P8_27, pruout, P8_27(PIN_OUTPUT_PULLDOWN | INPUT_EN | MUX_MODE5))
	BONE_PIN(P8_27, pruin, P8_27(PIN_INPUT | MUX_MODE6))

	/* P8_28 (ZCZ ball V5) lcd_pclk (hdmi) */
	BONE_PIN(P8_28, default, P8_28(PIN_OUTPUT_PULLDOWN | INPUT_EN | MUX_MODE7))
	BONE_PIN(P8_28, gpio, P8_28(PIN_OUTPUT | INPUT_EN | MUX_MODE7))
	BONE_PIN(P8_28, gpio_pu, P8_28(PIN_OUTPUT_PULLUP | INPUT_EN | MUX_MODE7))
	BONE_PIN(P8_28, gpio_pd, P8_28(PIN_OUTPUT_PULLDOWN | INPUT_EN | MUX_MODE7))
	BONE_PIN(P8_28, pruout, P8_28(PIN_OUTPUT_PULLDOWN | INPUT_EN | MUX_MODE5))
	BONE_PIN(P8_28, pruin, P8_28(PIN_INPUT | MUX_MODE6))

	/* P8_29 (ZCZ ball R5) lcd_hsync (hdmi) */
	BONE_PIN(P8_29, default, P8_29(PIN_OUTPUT_PULLDOWN | INPUT_EN | MUX_MODE7))
	BONE_PIN(P8_29, gpio, P8_29(PIN_OUTPUT | INPUT_EN | MUX_MODE7))
	BONE_PIN(P8_29, gpio_pu, P8_29(PIN_OUTPUT_PULLUP | INPUT_EN | MUX_MODE7))
	BONE_PIN(P8_29, gpio_pd, P8_29(PIN_OUTPUT_PULLDOWN | INPUT_EN | MUX_MODE7))
	BONE_PIN(P8_29, pruout, P8_29(PIN_OUTPUT_PULLDOWN | INPUT_EN | MUX_MODE5))
	BONE_PIN(P8_29, pruin, P8_29(PIN_INPUT | MUX_MODE6))

	/* P8_30 (ZCZ ball R6) lcd_ac_bias_en (hdmi) */
	BONE_PIN(P8_30, default, P8_30(PIN_OUTPUT_PULLDOWN | INPUT_EN | MUX_MODE7))
	BONE_PIN(P8_30, gpio, P8_30(PIN_OUTPUT | INPUT_EN | MUX_MODE7))
	BONE_PIN(P8_30, gpio_pu, P8_30(PIN_OUTPUT_PULLUP | INPUT_EN | MUX_MODE7))
	BONE_PIN(P8_30, gpio_pd, P8_30(PIN_OUTPUT_PULLDOWN | INPUT_EN | MUX_MODE7))
	BONE_PIN(P8_30, pruout, P8_30(PIN_OUTPUT_PULLDOWN | INPUT_EN | MUX_MODE5))
	BONE_PIN(P8_30, pruin, P8_30(PIN_INPUT | MUX_MODE6))

	/* P8_31 (ZCZ ball V4) lcd_data14 (hdmi) */
	BONE_PIN(P8_31, default, P8_31(PIN_OUTPUT_PULLDOWN | INPUT_EN | MUX_MODE7))
	BONE_PIN(P8_31, gpio, P8_31(PIN_OUTPUT | INPUT_EN | MUX_MODE7))
	BONE_PIN(P8_31, gpio_pu, P8_31(PIN_OUTPUT_PULLUP | INPUT_EN | MUX_MODE7))
	BONE_PIN(P8_31, gpio_pd, P8_31(PIN_OUTPUT_PULLDOWN | INPUT_EN | MUX_MODE7))
	BONE_PIN(P8_31, eqep, P8_31(PIN_OUTPUT_PULLUP | INPUT_EN | MUX_MODE2))
	BONE_PIN(P8_31, uart, P8_31(PIN_OUTPUT_PULLUP | INPUT_EN | MUX_MODE4))

	/* P8_32 (ZCZ ball T5) lcd_data15 (hdmi) */
	BONE_PIN(P8_32, default, P8_32(PIN_OUTPUT_PULLDOWN | INPUT_EN | MUX_MODE7))
	BONE_PIN(P8_32, gpio, P8_32(PIN_OUTPUT | INPUT_EN | MUX_MODE7))
	BONE_PIN(P8_32, gpio_pu, P8_32(PIN_OUTPUT_PULLUP | INPUT_EN | MUX_MODE7))
	BONE_PIN(P8_32, gpio_pd, P8_32(PIN_OUTPUT_PULLDOWN | INPUT_EN | MUX_MODE7))
	BONE_PIN(P8_32, eqep, P8_32(PIN_OUTPUT_PULLUP | INPUT_EN | MUX_MODE2))

	/* P8_33 (ZCZ ball V3) lcd_data13 (hdmi) */
	BONE_PIN(P8_33, default, P8_33(PIN_OUTPUT_PULLDOWN | INPUT_EN | MUX_MODE7))
	BONE_PIN(P8_33, gpio, P8_33(PIN_OUTPUT | INPUT_EN | MUX_MODE7))
	BONE_PIN(P8_33, gpio_pu, P8_33(PIN_OUTPUT_PULLUP | INPUT_EN | MUX_MODE7))
	BONE_PIN(P8_33, gpio_pd, P8_33(PIN_OUTPUT_PULLDOWN | INPUT_EN | MUX_MODE7))
	BONE_PIN(P8_33, eqep, P8_33(PIN_OUTPUT_PULLUP | INPUT_EN | MUX_MODE2))

	/* P8_34 (ZCZ ball U4) lcd_data11 (hdmi) */
	BONE_PIN(P8_34, default, P8_34(PIN_OUTPUT_PULLDOWN | INPUT_EN | MUX_MODE7))
	BONE_PIN(P8_34, gpio, P8_34(PIN_OUTPUT | INPUT_EN | MUX_MODE7))
	BONE_PIN(P8_34, gpio_pu, P8_34(PIN_OUTPUT_PULLUP | INPUT_EN | MUX_MODE7))
	BONE_PIN(P8_34, gpio_pd, P8_34(PIN_OUTPUT_PULLDOWN | INPUT_EN | MUX_MODE7))
	BONE_PIN(P8_34, pwm, P8_34(PIN_OUTPUT_PULLDOWN | INPUT_EN | MUX_MODE2))

	/* P8_35 (ZCZ ball V2) lcd_data12 (hdmi) */
	BONE_PIN(P8_35, default, P8_35(PIN_OUTPUT_PULLDOWN | INPUT_EN | MUX_MODE7))
	BONE_PIN(P8_35, gpio, P8_35(PIN_OUTPUT | INPUT_EN | MUX_MODE7))
	BONE_PIN(P8_35, gpio_pu, P8_35(PIN_OUTPUT_PULLUP | INPUT_EN | MUX_MODE7))
	BONE_PIN(P8_35, gpio_pd, P8_35(PIN_OUTPUT_PULLDOWN | INPUT_EN | MUX_MODE7))
	BONE_PIN(P8_35, eqep, P8_35(PIN_OUTPUT_PULLUP | INPUT_EN | MUX_MODE2))

	/* P8_36 (ZCZ ball U3) lcd_data10 (hdmi) */
	BONE_PIN(P8_36, default, P8_36(PIN_OUTPUT_PULLDOWN | INPUT_EN | MUX_MODE7))
	BONE_PIN(P8_36, gpio, P8_36(PIN_OUTPUT | INPUT_EN | MUX_MODE7))
	BONE_PIN(P8_36, gpio_pu, P8_36(PIN_OUTPUT_PULLUP | INPUT_EN | MUX_MODE7))
	BONE_PIN(P8_36, gpio_pd, P8_36(PIN_OUTPUT_PULLDOWN | INPUT_EN | MUX_MODE7))
	BONE_PIN(P8_36, pwm, P8_36(PIN_OUTPUT_PULLDOWN | INPUT_EN | MUX_MODE2))

	/* P8_37 (ZCZ ball U1) lcd_data8 (hdmi) */
	BONE_PIN(P8_37, default, P8_37(PIN_OUTPUT_PULLDOWN | INPUT_EN | MUX_MODE7))
	BONE_PIN(P8_37, gpio, P8_37(PIN_OUTPUT | INPUT_EN | MUX_MODE7))
	BONE_PIN(P8_37, gpio_pu, P8_37(PIN_OUTPUT_PULLUP | INPUT_EN | MUX_MODE7))
	BONE_PIN(P8_37, gpio_pd, P8_37(PIN_OUTPUT_PULLDOWN | INPUT_EN | MUX_MODE7))
	BONE_PIN(P8_37, pwm, P8_37(PIN_OUTPUT_PULLDOWN | INPUT_EN | MUX_MODE2))
	BONE_PIN(P8_37, uart, P8_37(PIN_OUTPUT_PULLUP | INPUT_EN | MUX_MODE4))

	/* P8_38 (ZCZ ball U2) lcd_data9 (hdmi) */
	BONE_PIN(P8_38, default, P8_38(PIN_OUTPUT_PULLDOWN | INPUT_EN | MUX_MODE7))
	BONE_PIN(P8_38, gpio, P8_38(PIN_OUTPUT | INPUT_EN | MUX_MODE7))
	BONE_PIN(P8_38, gpio_pu, P8_38(PIN_OUTPUT_PULLUP | INPUT_EN | MUX_MODE7))
	BONE_PIN(P8_38, gpio_pd, P8_38(PIN_OUTPUT_PULLDOWN | INPUT_EN | MUX_MODE7))
	BONE_PIN(P8_38, pwm, P8_38(PIN_OUTPUT_PULLDOWN | INPUT_EN | MUX_MODE2))
	BONE_PIN(P8_38, uart, P8_38(PIN_OUTPUT_PULLUP | INPUT_EN | MUX_MODE4))

	/* P8_39 (ZCZ ball T3) lcd_data6 (hdmi) */
	BONE_PIN(P8_39, default, P8_39(PIN_OUTPUT_PULLDOWN | INPUT_EN | MUX_MODE7))
	BONE_PIN(P8_39, gpio, P8_39(PIN_OUTPUT | INPUT_EN | MUX_MODE7))
	BONE_PIN(P8_39, gpio_pu, P8_39(PIN_OUTPUT_PULLUP | INPUT_EN | MUX_MODE7))
	BONE_PIN(P8_39, gpio_pd, P8_39(PIN_OUTPUT_PULLDOWN | INPUT_EN | MUX_MODE7))
	BONE_PIN(P8_39, eqep, P8_39(PIN_OUTPUT_PULLUP | INPUT_EN | MUX_MODE3))
	BONE_PIN(P8_39, pruout, P8_39(PIN_OUTPUT_PULLDOWN | INPUT_EN | MUX_MODE5))
	BONE_PIN(P8_39, pruin, P8_39(PIN_INPUT | MUX_MODE6))

	/* P8_40 (ZCZ ball T4) lcd_data7 (hdmi) */
	BONE_PIN(P8_40, default, P8_40(PIN_OUTPUT_PULLDOWN | INPUT_EN | MUX_MODE7))
	BONE_PIN(P8_40, gpio, P8_40(PIN_OUTPUT | INPUT_EN | MUX_MODE7))
	BONE_PIN(P8_40, gpio_pu, P8_40(PIN_OUTPUT_PULLUP | INPUT_EN | MUX_MODE7))
	BONE_PIN(P8_40, gpio_pd, P8_40(PIN_OUTPUT_PULLDOWN | INPUT_EN | MUX_MODE7))
	BONE_PIN(P8_40, eqep, P8_40(PIN_OUTPUT_PULLUP | INPUT_EN | MUX_MODE3))
	BONE_PIN(P8_40, pruout, P8_40(PIN_OUTPUT_PULLDOWN | INPUT_EN | MUX_MODE5))
	BONE_PIN(P8_40, pruin, P8_40(PIN_INPUT | MUX_MODE6))

	/* P8_41 (ZCZ ball T1) lcd_data4 (hdmi) */
	BONE_PIN(P8_41, default, P8_41(PIN_OUTPUT_PULLDOWN | INPUT_EN | MUX_MODE7))
	BONE_PIN(P8_41, gpio, P8_41(PIN_OUTPUT | INPUT_EN | MUX_MODE7))
	BONE_PIN(P8_41, gpio_pu, P8_41(PIN_OUTPUT_PULLUP | INPUT_EN | MUX_MODE7))
	BONE_PIN(P8_41, gpio_pd, P8_41(PIN_OUTPUT_PULLDOWN | INPUT_EN | MUX_MODE7))
	BONE_PIN(P8_41, eqep, P8_41(PIN_OUTPUT_PULLUP | INPUT_EN | MUX_MODE3))
	BONE_PIN(P8_41, pruout, P8_41(PIN_OUTPUT_PULLDOWN | INPUT_EN | MUX_MODE5))
	BONE_PIN(P8_41, pruin, P8_41(PIN_INPUT | MUX_MODE6))

	/* P8_42 (ZCZ ball T2) lcd_data5 (hdmi) */
	BONE_PIN(P8_42, default, P8_42(PIN_OUTPUT_PULLDOWN | INPUT_EN | MUX_MODE7))
	BONE_PIN(P8_42, gpio, P8_42(PIN_OUTPUT | INPUT_EN | MUX_MODE7))
	BONE_PIN(P8_42, gpio_pu, P8_42(PIN_OUTPUT_PULLUP | INPUT_EN | MUX_MODE7))
	BONE_PIN(P8_42, gpio_pd, P8_42(PIN_OUTPUT_PULLDOWN | INPUT_EN | MUX_MODE7))
	BONE_PIN(P8_42, eqep, P8_42(PIN_OUTPUT_PULLUP | INPUT_EN | MUX_MODE3))
	BONE_PIN(P8_42, pruout, P8_42(PIN_OUTPUT_PULLDOWN | INPUT_EN | MUX_MODE5))
	BONE_PIN(P8_42, pruin, P8_42(PIN_INPUT | MUX_MODE6))

	/* P8_43 (ZCZ ball R3) lcd_data2 (hdmi) */
	BONE_PIN(P8_43, default, P8_43(PIN_OUTPUT_PULLDOWN | INPUT_EN | MUX_MODE7))
	BONE_PIN(P8_43, gpio, P8_43(PIN_OUTPUT | INPUT_EN | MUX_MODE7))
	BONE_PIN(P8_43, gpio_pu, P8_43(PIN_OUTPUT_PULLUP | INPUT_EN | MUX_MODE7))
	BONE_PIN(P8_43, gpio_pd, P8_43(PIN_OUTPUT_PULLDOWN | INPUT_EN | MUX_MODE7))
	BONE_PIN(P8_43, pwm, P8_43(PIN_OUTPUT_PULLDOWN | INPUT_EN | MUX_MODE3))
	BONE_PIN(P8_43, pruout, P8_43(PIN_OUTPUT_PULLDOWN | INPUT_EN | MUX_MODE5))
	BONE_PIN(P8_43, pruin, P8_43(PIN_INPUT | MUX_MODE6))

	/* P8_44 (ZCZ ball R4) lcd_data3 (hdmi) */
	BONE_PIN(P8_44, default, P8_44(PIN_OUTPUT_PULLDOWN | INPUT_EN | MUX_MODE7))
	BONE_PIN(P8_44, gpio, P8_44(PIN_OUTPUT | INPUT_EN | MUX_MODE7))
	BONE_PIN(P8_44, gpio_pu, P8_44(PIN_OUTPUT_PULLUP | INPUT_EN | MUX_MODE7))
	BONE_PIN(P8_44, gpio_pd, P8_44(PIN_OUTPUT_PULLDOWN | INPUT_EN | MUX_MODE7))
	BONE_PIN(P8_44, pwm, P8_44(PIN_OUTPUT_PULLDOWN | INPUT_EN | MUX_MODE3))
	BONE_PIN(P8_44, pruout, P8_44(PIN_OUTPUT_PULLDOWN | INPUT_EN | MUX_MODE5))
	BONE_PIN(P8_44, pruin, P8_44(PIN_INPUT | MUX_MODE6))

	/* P8_45 (ZCZ ball R1) lcd_data0 (hdmi) */
	BONE_PIN(P8_45, default, P8_45(PIN_OUTPUT_PULLDOWN | INPUT_EN | MUX_MODE7))
	BONE_PIN(P8_45, gpio, P8_45(PIN_OUTPUT | INPUT_EN | MUX_MODE7))
	BONE_PIN(P8_45, gpio_pu, P8_45(PIN_OUTPUT_PULLUP | INPUT_EN | MUX_MODE7))
	BONE_PIN(P8_45, gpio_pd, P8_45(PIN_OUTPUT_PULLDOWN | INPUT_EN | MUX_MODE7))
	BONE_PIN(P8_45, pwm, P8_45(PIN_OUTPUT_PULLDOWN | INPUT_EN | MUX_MODE3))
	BONE_PIN(P8_45, pruout, P8_45(PIN_OUTPUT_PULLDOWN | INPUT_EN | MUX_MODE5))
	BONE_PIN(P8_45, pruin, P8_45(PIN_INPUT | MUX_MODE6))

	/* P8_46 (ZCZ ball R2) lcd_data1 (hdmi) */
	BONE_PIN(P8_46, default, P8_46(PIN_OUTPUT_PULLDOWN | INPUT_EN | MUX_MODE7))
	BONE_PIN(P8_46, gpio, P8_46(PIN_OUTPUT | INPUT_EN | MUX_MODE7))
	BONE_PIN(P8_46, gpio_pu, P8_46(PIN_OUTPUT_PULLUP | INPUT_EN | MUX_MODE7))
	BONE_PIN(P8_46, gpio_pd, P8_46(PIN_OUTPUT_PULLDOWN | INPUT_EN | MUX_MODE7))
	BONE_PIN(P8_46, pwm, P8_46(PIN_OUTPUT_PULLDOWN | INPUT_EN | MUX_MODE3))
	BONE_PIN(P8_46, pruout, P8_46(PIN_OUTPUT_PULLDOWN | INPUT_EN | MUX_MODE5))
	BONE_PIN(P8_46, pruin, P8_46(PIN_INPUT | MUX_MODE6))

	/************************/
	/* P9 Header */
	/************************/

	/* P9_01                GND */

	/* P9_02                GND */

	/* P9_03                3V3 */

	/* P9_04                3V3 */

	/* P9_05                VDD_5V */

	/* P9_06                VDD_5V */

	/* P9_07                SYS_5V */

	/* P9_08                SYS_5V */

	/* P9_09                PWR_BUT */

	/* P9_10                RSTn */

	/* P9_11 (ZCZ ball T17) gpmc_wait0 (gpio0_30) */
	BONE_PIN(P9_11, default, P9_11(PIN_OUTPUT_PULLUP | INPUT_EN | MUX_MODE7))
	BONE_PIN(P9_11, gpio, P9_11(PIN_OUTPUT | INPUT_EN | MUX_MODE7))
	BONE_PIN(P9_11, gpio_pu, P9_11(PIN_OUTPUT_PULLUP | INPUT_EN | MUX_MODE7))
	BONE_PIN(P9_11, gpio_pd, P9_11(PIN_OUTPUT_PULLDOWN | INPUT_EN | MUX_MODE7))
	BONE_PIN(P9_11, uart, P9_11(PIN_OUTPUT_PULLUP | INPUT_EN | MUX_MODE6))

	/* P9_12 (ZCZ ball U18) gpmc_be1n (gpio1_28) */
	BONE_PIN(P9_12, default, P9_12(PIN_OUTPUT_PULLUP | INPUT_EN | MUX_MODE7))
	BONE_PIN(P9_12, gpio, P9_12(PIN_OUTPUT | INPUT_EN | MUX_MODE7))
	BONE_PIN(P9_12, gpio_pu, P9_12(PIN_OUTPUT_PULLUP | INPUT_EN | MUX_MODE7))
	BONE_PIN(P9_12, gpio_pd, P9_12(PIN_OUTPUT_PULLDOWN | INPUT_EN | MUX_MODE7))

	/* P9_13 (ZCZ ball U17) gpmc_wpn (gpio0_31) */
	BONE_PIN(P9_13, default, P9_13(PIN_OUTPUT_PULLUP | INPUT_EN | MUX_MODE7))
	BONE_PIN(P9_13, gpio, P9_13(PIN_OUTPUT | INPUT_EN | MUX_MODE7))
	BONE_PIN(P9_13, gpio_pu, P9_13(PIN_OUTPUT_PULLUP | INPUT_EN | MUX_MODE7))
	BONE_PIN(P9_13, gpio_pd, P9_13(PIN_OUTPUT_PULLDOWN | INPUT_EN | MUX_MODE7))
	BONE_PIN(P9_13, uart, P9_13(PIN_OUTPUT_PULLUP | INPUT_EN | MUX_MODE6))

	/* P9_14 (ZCZ ball U14) gpmc_a2 (gpio1_18) */
	BONE_PIN(P9_14, default, P9_14(PIN_OUTPUT_PULLDOWN | INPUT_EN | MUX_MODE7))
	BONE_PIN(P9_14, gpio, P9_14(PIN_OUTPUT | INPUT_EN | MUX_MODE7))
	BONE_PIN(P9_14, gpio_pu, P9_14(PIN_OUTPUT_PULLUP | INPUT_EN | MUX_MODE7))
	BONE_PIN(P9_14, gpio_pd, P9_14(PIN_OUTPUT_PULLDOWN | INPUT_EN | MUX_MODE7))
	BONE_PIN(P9_14, pwm, P9_14(PIN_OUTPUT_PULLDOWN | INPUT_EN | MUX_MODE6))

	/* P9_15 (ZCZ ball R13) gpmc_a0 (gpio1_16) */
	BONE_PIN(P9_15, default, P9_15(PIN_OUTPUT_PULLDOWN | INPUT_EN | MUX_MODE7))
	BONE_PIN(P9_15, gpio, P9_15(PIN_OUTPUT | INPUT_EN | MUX_MODE7))
	BONE_PIN(P9_15, gpio_pu, P9_15(PIN_OUTPUT_PULLUP | INPUT_EN | MUX_MODE7))
	BONE_PIN(P9_15, gpio_pd, P9_15(PIN_OUTPUT_PULLDOWN | INPUT_EN | MUX_MODE7))
	BONE_PIN(P9_15, pwm, P9_15(PIN_OUTPUT_PULLDOWN | INPUT_EN | MUX_MODE6))

	/* P9_16 (ZCZ ball T14) gpmc_a3 (gpio1_19) */
	BONE_PIN(P9_16, default, P9_16(PIN_OUTPUT_PULLDOWN | INPUT_EN | MUX_MODE7))
	BONE_PIN(P9_16, gpio, P9_16(PIN_OUTPUT | INPUT_EN | MUX_MODE7))
	BONE_PIN(P9_16, gpio_pu, P9_16(PIN_OUTPUT_PULLUP | INPUT_EN | MUX_MODE7))
	BONE_PIN(P9_16, gpio_pd, P9_16(PIN_OUTPUT_PULLDOWN | INPUT_EN | MUX_MODE7))
	BONE_PIN(P9_16, pwm, P9_16(PIN_OUTPUT_PULLDOWN | INPUT_EN | MUX_MODE6))

	/* P9_17 (ZCZ ball A16) spi0_cs0 (gpio0_5) */
	BONE_PIN(P9_17, default, P9_17(PIN_OUTPUT_PULLUP | INPUT_EN | MUX_MODE7))
	BONE_PIN(P9_17, gpio, P9_17(PIN_OUTPUT | INPUT_EN | MUX_MODE7))
	BONE_PIN(P9_17, gpio_pu, P9_17(PIN_OUTPUT_PULLUP | INPUT_EN | MUX_MODE7))
	BONE_PIN(P9_17, gpio_pd, P9_17(PIN_OUTPUT_PULLDOWN | INPUT_EN | MUX_MODE7))
	BONE_PIN(P9_17, spi_cs, P9_17(PIN_OUTPUT_PULLUP | INPUT_EN | MUX_MODE0))
	BONE_PIN(P9_17, i2c, P9_17(PIN_OUTPUT_PULLUP | INPUT_EN | MUX_MODE2))
	BONE_PIN(P9_17, pwm, P9_17(PIN_OUTPUT_PULLDOWN | INPUT_EN | MUX_MODE3))
	BONE_PIN(P9_17, pru_uart, P9_17(PIN_OUTPUT_PULLUP | INPUT_EN | MUX_MODE4))

	/* P9_18 (ZCZ ball B16) spi0_d1 (gpio0_4) */
	BONE_PIN(P9_18, default, P9_18(PIN_OUTPUT_PULLUP | INPUT_EN | MUX_MODE7))
	BONE_PIN(P9_18, gpio, P9_18(PIN_OUTPUT | INPUT_EN | MUX_MODE7))
	BONE_PIN(P9_18, gpio_pu, P9_18(PIN_OUTPUT_PULLUP | INPUT_EN | MUX_MODE7))
	BONE_PIN(P9_18, gpio_pd, P9_18(PIN_OUTPUT_PULLDOWN | INPUT_EN | MUX_MODE7))
	BONE_PIN(P9_18, spi, P9_18(PIN_OUTPUT_PULLUP | INPUT_EN | MUX_MODE0))
	BONE_PIN(P9_18, i2c, P9_18(PIN_OUTPUT_PULLUP | INPUT_EN | MUX_MODE2))
	BONE_PIN(P9_18, pwm, P9_18(PIN_OUTPUT_PULLDOWN | INPUT_EN | MUX_MODE3))
	BONE_PIN(P9_18, pru_uart, P9_18(PIN_OUTPUT_PULLUP | INPUT_EN | MUX_MODE4))

	/* P9_19 (ZCZ ball D17) uart1_rtsn (i2c2_scl) */
	BONE_PIN(P9_19, default, P9_19(PIN_OUTPUT_PULLUP | INPUT_EN | MUX_MODE3))
	BONE_PIN(P9_19, gpio, P9_19(PIN_OUTPUT | INPUT_EN | MUX_MODE7))
	BONE_PIN(P9_19, gpio_pu, P9_19(PIN_OUTPUT_PULLUP | INPUT_EN | MUX_MODE7))
	BONE_PIN(P9_19, gpio_pd, P9_19(PIN_OUTPUT_PULLDOWN | INPUT_EN | MUX_MODE7))
	BONE_PIN(P9_19, timer, P9_19(PIN_OUTPUT_PULLUP | INPUT_EN | MUX_MODE1))
	BONE_PIN(P9_19, can, P9_19(PIN_INPUT_PULLUP | MUX_MODE2))
	BONE_PIN(P9_19, i2c, P9_19(PIN_OUTPUT_PULLUP | INPUT_EN | MUX_MODE3))
	BONE_PIN(P9_19, spi_cs, P9_19(PIN_OUTPUT_PULLUP | INPUT_EN | MUX_MODE4))
	BONE_PIN(P9_19, pru_uart, P9_19(PIN_OUTPUT_PULLUP | INPUT_EN | MUX_MODE5))

	/* P9_20 (ZCZ ball D18) uart1_ctsn (i2c2_sda) */
	BONE_PIN(P9_20, default, P9_20(PIN_OUTPUT_PULLUP | INPUT_EN | MUX_MODE3))
	BONE_PIN(P9_20, gpio, P9_20(PIN_OUTPUT | INPUT_EN | MUX_MODE7))
	BONE_PIN(P9_20, gpio_pu, P9_20(PIN_OUTPUT_PULLUP | INPUT_EN | MUX_MODE7))
	BONE_PIN(P9_20, gpio_pd, P9_20(PIN_OUTPUT_PULLDOWN | INPUT_EN | MUX_MODE7))
	BONE_PIN(P9_20, timer, P9_20(PIN_OUTPUT_PULLUP | INPUT_EN | MUX_MODE1))
	BONE_PIN(P9_20, can, P9_20(PIN_OUTPUT_PULLUP | MUX_MODE2))
	BONE_PIN(P9_20, i2c, P9_20(PIN_OUTPUT_PULLUP | INPUT_EN | MUX_MODE3))
	BONE_PIN(P9_20, spi_cs, P9_20(PIN_OUTPUT_PULLUP | INPUT_EN | MUX_MODE4))
	BONE_PIN(P9_20, pru_uart, P9_20(PIN_OUTPUT_PULLUP | INPUT_EN | MUX_MODE5))

	/* P9_21 (ZCZ ball B17) spi0_d0 (gpio0_3) */
	BONE_PIN(P9_21, default, P9_21(PIN_OUTPUT_PULLUP | INPUT_EN | MUX_MODE7))
	BONE_PIN(P9_21, gpio, P9_21(PIN_OUTPUT | INPUT_EN | MUX_MODE7))
	BONE_PIN(P9_21, gpio_pu, P9_21(PIN_OUTPUT_PULLUP | INPUT_EN | MUX_MODE7))
	BONE_PIN(P9_21, gpio_pd, P9_21(PIN_OUTPUT_PULLDOWN | INPUT_EN | MUX_MODE7))
	BONE_PIN(P9_21, spi, P9_21(PIN_INPUT_PULLUP | MUX_MODE0))
	BONE_PIN(P9_21, uart, P9_21(PIN_OUTPUT_PULLUP | INPUT_EN | MUX_MODE1))
	BONE_PIN(P9_21, i2c, P9_21(PIN_OUTPUT_PULLUP | INPUT_EN | MUX_MODE2))
	BONE_PIN(P9_21, pwm, P9_21(PIN_OUTPUT_PULLDOWN | INPUT_EN | MUX_MODE3))
	BONE_PIN(P9_21, pru_uart, P9_21(PIN_OUTPUT_PULLUP | INPUT_EN | MUX_MODE4))

	/* P9_22 (ZCZ ball A17) spi0_sclk (gpio0_2) */
	BONE_PIN(P9_22, default, P9_22(PIN_OUTPUT_PULLUP | INPUT_EN | MUX_MODE7))
	BONE_PIN(P9_22, gpio, P9_22(PIN_OUTPUT | INPUT_EN | MUX_MODE7))
	BONE_PIN(P9_22, gpio_pu, P9_22(PIN_OUTPUT_PULLUP | INPUT_EN | MUX_MODE7))
	BONE_PIN(P9_22, gpio_pd, P9_22(PIN_OUTPUT_PULLDOWN | INPUT_EN | MUX_MODE7))
	BONE_PIN(P9_22, spi_sclk, P9_22(PIN_INPUT_PULLUP | MUX_MODE0))
	BONE_PIN(P9_22, uart, P9_22(PIN_OUTPUT_PULLUP | INPUT_EN | MUX_MODE1))
	BONE_PIN(P9_22, i2c, P9_22(PIN_OUTPUT_PULLUP | INPUT_EN | MUX_MODE2))
	BONE_PIN(P9_22, pwm, P9_22(PIN_OUTPUT_PULLDOWN | INPUT_EN | MUX_MODE3))
	BONE_PIN(P9_22, pru_uart, P9_22(PIN_OUTPUT_PULLUP | INPUT_EN | MUX_MODE4))

	/* P9_23 (ZCZ ball V14) gpmc_a1 (gpio1_17) */
	BONE_PIN(P9_23, default, P9_23(PIN_OUTPUT_PULLDOWN | INPUT_EN | MUX_MODE7))
	BONE_PIN(P9_23, gpio, P9_23(PIN_OUTPUT | INPUT_EN | MUX_MODE7))
	BONE_PIN(P9_23, gpio_pu, P9_23(PIN_OUTPUT_PULLUP | INPUT_EN | MUX_MODE7))
	BONE_PIN(P9_23, gpio_pd, P9_23(PIN_OUTPUT_PULLDOWN | INPUT_EN | MUX_MODE7))
	BONE_PIN(P9_23, pwm, P9_23(PIN_OUTPUT_PULLDOWN | INPUT_EN | MUX_MODE6))

	/* P9_24 (ZCZ ball D15) uart1_txd (gpio0_15) */
	BONE_PIN(P9_24, default, P9_24(PIN_OUTPUT_PULLUP | INPUT_EN | MUX_MODE7))
	BONE_PIN(P9_24, gpio, P9_24(PIN_OUTPUT | INPUT_EN | MUX_MODE7))
	BONE_PIN(P9_24, gpio_pu, P9_24(PIN_OUTPUT_PULLUP | INPUT_EN | MUX_MODE7))
	BONE_PIN(P9_24, gpio_pd, P9_24(PIN_OUTPUT_PULLDOWN | INPUT_EN | MUX_MODE7))
	BONE_PIN(P9_24, uart, P9_24(PIN_OUTPUT_PULLUP | INPUT_EN | MUX_MODE0))
	BONE_PIN(P9_24, can, P9_24(PIN_INPUT_PULLUP | MUX_MODE2))
	BONE_PIN(P9_24, i2c, P9_24(PIN_OUTPUT_PULLUP | INPUT_EN | MUX_MODE3))
	BONE_PIN(P9_24, pru_uart, P9_24(PIN_OUTPUT_PULLUP | INPUT_EN | MUX_MODE5))
	BONE_PIN(P9_24, pruin, P9_24(PIN_INPUT | MUX_MODE6))

	/* P9_25 (ZCZ ball A14) mcasp0_ahclkx (audio) */
	BONE_PIN(P9_25, default, P9_25(PIN_OUTPUT_PULLDOWN | INPUT_EN | MUX_MODE7))
	BONE_PIN(P9_25, gpio, P9_25(PIN_OUTPUT | INPUT_EN | MUX_MODE7))
	BONE_PIN(P9_25, gpio_pu, P9_25(PIN_OUTPUT_PULLUP | INPUT_EN | MUX_MODE7))
	BONE_PIN(P9_25, gpio_pd, P9_25(PIN_OUTPUT_PULLDOWN | INPUT_EN | MUX_MODE7))
	BONE_PIN(P9_25, eqep, P9_25(PIN_OUTPUT_PULLUP | INPUT_EN | MUX_MODE1))
	BONE_PIN(P9_25, pruout, P9_25(PIN_OUTPUT_PULLDOWN | INPUT_EN | MUX_MODE5))
	BONE_PIN(P9_25, pruin, P9_25(PIN_INPUT | MUX_MODE6))

	/* P9_26 (ZCZ ball D16) uart1_rxd (gpio0_14) */
	BONE_PIN(P9_26, default, P9_26(PIN_OUTPUT_PULLUP | INPUT_EN | MUX_MODE7))
	BONE_PIN(P9_26, gpio, P9_26(PIN_OUTPUT | INPUT_EN | MUX_MODE7))
	BONE_PIN(P9_26, gpio_pu, P9_26(PIN_OUTPUT_PULLUP | INPUT_EN | MUX_MODE7))
	BONE_PIN(P9_26, gpio_pd, P9_26(PIN_OUTPUT_PULLDOWN | INPUT_EN | MUX_MODE7))
	BONE_PIN(P9_26, uart, P9_26(PIN_OUTPUT_PULLUP | INPUT_EN | MUX_MODE0))
	BONE_PIN(P9_26, can, P9_26(PIN_OUTPUT_PULLUP | MUX_MODE2))
	BONE_PIN(P9_26, i2c, P9_26(PIN_OUTPUT_PULLUP | INPUT_EN | MUX_MODE3))
	BONE_PIN(P9_26, pru_uart, P9_26(PIN_OUTPUT_PULLUP | INPUT_EN | MUX_MODE5))
	BONE_PIN(P9_26, pruin, P9_26(PIN_INPUT | MUX_MODE6))

	/* P9_27 (ZCZ ball C13) mcasp0_fsr (gpio3_19) */
	BONE_PIN(P9_27, default, P9_27(PIN_OUTPUT_PULLDOWN | INPUT_EN | MUX_MODE7))
	BONE_PIN(P9_27, gpio, P9_27(PIN_OUTPUT | INPUT_EN | MUX_MODE7))
	BONE_PIN(P9_27, gpio_pu, P9_27(PIN_OUTPUT_PULLUP | INPUT_EN | MUX_MODE7))
	BONE_PIN(P9_27, gpio_pd, P9_27(PIN_OUTPUT_PULLDOWN | INPUT_EN | MUX_MODE7))
	BONE_PIN(P9_27, eqep, P9_27(PIN_OUTPUT_PULLUP | INPUT_EN | MUX_MODE1))
	BONE_PIN(P9_27, pruout, P9_27(PIN_OUTPUT_PULLDOWN | INPUT_EN | MUX_MODE5))
	BONE_PIN(P9_27, pruin, P9_27(PIN_INPUT | MUX_MODE6))

	/* P9_28 (ZCZ ball C12) mcasp0_ahclkr (audio) */
	BONE_PIN(P9_28, default, P9_28(PIN_OUTPUT_PULLDOWN | INPUT_EN | MUX_MODE7))
	BONE_PIN(P9_28, gpio, P9_28(PIN_OUTPUT | INPUT_EN | MUX_MODE7))
	BONE_PIN(P9_28, gpio_pu, P9_28(PIN_OUTPUT_PULLUP | INPUT_EN | MUX_MODE7))
	BONE_PIN(P9_28, gpio_pd, P9_28(PIN_OUTPUT_PULLDOWN | INPUT_EN | MUX_MODE7))
	BONE_PIN(P9_28, pwm, P9_28(PIN_OUTPUT_PULLDOWN | INPUT_EN | MUX_MODE1))
	BONE_PIN(P9_28, spi_cs, P9_28(PIN_OUTPUT_PULLUP | INPUT_EN | MUX_MODE3))
	BONE_PIN(P9_28, pwm2, P9_28(PIN_OUTPUT_PULLDOWN | INPUT_EN | MUX_MODE4))
	BONE_PIN(P9_28, pruout, P9_28(PIN_OUTPUT_PULLDOWN | INPUT_EN | MUX_MODE5))
	BONE_PIN(P9_28, pruin, P9_28(PIN_INPUT | MUX_MODE6))

	/* P9_29 (ZCZ ball B13) mcasp0_fsx (audio) */
	BONE_PIN(P9_29, default, P9_29(PIN_OUTPUT_PULLDOWN | INPUT_EN | MUX_MODE7))
	BONE_PIN(P9_29, gpio, P9_29(PIN_OUTPUT | INPUT_EN | MUX_MODE7))
	BONE_PIN(P9_29, gpio_pu, P9_29(PIN_OUTPUT_PULLUP | INPUT_EN | MUX_MODE7))
	BONE_PIN(P9_29, gpio_pd, P9_29(PIN_OUTPUT_PULLDOWN | INPUT_EN | MUX_MODE7))
	BONE_PIN(P9_29, pwm, P9_29(PIN_OUTPUT_PULLDOWN | INPUT_EN | MUX_MODE1))
	BONE_PIN(P9_29, spi, P9_29(PIN_INPUT_PULLUP | MUX_MODE3))
	BONE_PIN(P9_29, pruout, P9_29(PIN_OUTPUT_PULLDOWN | INPUT_EN | MUX_MODE5))
	BONE_PIN(P9_29, pruin, P9_29(PIN_INPUT | MUX_MODE6))

	/* P9_30 (ZCZ ball D12) gpio-hog wl1835 */

	/* P9_31 (ZCZ ball A13) mcasp0_aclkx (audio) */
	BONE_PIN(P9_31, default, P9_31(PIN_OUTPUT_PULLDOWN | INPUT_EN | MUX_MODE7))
	BONE_PIN(P9_31, gpio, P9_31(PIN_OUTPUT | INPUT_EN | MUX_MODE7))
	BONE_PIN(P9_31, gpio_pu, P9_31(PIN_OUTPUT_PULLUP | INPUT_EN | MUX_MODE7))
	BONE_PIN(P9_31, gpio_pd, P9_31(PIN_OUTPUT_PULLDOWN | INPUT_EN | MUX_MODE7))
	BONE_PIN(P9_31, pwm, P9_31(PIN_OUTPUT_PULLDOWN | INPUT_EN | MUX_MODE1))
	BONE_PIN(P9_31, spi_sclk, P9_31(PIN_INPUT_PULLUP | MUX_MODE3))
	BONE_PIN(P9_31, pruout, P9_31(PIN_OUTPUT_PULLDOWN | INPUT_EN | MUX_MODE5))
	BONE_PIN(P9_31, pruin, P9_31(PIN_INPUT | MUX_MODE6))

	/* P9_32                VADC */

	/* P9_33 (ZCZ ball C8)  AIN4 */

	/* P9_34                AGND */

	/* P9_35 (ZCZ ball A8)  AIN6 */

	/* P9_36 (ZCZ ball B8)  AIN5 */

	/* P9_37 (ZCZ ball B7)  AIN2 */

	/* P9_38 (ZCZ ball A7)  AIN3 */

	/* P9_39 (ZCZ ball B6)  AIN0 */

	/* P9_40 (ZCZ ball C7)  AIN1 */

	/* P9_41 (ZCZ ball D14) xdma_event_intr1 (gpio0_20) */
	BONE_PIN(P9_41, default, P9_41(PIN_OUTPUT_PULLDOWN | INPUT_EN | MUX_MODE7))
	BONE_PIN(P9_41, gpio, P9_41(PIN_OUTPUT | INPUT_EN | MUX_MODE7))
	BONE_PIN(P9_41, gpio_pu, P9_41(PIN_OUTPUT_PULLUP | INPUT_EN | MUX_MODE7))
	BONE_PIN(P9_41, gpio_pd, P9_41(PIN_OUTPUT_PULLDOWN | INPUT_EN | MUX_MODE7))
	BONE_PIN(P9_41, timer, P9_41(PIN_OUTPUT_PULLUP | INPUT_EN | MUX_MODE4))
	BONE_PIN(P9_41, pruin, P9_41(PIN_INPUT | MUX_MODE5))

	/* P9_41.1 */
	/* P9_91 (ZCZ ball D13) mcasp0_axr1 (gpio3_20) */
	BONE_PIN(P9_91, default, P9_91(PIN_OUTPUT_PULLDOWN | INPUT_EN | MUX_MODE7))
	BONE_PIN(P9_91, gpio, P9_91(PIN_OUTPUT | INPUT_EN | MUX_MODE7))
	BONE_PIN(P9_91, gpio_pu, P9_91(PIN_OUTPUT_PULLUP | INPUT_EN | MUX_MODE7))
	BONE_PIN(P9_91, gpio_pd, P9_91(PIN_OUTPUT_PULLDOWN | INPUT_EN | MUX_MODE7))
	BONE_PIN(P9_91, eqep, P9_91(PIN_OUTPUT_PULLUP | INPUT_EN | MUX_MODE1))
	BONE_PIN(P9_91, pruout, P9_91(PIN_OUTPUT_PULLDOWN | INPUT_EN | MUX_MODE5))
	BONE_PIN(P9_91, pruin, P9_91(PIN_INPUT | MUX_MODE6))

	/* P9_42 (ZCZ ball C18) eCAP0_in_PWM0_out (gpio0_7) */
	BONE_PIN(P9_42, default, P9_42(PIN_OUTPUT_PULLDOWN | INPUT_EN | MUX_MODE7))
	BONE_PIN(P9_42, gpio, P9_42(PIN_OUTPUT | INPUT_EN | MUX_MODE7))
	BONE_PIN(P9_42, gpio_pu, P9_42(PIN_OUTPUT_PULLUP | INPUT_EN | MUX_MODE7))
	BONE_PIN(P9_42, gpio_pd, P9_42(PIN_OUTPUT_PULLDOWN | INPUT_EN | MUX_MODE7))
	BONE_PIN(P9_42, pwm, P9_42(PIN_OUTPUT_PULLDOWN | INPUT_EN | MUX_MODE0))
	BONE_PIN(P9_42, uart, P9_42(PIN_OUTPUT_PULLUP | INPUT_EN | MUX_MODE1))
	BONE_PIN(P9_42, spi_cs, P9_42(PIN_OUTPUT_PULLUP | INPUT_EN | MUX_MODE2))
	BONE_PIN(P9_42, pru_ecap_pwm, P9_42(PIN_OUTPUT_PULLDOWN | INPUT_EN | MUX_MODE3))
	BONE_PIN(P9_42, spi_sclk, P9_42(PIN_INPUT_PULLUP | MUX_MODE4))

	/* P9_42.1 */
	/* P9_92 (ZCZ ball B12) mcasp0_aclkr (gpio3_18) */
	BONE_PIN(P9_92, default, P9_92(PIN_OUTPUT_PULLDOWN | INPUT_EN | MUX_MODE7))
	BONE_PIN(P9_92, gpio, P9_92(PIN_OUTPUT | INPUT_EN | MUX_MODE7))
	BONE_PIN(P9_92, gpio_pu, P9_92(PIN_OUTPUT_PULLUP | INPUT_EN | MUX_MODE7))
	BONE_PIN(P9_92, gpio_pd, P9_92(PIN_OUTPUT_PULLDOWN | INPUT_EN | MUX_MODE7))
	BONE_PIN(P9_92, eqep, P9_92(PIN_OUTPUT_PULLUP | INPUT_EN | MUX_MODE1))
	BONE_PIN(P9_92, pruout, P9_92(PIN_OUTPUT_PULLDOWN | INPUT_EN | MUX_MODE5))
	BONE_PIN(P9_92, pruin, P9_92(PIN_INPUT | MUX_MODE6))

	/* P9_43                GND */

	/* P9_44                GND */

	/* P9_45                GND */

	/* P9_46                GND */
};

&i2c1 {
	status = "okay";
	pinctrl-names = "default";
	pinctrl-0 = <>;

	clock-frequency = <100000>;
	symlink = "bone/i2c/1";
};

&i2c2 {
	status = "okay";
	pinctrl-names = "default";
	pinctrl-0 = <>;

	clock-frequency = <100000>;
	symlink = "bone/i2c/2";
};

&uart1 {
	status = "okay";
	pinctrl-names = "default";
	pinctrl-0 = <>;
	symlink = "bone/uart/1";
};

&uart2 {
	status = "okay";
	pinctrl-names = "default";
	pinctrl-0 = <>;
	symlink = "bone/uart/2";
};

&uart3 {
	status = "okay";
	pinctrl-names = "default";
	pinctrl-0 = <>;
	symlink = "bone/uart/3";
};

&uart4 {
	status = "okay";
	pinctrl-names = "default";
	pinctrl-0 = <>;
	symlink = "bone/uart/4";
};

&uart5 {
	status = "okay";
	pinctrl-names = "default";
	pinctrl-0 = <>;
	symlink = "bone/uart/5";
};

&dcan0 {
	status = "okay";
	pinctrl-names = "default";
	pinctrl-0 = <>;
	symlink = "bone/can/0";
};

&dcan1 {
	status = "okay";
	pinctrl-names = "default";
	pinctrl-0 = <>;
	symlink = "bone/can/1";
};

&eqep0 {
	status = "okay";
	pinctrl-names = "default";
	pinctrl-0 = <>;
	symlink = "bone/eqep/0";
};

&eqep1 {
	status = "okay";
	pinctrl-names = "default";
	pinctrl-0 = <>;
	symlink = "bone/eqep/1";
};

&eqep2 {
	status = "okay";
	pinctrl-names = "default";
	pinctrl-0 = <>;
	symlink = "bone/eqep/2";
};

&epwmss0 {
	status = "okay";
};

&epwmss1 {
	status = "okay";
};

&epwmss2 {
	status = "okay";
};

&ehrpwm0 {
	status = "okay";
	pinctrl-names = "default";
	pinctrl-0 = <>;
};

&ehrpwm1 {
	status = "okay";
	pinctrl-names = "default";
	pinctrl-0 = <>;
};

&ehrpwm2 {
	status = "okay";
	pinctrl-names = "default";
	pinctrl-0 = <>;
};

&ecap0 {
	status = "okay";
	pinctrl-names = "default";
	pinctrl-0 = <>;
};

&ecap1 {
	status = "okay";
	pinctrl-names = "default";
	pinctrl-0 = <>;
};

&ecap2 {
	status = "okay";
	pinctrl-names = "default";
	pinctrl-0 = <>;
};

&spi0 {
	status = "okay";
	pinctrl-names = "default";
	pinctrl-0 = <>;

	channel@0 {
		#address-cells = <1>;
		#size-cells = <0>;

		compatible = "spidev";
		symlink = "bone/spi/0.0";

		reg = <0>;
		spi-max-frequency = <16000000>;
		spi-cpha;
	};

	channel@1 {
		#address-cells = <1>;
		#size-cells = <0>;

		compatible = "spidev";
		symlink = "bone/spi/0.1";

		reg = <1>;
		spi-max-frequency = <16000000>;
	};
};

&spi1 {
	status = "okay";
	pinctrl-names = "default";
	pinctrl-0 = <>;

	channel@0 {
		#address-cells = <1>;
		#size-cells = <0>;

		compatible = "spidev";
		symlink = "bone/spi/1.0";

		reg = <0>;
		spi-max-frequency = <16000000>;
		spi-cpha;
	};

	channel@1 {
		#address-cells = <1>;
		#size-cells = <0>;

		compatible = "spidev";
		symlink = "bone/spi/1.1";

		reg = <1>;
		spi-max-frequency = <16000000>;
	};
};

/**********************************************************************/
/* Pin Multiplex Helpers                                              */
/*                                                                    */
/* These provide userspace runtime pin configuration for the          */
/* BeagleBone cape expansion headers                                  */
/**********************************************************************/

&ocp {
	/************************/
	/* P8 Header */
	/************************/

	/* P8_01                GND */

	/* P8_02                GND */


	/* P8_03 (ZCZ ball R9) emmc */
	P8_03_pinmux {
		compatible = "bone-pinmux-helper";
		status = "okay";
		pinctrl-names = "default", "gpio", "gpio_pu", "gpio_pd";
		pinctrl-0 = <&P8_03_default_pin>;
		pinctrl-1 = <&P8_03_gpio_pin>;
		pinctrl-2 = <&P8_03_gpio_pu_pin>;
		pinctrl-3 = <&P8_03_gpio_pd_pin>;
	};

	/* P8_04 (ZCZ ball T9) emmc */
	P8_04_pinmux {
		compatible = "bone-pinmux-helper";
		status = "okay";
		pinctrl-names = "default", "gpio", "gpio_pu", "gpio_pd";
		pinctrl-0 = <&P8_04_default_pin>;
		pinctrl-1 = <&P8_04_gpio_pin>;
		pinctrl-2 = <&P8_04_gpio_pu_pin>;
		pinctrl-3 = <&P8_04_gpio_pd_pin>;
	};

	/* P8_05 (ZCZ ball R8) emmc */
	P8_05_pinmux {
		compatible = "bone-pinmux-helper";
		status = "okay";
		pinctrl-names = "default", "gpio", "gpio_pu", "gpio_pd";
		pinctrl-0 = <&P8_05_default_pin>;
		pinctrl-1 = <&P8_05_gpio_pin>;
		pinctrl-2 = <&P8_05_gpio_pu_pin>;
		pinctrl-3 = <&P8_05_gpio_pd_pin>;
	};

	/* P8_06 (ZCZ ball T8) emmc */
	P8_06_pinmux {
		compatible = "bone-pinmux-helper";
		status = "okay";
		pinctrl-names = "default", "gpio", "gpio_pu", "gpio_pd";
		pinctrl-0 = <&P8_06_default_pin>;
		pinctrl-1 = <&P8_06_gpio_pin>;
		pinctrl-2 = <&P8_06_gpio_pu_pin>;
		pinctrl-3 = <&P8_06_gpio_pd_pin>;
	};

	/* P8_07 (ZCZ ball R7) */
	P8_07_pinmux {
		compatible = "bone-pinmux-helper";
		status = "okay";
		pinctrl-names = "default", "gpio", "gpio_pu", "gpio_pd", "timer";
		pinctrl-0 = <&P8_07_default_pin>;
		pinctrl-1 = <&P8_07_gpio_pin>;
		pinctrl-2 = <&P8_07_gpio_pu_pin>;
		pinctrl-3 = <&P8_07_gpio_pd_pin>;
		pinctrl-4 = <&P8_07_timer_pin>;
	};

	/* P8_08 (ZCZ ball T7) */
	P8_08_pinmux {
		compatible = "bone-pinmux-helper";
		status = "okay";
		pinctrl-names = "default", "gpio", "gpio_pu", "gpio_pd", "timer";
		pinctrl-0 = <&P8_08_default_pin>;
		pinctrl-1 = <&P8_08_gpio_pin>;
		pinctrl-2 = <&P8_08_gpio_pu_pin>;
		pinctrl-3 = <&P8_08_gpio_pd_pin>;
		pinctrl-4 = <&P8_08_timer_pin>;
	};

	/* P8_09 (ZCZ ball T6) */
	P8_09_pinmux {
		compatible = "bone-pinmux-helper";
		status = "okay";
		pinctrl-names = "default", "gpio", "gpio_pu", "gpio_pd", "timer";
		pinctrl-0 = <&P8_09_default_pin>;
		pinctrl-1 = <&P8_09_gpio_pin>;
		pinctrl-2 = <&P8_09_gpio_pu_pin>;
		pinctrl-3 = <&P8_09_gpio_pd_pin>;
		pinctrl-4 = <&P8_09_timer_pin>;
	};

	/* P8_10 (ZCZ ball U6) */
	P8_10_pinmux {
		compatible = "bone-pinmux-helper";
		status = "okay";
		pinctrl-names = "default", "gpio", "gpio_pu", "gpio_pd", "timer";
		pinctrl-0 = <&P8_10_default_pin>;
		pinctrl-1 = <&P8_10_gpio_pin>;
		pinctrl-2 = <&P8_10_gpio_pu_pin>;
		pinctrl-3 = <&P8_10_gpio_pd_pin>;
		pinctrl-4 = <&P8_10_timer_pin>;
	};

	/* P8_11 (ZCZ ball R12) */
	P8_11_pinmux {
		compatible = "bone-pinmux-helper";
		status = "okay";
		pinctrl-names = "default", "gpio", "gpio_pu", "gpio_pd", "eqep", "pruout";
		pinctrl-0 = <&P8_11_default_pin>;
		pinctrl-1 = <&P8_11_gpio_pin>;
		pinctrl-2 = <&P8_11_gpio_pu_pin>;
		pinctrl-3 = <&P8_11_gpio_pd_pin>;
		pinctrl-4 = <&P8_11_eqep_pin>;
		pinctrl-5 = <&P8_11_pruout_pin>;
	};

	/* P8_12 (ZCZ ball T12) */
	P8_12_pinmux {
		compatible = "bone-pinmux-helper";
		status = "okay";
		pinctrl-names = "default", "gpio", "gpio_pu", "gpio_pd", "eqep", "pruout";
		pinctrl-0 = <&P8_12_default_pin>;
		pinctrl-1 = <&P8_12_gpio_pin>;
		pinctrl-2 = <&P8_12_gpio_pu_pin>;
		pinctrl-3 = <&P8_12_gpio_pd_pin>;
		pinctrl-4 = <&P8_12_eqep_pin>;
		pinctrl-5 = <&P8_12_pruout_pin>;
	};

	/* P8_13 (ZCZ ball T10) */
	P8_13_pinmux {
		compatible = "bone-pinmux-helper";
		status = "okay";
		pinctrl-names = "default", "gpio", "gpio_pu", "gpio_pd", "pwm";
		pinctrl-0 = <&P8_13_default_pin>;
		pinctrl-1 = <&P8_13_gpio_pin>;
		pinctrl-2 = <&P8_13_gpio_pu_pin>;
		pinctrl-3 = <&P8_13_gpio_pd_pin>;
		pinctrl-4 = <&P8_13_pwm_pin>;
	};

	/* P8_14 (ZCZ ball T11) wl1835: wl_en */

	/* P8_15 (ZCZ ball U13) */
	P8_15_pinmux {
		compatible = "bone-pinmux-helper";
		status = "okay";
		pinctrl-names = "default", "gpio", "gpio_pu", "gpio_pd", "eqep", "pru_ecap_pwm", "pruin";
		pinctrl-0 = <&P8_15_default_pin>;
		pinctrl-1 = <&P8_15_gpio_pin>;
		pinctrl-2 = <&P8_15_gpio_pu_pin>;
		pinctrl-3 = <&P8_15_gpio_pd_pin>;
		pinctrl-4 = <&P8_15_eqep_pin>;
		pinctrl-5 = <&P8_15_pru_ecap_pwm_pin>;
		pinctrl-6 = <&P8_15_pruin_pin>;
	};

	/* P8_16 (ZCZ ball V13) */
	P8_16_pinmux {
		compatible = "bone-pinmux-helper";
		status = "okay";
		pinctrl-names = "default", "gpio", "gpio_pu", "gpio_pd", "eqep", "pruin";
		pinctrl-0 = <&P8_16_default_pin>;
		pinctrl-1 = <&P8_16_gpio_pin>;
		pinctrl-2 = <&P8_16_gpio_pu_pin>;
		pinctrl-3 = <&P8_16_gpio_pd_pin>;
		pinctrl-4 = <&P8_16_eqep_pin>;
		pinctrl-5 = <&P8_16_pruin_pin>;
	};

	/* P8_17 (ZCZ ball U12) wl1835: wl_irq */

	/* P8_18 (ZCZ ball V12) */
	P8_18_pinmux {
		compatible = "bone-pinmux-helper";
		status = "okay";
		pinctrl-names = "default", "gpio", "gpio_pu", "gpio_pd";
		pinctrl-0 = <&P8_18_default_pin>;
		pinctrl-1 = <&P8_18_gpio_pin>;
		pinctrl-2 = <&P8_18_gpio_pu_pin>;
		pinctrl-3 = <&P8_18_gpio_pd_pin>;
	};

	/* P8_19 (ZCZ ball U10) */
	P8_19_pinmux {
		compatible = "bone-pinmux-helper";
		status = "okay";
		pinctrl-names = "default", "gpio", "gpio_pu", "gpio_pd", "pwm";
		pinctrl-0 = <&P8_19_default_pin>;
		pinctrl-1 = <&P8_19_gpio_pin>;
		pinctrl-2 = <&P8_19_gpio_pu_pin>;
		pinctrl-3 = <&P8_19_gpio_pd_pin>;
		pinctrl-4 = <&P8_19_pwm_pin>;
	};

	/* P8_20 (ZCZ ball V9) emmc */
	P8_20_pinmux {
		compatible = "bone-pinmux-helper";
		status = "okay";
		pinctrl-names = "default", "gpio", "gpio_pu", "gpio_pd", "pruout", "pruin";
		pinctrl-0 = <&P8_20_default_pin>;
		pinctrl-1 = <&P8_20_gpio_pin>;
		pinctrl-2 = <&P8_20_gpio_pu_pin>;
		pinctrl-3 = <&P8_20_gpio_pd_pin>;
		pinctrl-4 = <&P8_20_pruout_pin>;
		pinctrl-5 = <&P8_20_pruin_pin>;
	};

	/* P8_21 (ZCZ ball U9) emmc */
	P8_21_pinmux {
		compatible = "bone-pinmux-helper";
		status = "okay";
		pinctrl-names = "default", "gpio", "gpio_pu", "gpio_pd", "pruout", "pruin";
		pinctrl-0 = <&P8_21_default_pin>;
		pinctrl-1 = <&P8_21_gpio_pin>;
		pinctrl-2 = <&P8_21_gpio_pu_pin>;
		pinctrl-3 = <&P8_21_gpio_pd_pin>;
		pinctrl-4 = <&P8_21_pruout_pin>;
		pinctrl-5 = <&P8_21_pruin_pin>;
	};

	/* P8_22 (ZCZ ball V8) emmc */
	P8_22_pinmux {
		compatible = "bone-pinmux-helper";
		status = "okay";
		pinctrl-names = "default", "gpio", "gpio_pu", "gpio_pd";
		pinctrl-0 = <&P8_22_default_pin>;
		pinctrl-1 = <&P8_22_gpio_pin>;
		pinctrl-2 = <&P8_22_gpio_pu_pin>;
		pinctrl-3 = <&P8_22_gpio_pd_pin>;
	};

	/* P8_23 (ZCZ ball U8) emmc */
	P8_23_pinmux {
		compatible = "bone-pinmux-helper";
		status = "okay";
		pinctrl-names = "default", "gpio", "gpio_pu", "gpio_pd";
		pinctrl-0 = <&P8_23_default_pin>;
		pinctrl-1 = <&P8_23_gpio_pin>;
		pinctrl-2 = <&P8_23_gpio_pu_pin>;
		pinctrl-3 = <&P8_23_gpio_pd_pin>;
	};

	/* P8_24 (ZCZ ball V7) emmc */
	P8_24_pinmux {
		compatible = "bone-pinmux-helper";
		status = "okay";
		pinctrl-names = "default", "gpio", "gpio_pu", "gpio_pd";
		pinctrl-0 = <&P8_24_default_pin>;
		pinctrl-1 = <&P8_24_gpio_pin>;
		pinctrl-2 = <&P8_24_gpio_pu_pin>;
		pinctrl-3 = <&P8_24_gpio_pd_pin>;
	};

	/* P8_25 (ZCZ ball U7) emmc */
	P8_25_pinmux {
		compatible = "bone-pinmux-helper";
		status = "okay";
		pinctrl-names = "default", "gpio", "gpio_pu", "gpio_pd";
		pinctrl-0 = <&P8_25_default_pin>;
		pinctrl-1 = <&P8_25_gpio_pin>;
		pinctrl-2 = <&P8_25_gpio_pu_pin>;
		pinctrl-3 = <&P8_25_gpio_pd_pin>;
	};

	/* P8_26 (ZCZ ball V6) gpio-hog wl1835 */

	/* P8_27 (ZCZ ball U5) hdmi */
	P8_27_pinmux {
		compatible = "bone-pinmux-helper";
		status = "okay";
		pinctrl-names = "default", "gpio", "gpio_pu", "gpio_pd", "pruout", "pruin";
		pinctrl-0 = <&P8_27_default_pin>;
		pinctrl-1 = <&P8_27_gpio_pin>;
		pinctrl-2 = <&P8_27_gpio_pu_pin>;
		pinctrl-3 = <&P8_27_gpio_pd_pin>;
		pinctrl-4 = <&P8_27_pruout_pin>;
		pinctrl-5 = <&P8_27_pruin_pin>;
	};

	/* P8_28 (ZCZ ball V5) hdmi */
	P8_28_pinmux {
		compatible = "bone-pinmux-helper";
		status = "okay";
		pinctrl-names = "default", "gpio", "gpio_pu", "gpio_pd", "pruout", "pruin";
		pinctrl-0 = <&P8_28_default_pin>;
		pinctrl-1 = <&P8_28_gpio_pin>;
		pinctrl-2 = <&P8_28_gpio_pu_pin>;
		pinctrl-3 = <&P8_28_gpio_pd_pin>;
		pinctrl-4 = <&P8_28_pruout_pin>;
		pinctrl-5 = <&P8_28_pruin_pin>;
	};

	/* P8_29 (ZCZ ball R5) hdmi */
	P8_29_pinmux {
		compatible = "bone-pinmux-helper";
		status = "okay";
		pinctrl-names = "default", "gpio", "gpio_pu", "gpio_pd", "pruout", "pruin";
		pinctrl-0 = <&P8_29_default_pin>;
		pinctrl-1 = <&P8_29_gpio_pin>;
		pinctrl-2 = <&P8_29_gpio_pu_pin>;
		pinctrl-3 = <&P8_29_gpio_pd_pin>;
		pinctrl-4 = <&P8_29_pruout_pin>;
		pinctrl-5 = <&P8_29_pruin_pin>;
	};

	/* P8_30 (ZCZ ball R6) hdmi */
	P8_30_pinmux {
		compatible = "bone-pinmux-helper";
		status = "okay";
		pinctrl-names = "default", "gpio", "gpio_pu", "gpio_pd", "pruout", "pruin";
		pinctrl-0 = <&P8_30_default_pin>;
		pinctrl-1 = <&P8_30_gpio_pin>;
		pinctrl-2 = <&P8_30_gpio_pu_pin>;
		pinctrl-3 = <&P8_30_gpio_pd_pin>;
		pinctrl-4 = <&P8_30_pruout_pin>;
		pinctrl-5 = <&P8_30_pruin_pin>;
	};

	/* P8_31 (ZCZ ball V4) hdmi */
	P8_31_pinmux {
		compatible = "bone-pinmux-helper";
		status = "okay";
		pinctrl-names = "default", "gpio", "gpio_pu", "gpio_pd", "uart", "eqep";
		pinctrl-0 = <&P8_31_default_pin>;
		pinctrl-1 = <&P8_31_gpio_pin>;
		pinctrl-2 = <&P8_31_gpio_pu_pin>;
		pinctrl-3 = <&P8_31_gpio_pd_pin>;
		pinctrl-4 = <&P8_31_uart_pin>;
		pinctrl-5 = <&P8_31_eqep_pin>;
	};

	/* P8_32 (ZCZ ball T5) hdmi */
	P8_32_pinmux {
		compatible = "bone-pinmux-helper";
		status = "okay";
		pinctrl-names = "default", "gpio", "gpio_pu", "gpio_pd", "eqep";
		pinctrl-0 = <&P8_32_default_pin>;
		pinctrl-1 = <&P8_32_gpio_pin>;
		pinctrl-2 = <&P8_32_gpio_pu_pin>;
		pinctrl-3 = <&P8_32_gpio_pd_pin>;
		pinctrl-4 = <&P8_32_eqep_pin>;
	};

	/* P8_33 (ZCZ ball V3) hdmi */
	P8_33_pinmux {
		compatible = "bone-pinmux-helper";
		status = "okay";
		pinctrl-names = "default", "gpio", "gpio_pu", "gpio_pd", "eqep";
		pinctrl-0 = <&P8_33_default_pin>;
		pinctrl-1 = <&P8_33_gpio_pin>;
		pinctrl-2 = <&P8_33_gpio_pu_pin>;
		pinctrl-3 = <&P8_33_gpio_pd_pin>;
		pinctrl-4 = <&P8_33_eqep_pin>;
	};

	/* P8_34 (ZCZ ball U4) hdmi */
	P8_34_pinmux {
		compatible = "bone-pinmux-helper";
		status = "okay";
		pinctrl-names = "default", "gpio", "gpio_pu", "gpio_pd", "pwm";
		pinctrl-0 = <&P8_34_default_pin>;
		pinctrl-1 = <&P8_34_gpio_pin>;
		pinctrl-2 = <&P8_34_gpio_pu_pin>;
		pinctrl-3 = <&P8_34_gpio_pd_pin>;
		pinctrl-4 = <&P8_34_pwm_pin>;
	};

	/* P8_35 (ZCZ ball V2) hdmi */
	P8_35_pinmux {
		compatible = "bone-pinmux-helper";
		status = "okay";
		pinctrl-names = "default", "gpio", "gpio_pu", "gpio_pd", "eqep";
		pinctrl-0 = <&P8_35_default_pin>;
		pinctrl-1 = <&P8_35_gpio_pin>;
		pinctrl-2 = <&P8_35_gpio_pu_pin>;
		pinctrl-3 = <&P8_35_gpio_pd_pin>;
		pinctrl-4 = <&P8_35_eqep_pin>;
	};

	/* P8_36 (ZCZ ball U3) hdmi */
	P8_36_pinmux {
		compatible = "bone-pinmux-helper";
		status = "okay";
		pinctrl-names = "default", "gpio", "gpio_pu", "gpio_pd", "pwm";
		pinctrl-0 = <&P8_36_default_pin>;
		pinctrl-1 = <&P8_36_gpio_pin>;
		pinctrl-2 = <&P8_36_gpio_pu_pin>;
		pinctrl-3 = <&P8_36_gpio_pd_pin>;
		pinctrl-4 = <&P8_36_pwm_pin>;
	};

	/* P8_37 (ZCZ ball U1) hdmi */
	P8_37_pinmux {
		compatible = "bone-pinmux-helper";
		status = "okay";
		pinctrl-names = "default", "gpio", "gpio_pu", "gpio_pd", "uart", "pwm";
		pinctrl-0 = <&P8_37_default_pin>;
		pinctrl-1 = <&P8_37_gpio_pin>;
		pinctrl-2 = <&P8_37_gpio_pu_pin>;
		pinctrl-3 = <&P8_37_gpio_pd_pin>;
		pinctrl-4 = <&P8_37_uart_pin>;
		pinctrl-5 = <&P8_37_pwm_pin>;
	};

	/* P8_38 (ZCZ ball U2) hdmi */
	P8_38_pinmux {
		compatible = "bone-pinmux-helper";
		status = "okay";
		pinctrl-names = "default", "gpio", "gpio_pu", "gpio_pd", "uart", "pwm";
		pinctrl-0 = <&P8_38_default_pin>;
		pinctrl-1 = <&P8_38_gpio_pin>;
		pinctrl-2 = <&P8_38_gpio_pu_pin>;
		pinctrl-3 = <&P8_38_gpio_pd_pin>;
		pinctrl-4 = <&P8_38_uart_pin>;
		pinctrl-5 = <&P8_38_pwm_pin>;
	};

	/* P8_39 (ZCZ ball T3) hdmi */
	P8_39_pinmux {
		compatible = "bone-pinmux-helper";
		status = "okay";
		pinctrl-names = "default", "gpio", "gpio_pu", "gpio_pd", "eqep", "pruout", "pruin";
		pinctrl-0 = <&P8_39_default_pin>;
		pinctrl-1 = <&P8_39_gpio_pin>;
		pinctrl-2 = <&P8_39_gpio_pu_pin>;
		pinctrl-3 = <&P8_39_gpio_pd_pin>;
		pinctrl-4 = <&P8_39_eqep_pin>;
		pinctrl-5 = <&P8_39_pruout_pin>;
		pinctrl-6 = <&P8_39_pruin_pin>;
	};

	/* P8_40 (ZCZ ball T4) hdmi */
	P8_40_pinmux {
		compatible = "bone-pinmux-helper";
		status = "okay";
		pinctrl-names = "default", "gpio", "gpio_pu", "gpio_pd", "eqep", "pruout", "pruin";
		pinctrl-0 = <&P8_40_default_pin>;
		pinctrl-1 = <&P8_40_gpio_pin>;
		pinctrl-2 = <&P8_40_gpio_pu_pin>;
		pinctrl-3 = <&P8_40_gpio_pd_pin>;
		pinctrl-4 = <&P8_40_eqep_pin>;
		pinctrl-5 = <&P8_40_pruout_pin>;
		pinctrl-6 = <&P8_40_pruin_pin>;
	};

	/* P8_41 (ZCZ ball T1) hdmi */
	P8_41_pinmux {
		compatible = "bone-pinmux-helper";
		status = "okay";
		pinctrl-names = "default", "gpio", "gpio_pu", "gpio_pd", "eqep", "pruout", "pruin";
		pinctrl-0 = <&P8_41_default_pin>;
		pinctrl-1 = <&P8_41_gpio_pin>;
		pinctrl-2 = <&P8_41_gpio_pu_pin>;
		pinctrl-3 = <&P8_41_gpio_pd_pin>;
		pinctrl-4 = <&P8_41_eqep_pin>;
		pinctrl-5 = <&P8_41_pruout_pin>;
		pinctrl-6 = <&P8_41_pruin_pin>;
	};

	/* P8_42 (ZCZ ball T2) hdmi */
	P8_42_pinmux {
		compatible = "bone-pinmux-helper";
		status = "okay";
		pinctrl-names = "default", "gpio", "gpio_pu", "gpio_pd", "eqep", "pruout", "pruin";
		pinctrl-0 = <&P8_42_default_pin>;
		pinctrl-1 = <&P8_42_gpio_pin>;
		pinctrl-2 = <&P8_42_gpio_pu_pin>;
		pinctrl-3 = <&P8_42_gpio_pd_pin>;
		pinctrl-4 = <&P8_42_eqep_pin>;
		pinctrl-5 = <&P8_42_pruout_pin>;
		pinctrl-6 = <&P8_42_pruin_pin>;
	};

	/* P8_43 (ZCZ ball R3) hdmi */
	P8_43_pinmux {
		compatible = "bone-pinmux-helper";
		status = "okay";
		pinctrl-names = "default", "gpio", "gpio_pu", "gpio_pd", "pwm", "pruout", "pruin";
		pinctrl-0 = <&P8_43_default_pin>;
		pinctrl-1 = <&P8_43_gpio_pin>;
		pinctrl-2 = <&P8_43_gpio_pu_pin>;
		pinctrl-3 = <&P8_43_gpio_pd_pin>;
		pinctrl-4 = <&P8_43_pwm_pin>;
		pinctrl-5 = <&P8_43_pruout_pin>;
		pinctrl-6 = <&P8_43_pruin_pin>;
	};

	/* P8_44 (ZCZ ball R4) hdmi */
	P8_44_pinmux {
		compatible = "bone-pinmux-helper";
		status = "okay";
		pinctrl-names = "default", "gpio", "gpio_pu", "gpio_pd", "pwm", "pruout", "pruin";
		pinctrl-0 = <&P8_44_default_pin>;
		pinctrl-1 = <&P8_44_gpio_pin>;
		pinctrl-2 = <&P8_44_gpio_pu_pin>;
		pinctrl-3 = <&P8_44_gpio_pd_pin>;
		pinctrl-4 = <&P8_44_pwm_pin>;
		pinctrl-5 = <&P8_44_pruout_pin>;
		pinctrl-6 = <&P8_44_pruin_pin>;
	};

	/* P8_45 (ZCZ ball R1) hdmi */
	P8_45_pinmux {
		compatible = "bone-pinmux-helper";
		status = "okay";
		pinctrl-names = "default", "gpio", "gpio_pu", "gpio_pd", "pwm", "pruout", "pruin";
		pinctrl-0 = <&P8_45_default_pin>;
		pinctrl-1 = <&P8_45_gpio_pin>;
		pinctrl-2 = <&P8_45_gpio_pu_pin>;
		pinctrl-3 = <&P8_45_gpio_pd_pin>;
		pinctrl-4 = <&P8_45_pwm_pin>;
		pinctrl-5 = <&P8_45_pruout_pin>;
		pinctrl-6 = <&P8_45_pruin_pin>;
	};

	/* P8_46 (ZCZ ball R2) hdmi */
	P8_46_pinmux {
		compatible = "bone-pinmux-helper";
		status = "okay";
		pinctrl-names = "default", "gpio", "gpio_pu", "gpio_pd", "pwm", "pruout", "pruin";
		pinctrl-0 = <&P8_46_default_pin>;
		pinctrl-1 = <&P8_46_gpio_pin>;
		pinctrl-2 = <&P8_46_gpio_pu_pin>;
		pinctrl-3 = <&P8_46_gpio_pd_pin>;
		pinctrl-4 = <&P8_46_pwm_pin>;
		pinctrl-5 = <&P8_46_pruout_pin>;
		pinctrl-6 = <&P8_46_pruin_pin>;
	};

	/************************/
	/* P9 Header */
	/************************/

	/* P9_01                GND */

	/* P9_02                GND */

	/* P9_03                3V3 */

	/* P9_04                3V3 */

	/* P9_05                VDD_5V */

	/* P9_06                VDD_5V */

	/* P9_07                SYS_5V */

	/* P9_08                SYS_5V */

	/* P9_09                PWR_BUT */

	/* P9_10                RSTn */

	/* P9_11 (ZCZ ball T17) */
	P9_11_pinmux {
		compatible = "bone-pinmux-helper";
		status = "okay";
		pinctrl-names = "default", "gpio", "gpio_pu", "gpio_pd", "uart";
		pinctrl-0 = <&P9_11_default_pin>;
		pinctrl-1 = <&P9_11_gpio_pin>;
		pinctrl-2 = <&P9_11_gpio_pu_pin>;
		pinctrl-3 = <&P9_11_gpio_pd_pin>;
		pinctrl-4 = <&P9_11_uart_pin>;
	};

	/* P9_12 (ZCZ ball U18) */
	P9_12_pinmux {
		compatible = "bone-pinmux-helper";
		status = "okay";
		pinctrl-names = "default", "gpio", "gpio_pu", "gpio_pd";
		pinctrl-0 = <&P9_12_default_pin>;
		pinctrl-1 = <&P9_12_gpio_pin>;
		pinctrl-2 = <&P9_12_gpio_pu_pin>;
		pinctrl-3 = <&P9_12_gpio_pd_pin>;
	};

	/* P9_13 (ZCZ ball U17) */
	P9_13_pinmux {
		compatible = "bone-pinmux-helper";
		status = "okay";
		pinctrl-names = "default", "gpio", "gpio_pu", "gpio_pd", "uart";
		pinctrl-0 = <&P9_13_default_pin>;
		pinctrl-1 = <&P9_13_gpio_pin>;
		pinctrl-2 = <&P9_13_gpio_pu_pin>;
		pinctrl-3 = <&P9_13_gpio_pd_pin>;
		pinctrl-4 = <&P9_13_uart_pin>;
	};

	/* P9_14 (ZCZ ball U14) */
	P9_14_pinmux {
		compatible = "bone-pinmux-helper";
		status = "okay";
		pinctrl-names = "default", "gpio", "gpio_pu", "gpio_pd", "pwm";
		pinctrl-0 = <&P9_14_default_pin>;
		pinctrl-1 = <&P9_14_gpio_pin>;
		pinctrl-2 = <&P9_14_gpio_pu_pin>;
		pinctrl-3 = <&P9_14_gpio_pd_pin>;
		pinctrl-4 = <&P9_14_pwm_pin>;
	};

	/* P9_15 (ZCZ ball R13) */
	P9_15_pinmux {
		compatible = "bone-pinmux-helper";
		status = "okay";
		pinctrl-names = "default", "gpio", "gpio_pu", "gpio_pd", "pwm";
		pinctrl-0 = <&P9_15_default_pin>;
		pinctrl-1 = <&P9_15_gpio_pin>;
		pinctrl-2 = <&P9_15_gpio_pu_pin>;
		pinctrl-3 = <&P9_15_gpio_pd_pin>;
		pinctrl-4 = <&P9_15_pwm_pin>;
	};

	/* P9_16 (ZCZ ball T14) */
	P9_16_pinmux {
		compatible = "bone-pinmux-helper";
		status = "okay";
		pinctrl-names = "default", "gpio", "gpio_pu", "gpio_pd", "pwm";
		pinctrl-0 = <&P9_16_default_pin>;
		pinctrl-1 = <&P9_16_gpio_pin>;
		pinctrl-2 = <&P9_16_gpio_pu_pin>;
		pinctrl-3 = <&P9_16_gpio_pd_pin>;
		pinctrl-4 = <&P9_16_pwm_pin>;
	};

	/* P9_17 (ZCZ ball A16) */
	P9_17_pinmux {
		compatible = "bone-pinmux-helper";
		status = "okay";
		pinctrl-names = "default", "gpio", "gpio_pu", "gpio_pd", "spi_cs", "i2c", "pwm", "pru_uart";
		pinctrl-0 = <&P9_17_default_pin>;
		pinctrl-1 = <&P9_17_gpio_pin>;
		pinctrl-2 = <&P9_17_gpio_pu_pin>;
		pinctrl-3 = <&P9_17_gpio_pd_pin>;
		pinctrl-4 = <&P9_17_spi_cs_pin>;
		pinctrl-5 = <&P9_17_i2c_pin>;
		pinctrl-6 = <&P9_17_pwm_pin>;
		pinctrl-7 = <&P9_17_pru_uart_pin>;
	};

	/* P9_18 (ZCZ ball B16) */
	P9_18_pinmux {
		compatible = "bone-pinmux-helper";
		status = "okay";
		pinctrl-names = "default", "gpio", "gpio_pu", "gpio_pd", "spi", "i2c", "pwm", "pru_uart";
		pinctrl-0 = <&P9_18_default_pin>;
		pinctrl-1 = <&P9_18_gpio_pin>;
		pinctrl-2 = <&P9_18_gpio_pu_pin>;
		pinctrl-3 = <&P9_18_gpio_pd_pin>;
		pinctrl-4 = <&P9_18_spi_pin>;
		pinctrl-5 = <&P9_18_i2c_pin>;
		pinctrl-6 = <&P9_18_pwm_pin>;
		pinctrl-7 = <&P9_18_pru_uart_pin>;
	};

	/* P9_19 (ZCZ ball D17) i2c */
	P9_19_pinmux {
		compatible = "bone-pinmux-helper";
		status = "okay";
		pinctrl-names = "default", "gpio", "gpio_pu", "gpio_pd", "spi_cs", "can", "i2c", "pru_uart", "timer";
		pinctrl-0 = <&P9_19_default_pin>;
		pinctrl-1 = <&P9_19_gpio_pin>;
		pinctrl-2 = <&P9_19_gpio_pu_pin>;
		pinctrl-3 = <&P9_19_gpio_pd_pin>;
		pinctrl-4 = <&P9_19_spi_cs_pin>;
		pinctrl-5 = <&P9_19_can_pin>;
		pinctrl-6 = <&P9_19_i2c_pin>;
		pinctrl-7 = <&P9_19_pru_uart_pin>;
		pinctrl-8 = <&P9_19_timer_pin>;
	};

	/* P9_20 (ZCZ ball D18) i2c */
	P9_20_pinmux {
		compatible = "bone-pinmux-helper";
		status = "okay";
		pinctrl-names = "default", "gpio", "gpio_pu", "gpio_pd", "spi_cs", "can", "i2c", "pru_uart", "timer";
		pinctrl-0 = <&P9_20_default_pin>;
		pinctrl-1 = <&P9_20_gpio_pin>;
		pinctrl-2 = <&P9_20_gpio_pu_pin>;
		pinctrl-3 = <&P9_20_gpio_pd_pin>;
		pinctrl-4 = <&P9_20_spi_cs_pin>;
		pinctrl-5 = <&P9_20_can_pin>;
		pinctrl-6 = <&P9_20_i2c_pin>;
		pinctrl-7 = <&P9_20_pru_uart_pin>;
		pinctrl-8 = <&P9_20_timer_pin>;
	};

	/* P9_21 (ZCZ ball B17) */
	P9_21_pinmux {
		compatible = "bone-pinmux-helper";
		status = "okay";
		pinctrl-names = "default", "gpio", "gpio_pu", "gpio_pd", "spi", "uart", "i2c", "pwm", "pru_uart";
		pinctrl-0 = <&P9_21_default_pin>;
		pinctrl-1 = <&P9_21_gpio_pin>;
		pinctrl-2 = <&P9_21_gpio_pu_pin>;
		pinctrl-3 = <&P9_21_gpio_pd_pin>;
		pinctrl-4 = <&P9_21_spi_pin>;
		pinctrl-5 = <&P9_21_uart_pin>;
		pinctrl-6 = <&P9_21_i2c_pin>;
		pinctrl-7 = <&P9_21_pwm_pin>;
		pinctrl-8 = <&P9_21_pru_uart_pin>;
	};

	/* P9_22 (ZCZ ball A17) */
	P9_22_pinmux {
		compatible = "bone-pinmux-helper";
		status = "okay";
		pinctrl-names = "default", "gpio", "gpio_pu", "gpio_pd", "spi_sclk", "uart", "i2c", "pwm", "pru_uart";
		pinctrl-0 = <&P9_22_default_pin>;
		pinctrl-1 = <&P9_22_gpio_pin>;
		pinctrl-2 = <&P9_22_gpio_pu_pin>;
		pinctrl-3 = <&P9_22_gpio_pd_pin>;
		pinctrl-4 = <&P9_22_spi_sclk_pin>;
		pinctrl-5 = <&P9_22_uart_pin>;
		pinctrl-6 = <&P9_22_i2c_pin>;
		pinctrl-7 = <&P9_22_pwm_pin>;
		pinctrl-8 = <&P9_22_pru_uart_pin>;
	};

	/* P9_23 (ZCZ ball V14) */
	P9_23_pinmux {
		compatible = "bone-pinmux-helper";
		status = "okay";
		pinctrl-names = "default", "gpio", "gpio_pu", "gpio_pd", "pwm";
		pinctrl-0 = <&P9_23_default_pin>;
		pinctrl-1 = <&P9_23_gpio_pin>;
		pinctrl-2 = <&P9_23_gpio_pu_pin>;
		pinctrl-3 = <&P9_23_gpio_pd_pin>;
		pinctrl-4 = <&P9_23_pwm_pin>;
	};

	/* P9_24 (ZCZ ball D15) */
	P9_24_pinmux {
		compatible = "bone-pinmux-helper";
		status = "okay";
		pinctrl-names = "default", "gpio", "gpio_pu", "gpio_pd", "uart", "can", "i2c", "pru_uart", "pruin";
		pinctrl-0 = <&P9_24_default_pin>;
		pinctrl-1 = <&P9_24_gpio_pin>;
		pinctrl-2 = <&P9_24_gpio_pu_pin>;
		pinctrl-3 = <&P9_24_gpio_pd_pin>;
		pinctrl-4 = <&P9_24_uart_pin>;
		pinctrl-5 = <&P9_24_can_pin>;
		pinctrl-6 = <&P9_24_i2c_pin>;
		pinctrl-7 = <&P9_24_pru_uart_pin>;
		pinctrl-8 = <&P9_24_pruin_pin>;
	};

	/* P9_25 (ZCZ ball A14) audio */
	P9_25_pinmux {
		compatible = "bone-pinmux-helper";
		status = "okay";
		pinctrl-names = "default", "gpio", "gpio_pu", "gpio_pd", "eqep", "pruout", "pruin";
		pinctrl-0 = <&P9_25_default_pin>;
		pinctrl-1 = <&P9_25_gpio_pin>;
		pinctrl-2 = <&P9_25_gpio_pu_pin>;
		pinctrl-3 = <&P9_25_gpio_pd_pin>;
		pinctrl-4 = <&P9_25_eqep_pin>;
		pinctrl-5 = <&P9_25_pruout_pin>;
		pinctrl-6 = <&P9_25_pruin_pin>;
	};

	/* P9_26 (ZCZ ball D16) */
	P9_26_pinmux {
		compatible = "bone-pinmux-helper";
		status = "okay";
		pinctrl-names = "default", "gpio", "gpio_pu", "gpio_pd", "uart", "can", "i2c", "pru_uart", "pruin";
		pinctrl-0 = <&P9_26_default_pin>;
		pinctrl-1 = <&P9_26_gpio_pin>;
		pinctrl-2 = <&P9_26_gpio_pu_pin>;
		pinctrl-3 = <&P9_26_gpio_pd_pin>;
		pinctrl-4 = <&P9_26_uart_pin>;
		pinctrl-5 = <&P9_26_can_pin>;
		pinctrl-6 = <&P9_26_i2c_pin>;
		pinctrl-7 = <&P9_26_pru_uart_pin>;
		pinctrl-8 = <&P9_26_pruin_pin>;
	};

	/* P9_27 (ZCZ ball C13) */
	P9_27_pinmux {
		compatible = "bone-pinmux-helper";
		status = "okay";
		pinctrl-names = "default", "gpio", "gpio_pu", "gpio_pd", "eqep", "pruout", "pruin";
		pinctrl-0 = <&P9_27_default_pin>;
		pinctrl-1 = <&P9_27_gpio_pin>;
		pinctrl-2 = <&P9_27_gpio_pu_pin>;
		pinctrl-3 = <&P9_27_gpio_pd_pin>;
		pinctrl-4 = <&P9_27_eqep_pin>;
		pinctrl-5 = <&P9_27_pruout_pin>;
		pinctrl-6 = <&P9_27_pruin_pin>;
	};

	/* P9_28 (ZCZ ball C12) audio */
	P9_28_pinmux {
		compatible = "bone-pinmux-helper";
		status = "okay";
		pinctrl-names = "default", "gpio", "gpio_pu", "gpio_pd", "spi_cs", "pwm", "pwm2", "pruout", "pruin";
		pinctrl-0 = <&P9_28_default_pin>;
		pinctrl-1 = <&P9_28_gpio_pin>;
		pinctrl-2 = <&P9_28_gpio_pu_pin>;
		pinctrl-3 = <&P9_28_gpio_pd_pin>;
		pinctrl-4 = <&P9_28_spi_cs_pin>;
		pinctrl-5 = <&P9_28_pwm_pin>;
		pinctrl-6 = <&P9_28_pwm2_pin>;
		pinctrl-7 = <&P9_28_pruout_pin>;
		pinctrl-8 = <&P9_28_pruin_pin>;
	};

	/* P9_29 (ZCZ ball B13) audio */
	P9_29_pinmux {
		compatible = "bone-pinmux-helper";
		status = "okay";
		pinctrl-names = "default", "gpio", "gpio_pu", "gpio_pd", "spi", "pwm", "pruout", "pruin";
		pinctrl-0 = <&P9_29_default_pin>;
		pinctrl-1 = <&P9_29_gpio_pin>;
		pinctrl-2 = <&P9_29_gpio_pu_pin>;
		pinctrl-3 = <&P9_29_gpio_pd_pin>;
		pinctrl-4 = <&P9_29_spi_pin>;
		pinctrl-5 = <&P9_29_pwm_pin>;
		pinctrl-6 = <&P9_29_pruout_pin>;
		pinctrl-7 = <&P9_29_pruin_pin>;
	};

	/* P9_30 (ZCZ ball D12) gpio-hog wl1835 */

	/* P9_31 (ZCZ ball A13) audio */
	P9_31_pinmux {
		compatible = "bone-pinmux-helper";
		status = "okay";
		pinctrl-names = "default", "gpio", "gpio_pu", "gpio_pd", "spi_sclk", "pwm", "pruout", "pruin";
		pinctrl-0 = <&P9_31_default_pin>;
		pinctrl-1 = <&P9_31_gpio_pin>;
		pinctrl-2 = <&P9_31_gpio_pu_pin>;
		pinctrl-3 = <&P9_31_gpio_pd_pin>;
		pinctrl-4 = <&P9_31_spi_sclk_pin>;
		pinctrl-5 = <&P9_31_pwm_pin>;
		pinctrl-6 = <&P9_31_pruout_pin>;
		pinctrl-7 = <&P9_31_pruin_pin>;
	};

	/* P9_32                VADC */

	/* P9_33 (ZCZ ball C8)  AIN4 */

	/* P9_34                AGND */

	/* P9_35 (ZCZ ball A8)  AIN6 */

	/* P9_36 (ZCZ ball B8)  AIN5 */

	/* P9_37 (ZCZ ball B7)  AIN2 */

	/* P9_38 (ZCZ ball A7)  AIN3 */

	/* P9_39 (ZCZ ball B6)  AIN0 */

	/* P9_40 (ZCZ ball C7)  AIN1 */

	/* P9_41 (ZCZ ball D14) */
	P9_41_pinmux {
		compatible = "bone-pinmux-helper";
		status = "okay";
		pinctrl-names = "default", "gpio", "gpio_pu", "gpio_pd", "timer", "pruin";
		pinctrl-0 = <&P9_41_default_pin>;
		pinctrl-1 = <&P9_41_gpio_pin>;
		pinctrl-2 = <&P9_41_gpio_pu_pin>;
		pinctrl-3 = <&P9_41_gpio_pd_pin>;
		pinctrl-4 = <&P9_41_timer_pin>;
		pinctrl-5 = <&P9_41_pruin_pin>;
	};

	/* P9_41.1 */
	/* P9_91 (ZCZ ball D13) */
	P9_91_pinmux {
		compatible = "bone-pinmux-helper";
		status = "okay";
		pinctrl-names = "default", "gpio", "gpio_pu", "gpio_pd", "eqep", "pruout", "pruin";
		pinctrl-0 = <&P9_91_default_pin>;
		pinctrl-1 = <&P9_91_gpio_pin>;
		pinctrl-2 = <&P9_91_gpio_pu_pin>;
		pinctrl-3 = <&P9_91_gpio_pd_pin>;
		pinctrl-4 = <&P9_91_eqep_pin>;
		pinctrl-5 = <&P9_91_pruout_pin>;
		pinctrl-6 = <&P9_91_pruin_pin>;
	};

	/* P9_42 (ZCZ ball C18) */
	P9_42_pinmux {
		compatible = "bone-pinmux-helper";
		status = "okay";
		pinctrl-names = "default", "gpio", "gpio_pu", "gpio_pd", "spi_cs", "spi_sclk", "uart", "pwm", "pru_ecap_pwm";
		pinctrl-0 = <&P9_42_default_pin>;
		pinctrl-1 = <&P9_42_gpio_pin>;
		pinctrl-2 = <&P9_42_gpio_pu_pin>;
		pinctrl-3 = <&P9_42_gpio_pd_pin>;
		pinctrl-4 = <&P9_42_spi_cs_pin>;
		pinctrl-5 = <&P9_42_spi_sclk_pin>;
		pinctrl-6 = <&P9_42_uart_pin>;
		pinctrl-7 = <&P9_42_pwm_pin>;
		pinctrl-8 = <&P9_42_pru_ecap_pwm_pin>;
	};

	/* P9_42.1 */
	/* P9_92 (ZCZ ball B12) */
	P9_92_pinmux {
		compatible = "bone-pinmux-helper";
		status = "okay";
		pinctrl-names = "default", "gpio", "gpio_pu", "gpio_pd", "eqep", "pruout", "pruin";
		pinctrl-0 = <&P9_92_default_pin>;
		pinctrl-1 = <&P9_92_gpio_pin>;
		pinctrl-2 = <&P9_92_gpio_pu_pin>;
		pinctrl-3 = <&P9_92_gpio_pd_pin>;
		pinctrl-4 = <&P9_92_eqep_pin>;
		pinctrl-5 = <&P9_92_pruout_pin>;
		pinctrl-6 = <&P9_92_pruin_pin>;
	};

	/* P9_43                GND */

	/* P9_44                GND */

	/* P9_45                GND */

	/* P9_46                GND */

	cape-universal {
		compatible = "gpio-of-helper";
		status = "okay";
		pinctrl-names = "default";
		pinctrl-0 = <>;

		P8_03 {
			gpio-name = "P8_03";
			gpio = <&gpio1 6 0>;
			input;
			dir-changeable;
		};

		P8_04 {
			gpio-name = "P8_04";
			gpio = <&gpio1 7 0>;
			input;
			dir-changeable;
		};

		P8_05 {
			gpio-name = "P8_05";
			gpio = <&gpio1 2 0>;
			input;
			dir-changeable;
		};

		P8_06 {
			gpio-name = "P8_06";
			gpio = <&gpio1 3 0>;
			input;
			dir-changeable;
		};

		P8_07 {
			gpio-name = "P8_07";
			gpio = <&gpio2 2 0>;
			input;
			dir-changeable;
		};

		P8_08 {
			gpio-name = "P8_08";
			gpio = <&gpio2 3 0>;
			input;
			dir-changeable;
		};

		P8_09 {
			gpio-name = "P8_09";
			gpio = <&gpio2 5 0>;
			input;
			dir-changeable;
		};

		P8_10 {
			gpio-name = "P8_10";
			gpio = <&gpio2 4 0>;
			input;
			dir-changeable;
		};

		P8_11 {
			gpio-name = "P8_11";
			gpio = <&gpio1 13 0>;
			input;
			dir-changeable;
		};

		P8_12 {
			gpio-name = "P8_12";
			gpio = <&gpio1 12 0>;
			input;
			dir-changeable;
		};

		P8_13 {
			gpio-name = "P8_13";
			gpio = <&gpio0 23 0>;
			input;
			dir-changeable;
		};

		P8_15 {
			gpio-name = "P8_15";
			gpio = <&gpio1 15 0>;
			input;
			dir-changeable;
		};

		P8_16 {
			gpio-name = "P8_16";
			gpio = <&gpio1 14 0>;
			input;
			dir-changeable;
		};

		P8_18 {
			gpio-name = "P8_18";
			gpio = <&gpio2 1 0>;
			input;
			dir-changeable;
		};

		P8_19 {
			gpio-name = "P8_19";
			gpio = <&gpio0 22 0>;
			input;
			dir-changeable;
		};

		P8_20 {
			gpio-name = "P8_20";
			gpio = <&gpio1 31 0>;
			input;
			dir-changeable;
		};

		P8_21 {
			gpio-name = "P8_21";
			gpio = <&gpio1 30 0>;
			input;
			dir-changeable;
		};

		P8_22 {
			gpio-name = "P8_22";
			gpio = <&gpio1 5 0>;
			input;
			dir-changeable;
		};

		P8_23 {
			gpio-name = "P8_23";
			gpio = <&gpio1 4 0>;
			input;
			dir-changeable;
		};

		P8_24 {
			gpio-name = "P8_24";
			gpio = <&gpio1 1 0>;
			input;
			dir-changeable;
		};

		P8_25 {
			gpio-name = "P8_25";
			gpio = <&gpio1 0 0>;
			input;
			dir-changeable;
		};

		P8_27 {
			gpio-name = "P8_27";
			gpio = <&gpio2 22 0>;
			input;
			dir-changeable;
		};

		P8_28 {
			gpio-name = "P8_28";
			gpio = <&gpio2 24 0>;
			input;
			dir-changeable;
		};

		P8_29 {
			gpio-name = "P8_29";
			gpio = <&gpio2 23 0>;
			input;
			dir-changeable;
		};

		P8_30 {
			gpio-name = "P8_30";
			gpio = <&gpio2 25 0>;
			input;
			dir-changeable;
		};

		P8_31 {
			gpio-name = "P8_31";
			gpio = <&gpio0 10 0>;
			input;
			dir-changeable;
		};

		P8_32 {
			gpio-name = "P8_32";
			gpio = <&gpio0 11 0>;
			input;
			dir-changeable;
		};

		P8_33 {
			gpio-name = "P8_33";
			gpio = <&gpio0 9 0>;
			input;
			dir-changeable;
		};

		P8_34 {
			gpio-name = "P8_34";
			gpio = <&gpio2 17 0>;
			input;
			dir-changeable;
		};

		P8_35 {
			gpio-name = "P8_35";
			gpio = <&gpio0 8 0>;
			input;
			dir-changeable;
		};

		P8_36 {
			gpio-name = "P8_36";
			gpio = <&gpio2 16 0>;
			input;
			dir-changeable;
		};

		P8_37 {
			gpio-name = "P8_37";
			gpio = <&gpio2 14 0>;
			input;
			dir-changeable;
		};

		P8_38 {
			gpio-name = "P8_38";
			gpio = <&gpio2 15 0>;
			input;
			dir-changeable;
		};

		P8_39 {
			gpio-name = "P8_39";
			gpio = <&gpio2 12 0>;
			input;
			dir-changeable;
		};

		P8_40 {
			gpio-name = "P8_40";
			gpio = <&gpio2 13 0>;
			input;
			dir-changeable;
		};

		P8_41 {
			gpio-name = "P8_41";
			gpio = <&gpio2 10 0>;
			input;
			dir-changeable;
		};

		P8_42 {
			gpio-name = "P8_42";
			gpio = <&gpio2 11 0>;
			input;
			dir-changeable;
		};

		P8_43 {
			gpio-name = "P8_43";
			gpio = <&gpio2 8 0>;
			input;
			dir-changeable;
		};

		P8_44 {
			gpio-name = "P8_44";
			gpio = <&gpio2 9 0>;
			input;
			dir-changeable;
		};

		P8_45 {
			gpio-name = "P8_45";
			gpio = <&gpio2 6 0>;
			input;
			dir-changeable;
		};

		P8_46 {
			gpio-name = "P8_46";
			gpio = <&gpio2 7 0>;
			input;
			dir-changeable;
		};

		P9_11 {
			gpio-name = "P9_11";
			gpio = <&gpio0 30 0>;
			input;
			dir-changeable;
		};

		P9_12 {
			gpio-name = "P9_12";
			gpio = <&gpio1 28 0>;
			input;
			dir-changeable;
		};

		P9_13 {
			gpio-name = "P9_13";
			gpio = <&gpio0 31 0>;
			input;
			dir-changeable;
		};

		P9_14 {
			gpio-name = "P9_14";
			gpio = <&gpio1 18 0>;
			input;
			dir-changeable;
		};

		P9_15 {
			gpio-name = "P9_15";
			gpio = <&gpio1 16 0>;
			input;
			dir-changeable;
		};

		P9_16 {
			gpio-name = "P9_16";
			gpio = <&gpio1 19 0>;
			input;
			dir-changeable;
		};

		P9_17 {
			gpio-name = "P9_17";
			gpio = <&gpio0 5 0>;
			input;
			dir-changeable;
		};

		P9_18 {
			gpio-name = "P9_18";
			gpio = <&gpio0 4 0>;
			input;
			dir-changeable;
		};

		P9_19 {
			gpio-name = "P9_19";
			gpio = <&gpio0 13 0>;
			input;
			dir-changeable;
		};

		P9_20 {
			gpio-name = "P9_20";
			gpio = <&gpio0 12 0>;
			input;
			dir-changeable;
		};

		P9_21 {
			gpio-name = "P9_21";
			gpio = <&gpio0 3 0>;
			input;
			dir-changeable;
		};

		P9_22 {
			gpio-name = "P9_22";
			gpio = <&gpio0 2 0>;
			input;
			dir-changeable;
		};

		P9_23 {
			gpio-name = "P9_23";
			gpio = <&gpio1 17 0>;
			input;
			dir-changeable;
		};

		P9_24 {
			gpio-name = "P9_24";
			gpio = <&gpio0 15 0>;
			input;
			dir-changeable;
		};

		P9_25 {
			gpio-name = "P9_25";
			gpio = <&gpio3 21 0>;
			input;
			dir-changeable;
		};

		P9_26 {
			gpio-name = "P9_26";
			gpio = <&gpio0 14 0>;
			input;
			dir-changeable;
		};

		P9_27 {
			gpio-name = "P9_27";
			gpio = <&gpio3 19 0>;
			input;
			dir-changeable;
		};

		P9_28 {
			gpio-name = "P9_28";
			gpio = <&gpio3 17 0>;
			input;
			dir-changeable;
		};

		P9_29 {
			gpio-name = "P9_29";
			gpio = <&gpio3 15 0>;
			input;
			dir-changeable;
		};

		P9_31 {
			gpio-name = "P9_31";
			gpio = <&gpio3 14 0>;
			input;
			dir-changeable;
		};

		P9_41 {
			gpio-name = "P9_41";
			gpio = <&gpio0 20 0>;
			input;
			dir-changeable;
		};

		P9_91 {
			gpio-name = "P9_91";
			gpio = <&gpio3 20 0>;
			input;
			dir-changeable;
		};

		P9_42 {
			gpio-name = "P9_42";
			gpio = <&gpio0 7 0>;
			input;
			dir-changeable;
		};

		P9_92 {
			gpio-name = "P9_92";
			gpio = <&gpio3 18 0>;
			input;
			dir-changeable;
		};
	};
};
