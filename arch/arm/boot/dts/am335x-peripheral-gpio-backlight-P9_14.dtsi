/*
 * Copyright (C) 2012 Texas Instruments Incorporated - http://www.ti.com/
 *
 * This program is free software; you can redistribute it and/or modify
 * it under the terms of the GNU General Public License version 2 as
 * published by the Free Software Foundation.
 */

/ {
	backlight {
		status = "okay";
		compatible = "gpio-backlight";
		pinctrl-names = "default";


		default-on;
	};
};
