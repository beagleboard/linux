// SPDX-License-Identifier: GPL-2.0-only
/*
 * Copyright (C) 2012 Texas Instruments Incorporated - https://www.ti.com/
 */

#include <dt-bindings/board/am335x-bbw-bbb-base.h>
#include "am335x-peripheral-can1.dtsi"

/* cape universal */

/*
 *&ocp {
 *	P9_24_pinmux {
 *		mode = "can";
 *	};
 *	P9_26_pinmux {
 *		mode = "can";
 *	};
 *};
 *
 *&dcan1 {
 *	pinctrl-0 = <>;
 *};
 *
 */

/* standard */

&am33xx_pinmux {
	dcan1_pins: pinmux_dcan1_pins {
		pinctrl-single,pins = <
			/* P9_26: uart1_rxd.d_can1_tx */
			BONE_P9_26 (PIN_OUTPUT_PULLUP | MUX_MODE2)
			/* P9_24: uart1_txd.d_can1_rx */
			BONE_P9_24 (PIN_INPUT_PULLUP | MUX_MODE2)
		>;
	};
};

&dcan1 {
	pinctrl-0 = <&dcan1_pins>;
};
