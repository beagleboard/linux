## arch/riscv/configs/light_emu_defconfig
```kconfig
CONFIG_COMPILE_TEST=y
CONFIG_SYSVIPC=y
CONFIG_POSIX_MQUEUE=y
CONFIG_NO_HZ_IDLE=y
CONFIG_HIGH_RES_TIMERS=y
CONFIG_IKCONFIG=y
CONFIG_IKCONFIG_PROC=y
CONFIG_CGROUPS=y
CONFIG_NAMESPACES=y
CONFIG_USER_NS=y
CONFIG_CHECKPOINT_RESTORE=y
CONFIG_BLK_DEV_INITRD=y
CONFIG_EXPERT=y
# CONFIG_BUG is not set
CONFIG_BPF_SYSCALL=y
CONFIG_PERF_EVENTS=y
CONFIG_SOC_THEAD=y
CONFIG_SOC_THEAD_LIGHT_EMU=y
CONFIG_SOC_SIFIVE=y
CONFIG_SMP=y
CONFIG_HOTPLUG_CPU=y
CONFIG_KEXEC=y
CONFIG_CRASH_DUMP=y
CONFIG_MODULES=y
CONFIG_MODULE_UNLOAD=y
CONFIG_CMA=y
CONFIG_CMA_DEBUGFS=y
CONFIG_CMA_AREAS=16
CONFIG_NET=y
CONFIG_NVMEM_THEAD_LIGHT_EFUSE=y
CONFIG_PACKET=y
CONFIG_UNIX=y
CONFIG_INET=y
CONFIG_IP_MULTICAST=y
CONFIG_IP_ADVANCED_ROUTER=y
CONFIG_IP_PNP=y
CONFIG_IP_PNP_DHCP=y
CONFIG_IP_PNP_BOOTP=y
CONFIG_IP_PNP_RARP=y
CONFIG_NETLINK_DIAG=y
CONFIG_DEVTMPFS=y
CONFIG_DEVTMPFS_MOUNT=y
CONFIG_MTD=y
CONFIG_MTD_TESTS=m
CONFIG_MTD_BLOCK=y
CONFIG_MTD_SPI_NAND=y
CONFIG_MTD_SPI_NOR=y
CONFIG_MTD_UBI=y
CONFIG_BLK_DEV_LOOP=y
CONFIG_EEPROM_AT24=y
CONFIG_NETDEVICES=y
CONFIG_MACB=y
CONFIG_STMMAC_ETH=y
CONFIG_DWMAC_LIGHT=y
CONFIG_MICROSEMI_PHY=y
CONFIG_REALTEK_PHY=y
# CONFIG_WLAN is not set
CONFIG_NET_FAILOVER=y
CONFIG_INPUT_EVDEV=y
CONFIG_KEYBOARD_GPIO=y
# CONFIG_INPUT_MOUSE is not set
CONFIG_SERIAL_8250=y
# CONFIG_SERIAL_8250_DEPRECATED_OPTIONS is not set
CONFIG_SERIAL_8250_CONSOLE=y
CONFIG_SERIAL_8250_NR_UARTS=6
CONFIG_SERIAL_8250_RUNTIME_UARTS=6
CONFIG_SERIAL_8250_DW=y
CONFIG_SERIAL_OF_PLATFORM=y
CONFIG_SERIAL_EARLYCON_RISCV_SBI=y
CONFIG_HVC_RISCV_SBI=y
CONFIG_HW_RANDOM=y
CONFIG_I2C_CHARDEV=y
CONFIG_I2C_DESIGNWARE_PLATFORM=y
CONFIG_SPI=y
CONFIG_SPI_DW_QUAD=y
CONFIG_SPI_DESIGNWARE=y
CONFIG_SPI_DW_MMIO=y
CONFIG_SPI_SPIDEV=y
# CONFIG_PTP_1588_CLOCK is not set
CONFIG_PINCTRL=y
CONFIG_GPIOLIB=y
CONFIG_GPIO_SYSFS=y
CONFIG_GPIO_DWAPB=y
CONFIG_POWER_SUPPLY=y
CONFIG_WATCHDOG=y
CONFIG_DW_WATCHDOG=y
CONFIG_REGULATOR=y
CONFIG_REGULATOR_FIXED_VOLTAGE=y
CONFIG_MEDIA_SUPPORT=y
CONFIG_MEDIA_CAMERA_SUPPORT=y
CONFIG_MEDIA_DIGITAL_TV_SUPPORT=y
CONFIG_MEDIA_CONTROLLER=y
CONFIG_V4L_PLATFORM_DRIVERS=y
CONFIG_VIDEO_ASPEED=y
CONFIG_V4L_MEM2MEM_DRIVERS=y
CONFIG_DRM=y
CONFIG_DRM_PANEL_SIMPLE=y
CONFIG_DRM_VERISILICON=y
CONFIG_BACKLIGHT_CLASS_DEVICE=y
CONFIG_FRAMEBUFFER_CONSOLE=y
CONFIG_LOGO=y
CONFIG_SOUND=y
CONFIG_SND_DMAENGINE_PCM=y
CONFIG_SND_SOC_GENERIC_DMAENGINE_PCM=y
CONFIG_SND_SOC_BT_SCO=y
CONFIG_SND_SOC_THEAD_LIGHT=y
CONFIG_SND=y
CONFIG_SND_SOC=y
CONFIG_SND_SIMPLE_CARD_UTILS=y
CONFIG_SND_SIMPLE_CARD=y
CONFIG_SND_AUDIO_GRAPH_CARD=y
CONFIG_LIGHT_GPU_VIV=m
CONFIG_HID_PID=y
CONFIG_USB_HIDDEV=y
CONFIG_USB=y
CONFIG_USB_XHCI_HCD=y
CONFIG_USB_OHCI_HCD=y
CONFIG_USB_DWC3=y
CONFIG_USB_DWC3_GADGET=y
# CONFIG_USB_DWC3_OF_SIMPLE is not set
CONFIG_USB_GADGET=y
CONFIG_USB_ZERO=m
CONFIG_USB_ETH=m
CONFIG_USB_ETH_EEM=y
CONFIG_USB_G_NCM=m
CONFIG_USB_MASS_STORAGE=m
CONFIG_USB_G_SERIAL=m
CONFIG_USB_G_MULTI=m
CONFIG_USB_G_MULTI_CDC=y
CONFIG_MMC=y
CONFIG_MMC_SDHCI=y
CONFIG_MMC_SDHCI_PLTFM=y
CONFIG_MMC_SDHCI_OF_DWCMSHC=y
CONFIG_NEW_LEDS=y
CONFIG_LEDS_CLASS=y
CONFIG_LEDS_GPIO=y
CONFIG_RTC_CLASS=y
CONFIG_RTC_DRV_XGENE=y
CONFIG_DMADEVICES=y
CONFIG_DW_AXI_DMAC=y
CONFIG_DMATEST=y
CONFIG_SW_SYNC=y
CONFIG_UDMABUF=y
CONFIG_DMABUF_SELFTESTS=m
# CONFIG_VIRTIO_MENU is not set
CONFIG_HWSPINLOCK=y
CONFIG_HWSPINLOCK_LIGHT=y
CONFIG_HWSPINLOCK_LIGHT_TEST=m
CONFIG_MAILBOX=y
CONFIG_IIO=y
CONFIG_IIO_SW_DEVICE=y
CONFIG_GENERIC_PHY=y
CONFIG_EXT4_FS=y
CONFIG_EXT4_FS_POSIX_ACL=y
CONFIG_AUTOFS4_FS=y
CONFIG_FUSE_FS=y
CONFIG_MSDOS_FS=y
CONFIG_VFAT_FS=y
CONFIG_TMPFS=y
CONFIG_TMPFS_POSIX_ACL=y
CONFIG_JFFS2_FS=y
CONFIG_UBIFS_FS=y
CONFIG_NFS_FS=y
CONFIG_NFS_V4=y
CONFIG_NFS_V4_1=y
CONFIG_NFS_V4_2=y
CONFIG_ROOT_NFS=y
CONFIG_NLS_CODEPAGE_437=y
CONFIG_NLS_ISO8859_1=y
CONFIG_CRYPTO_AUTHENC=y
CONFIG_CRYPTO_RSA=y
CONFIG_CRYPTO_DH=y
CONFIG_CRYPTO_ECDH=y
CONFIG_CRYPTO_CURVE25519=y
CONFIG_CRYPTO_CHACHA20POLY1305=y
CONFIG_CRYPTO_OFB=y
CONFIG_CRYPTO_MD5=y
CONFIG_CRYPTO_SHA1=y
CONFIG_CRYPTO_SHA512=y
CONFIG_CRYPTO_SHA3=y
CONFIG_CRYPTO_SM3=y
CONFIG_CRYPTO_DES=y
CONFIG_CRYPTO_USER_API_HASH=y
CONFIG_DMA_CMA=y
CONFIG_DMA_PERNUMA_CMA=y
CONFIG_CMA_SIZE_MBYTES=32
CONFIG_PRINTK_TIME=y
CONFIG_DYNAMIC_DEBUG=y
CONFIG_DEBUG_INFO=y
CONFIG_DEBUG_FS=y
CONFIG_DETECT_HUNG_TASK=y
CONFIG_DEBUG_ATOMIC_SLEEP=y
# CONFIG_RCU_TRACE is not set
CONFIG_FORCE_MAX_ZONEORDER=15
```

## arch/riscv/kvm/Kconfig
```kconfig
# SPDX-License-Identifier: GPL-2.0
#
# KVM configuration
#

source "virt/kvm/Kconfig"

menuconfig VIRTUALIZATION
	bool "Virtualization"
	help
	  Say Y here to get to see options for using your Linux host to run
	  other operating systems inside virtual machines (guests).
	  This option alone does not add any kernel code.

	  If you say N, all options in this submenu will be skipped and
	  disabled.

if VIRTUALIZATION

config KVM
	tristate "Kernel-based Virtual Machine (KVM) support (EXPERIMENTAL)"
	depends on RISCV_SBI && MMU
	select MMU_NOTIFIER
	select PREEMPT_NOTIFIERS
	select ANON_INODES
	select KVM_MMIO
	select KVM_GENERIC_DIRTYLOG_READ_PROTECT
	select HAVE_KVM_VCPU_ASYNC_IOCTL
	select HAVE_KVM_EVENTFD
	select SRCU
	help
	  Support hosting virtualized guest machines.

	  If unsure, say N.

config	SOC_INT_SRC7
	bool "Kernel-based Heter Virtual Machine(KHV) Kick and Call supported by SOC_INT_SRC7"
	default y
	help
	 Say Y here to use soc interrupt src7 to support kick and call between
	 host and guest.

endif # VIRTUALIZATION
```

## drivers/cbus/Kconfig
```kconfig
#
# CBUS device configuration
#

menu "CBUS support"

config CBUS
	bool "CBUS support on OMAP"
	---help---
	  CBUS is a proprietary serial protocol by Nokia.  It is mainly
	  used for accessing Energy Management auxiliary chips.

	  If you want CBUS support, you should say Y here.

config CBUS_TAHVO
	depends on CBUS
	bool "Support for Tahvo"
	---help---
	  Tahvo is a mixed signal ASIC with some system features

	  If you want Tahvo support, you should say Y here.

if CBUS_TAHVO

config CBUS_TAHVO_USB
	depends on USB
	depends on ARCH_OMAP
	select USB_OTG_UTILS
	tristate "Support for Tahvo USB transceiver"
	---help---
	  If you want Tahvo support for USB transceiver, say Y or M here.

config CBUS_TAHVO_USB_HOST_BY_DEFAULT
	depends on CBUS_TAHVO_USB && USB_OTG
	boolean "Device in USB host mode by default"
	---help---
	  Say Y here, if you want the device to enter USB host mode
	  by default on bootup.

endif # CBUS_TAHVO

config CBUS_RETU
	depends on CBUS
	bool "Support for Retu"
	---help---
	  Retu is a mixed signal ASIC with some system features

	  If you want Retu support, you should say Y here.

if CBUS_RETU

config CBUS_RETU_POWERBUTTON
	depends on INPUT
	bool "Support for Retu power button"
	---help---
	  The power button on Nokia 770 is connected to the Retu ASIC.

	  If you want support for the Retu power button, you should say Y here.

config CBUS_RETU_RTC
	depends on RTC_CLASS
	depends on ARCH_OMAP
	tristate "Support for Retu pseudo-RTC"
	---help---
	  Say Y here if you want support for the device that alleges to be an
	  RTC in Retu. This will expose a sysfs interface for it.

config CBUS_RETU_WDT
	depends on SYSFS && WATCHDOG
	depends on ARCH_OMAP
	tristate "Support for Retu watchdog timer"
	---help---
	  Say Y here if you want support for the watchdog in Retu. This will
	  expose a sysfs interface to grok it.

config CBUS_RETU_HEADSET
	depends on SYSFS
	tristate "Support for headset detection with Retu/Vilma"
	---help---
	  Say Y here if you want support detecting a headset that's connected
	  to Retu/Vilma. Detection state and events are exposed through
	  sysfs.

endif # CBUS_RETU

endmenu
```

## drivers/clk/thead/Kconfig
```kconfig
# SPDX-License-Identifier: GPL-2.0

config THEAD_CLK
	bool
	def_bool SOC_THEAD

config CLK_LIGHT_MPW
	bool "Thead Light MPW Clock Driver"
	depends on SOC_THEAD
	default n
	help
	    Build the driver for light mpw Clock Driver

config CLK_LIGHT_FM
	bool "Thead Light Fullmask Clock Driver"
	depends on SOC_THEAD
	default n
	help
	    Build the driver for light fullmask Clock Driver
```

## drivers/cpuidle/Kconfig.riscv
```kconfig
# SPDX-License-Identifier: GPL-2.0-only
#
# RISCV CPU Idle Drivers
#
config LIGHT_CPUIDLE
	bool "Cpuidle driver for Thead light platforms"
	depends on CPU_IDLE
	depends on SOC_THEAD
	default y
	help
	  Select this option to enable processor idle state management
	  through cpuidle subsystem.
```

## drivers/crypto/ti/Kconfig
```kconfig
# SPDX-License-Identifier: GPL-2.0-only
config CRYPTO_DEV_TI_MCRC64
	tristate "Texas Instruments MCRC64 engine support"
	depends on ARCH_K3 || COMPILE_TEST
	select CRYPTO_HASH
	select CRYPTO_CRC64_ISO3309
	help
	  This enables support for the MCRC64 engine
	  which can be found on all AM62* and J722S devices.
	  MCRC64 engine calculates 64-bit cyclic redundancy checks (CRC)
	  according to the ISO 3309 standard.

config CRYPTO_DEV_TI_DTHEV2
	tristate "Support for TI DTHE V2 crypto accelerators"
	depends on CRYPTO && CRYPTO_HW && ARCH_K3
	select CRYPTO_SKCIPHER
	select CRYPTO_SHA256
	select CRYPTO_SHA512
	select CRYPTO_MD5
	help
	  This enables support for the TI DTHE V2 hw crypto accelerator
	  which can be found on TI K3 SOCs. Selecting this enables use
	  of hardware acceleration for cryptographic algorithms on
	  these devices.
```

## drivers/dma-buf/heaps/Kconfig
```kconfig
config DMABUF_HEAPS_SYSTEM
	bool "DMA-BUF System Heap"
	depends on DMABUF_HEAPS
	help
	  Choose this option to enable the system dmabuf heap. The system heap
	  is backed by pages from the buddy allocator. If in doubt, say Y.

config DMABUF_HEAPS_CMA
	bool "DMA-BUF CMA Heap"
	depends on DMABUF_HEAPS && DMA_CMA
	help
	  Choose this option to enable dma-buf CMA heap. This heap is backed
	  by the Contiguous Memory Allocator (CMA). If your system has these
	  regions, you should say Y here.

config DMABUF_HEAPS_CARVEOUT
	bool "DMA-BUF Carveout Heap"
	depends on DMABUF_HEAPS && HAS_IOMEM
	depends on OF_RESERVED_MEM
	select GENERIC_ALLOCATOR
	help
	  Choose this option to enable dma-buf Carveout heap. This heap is
	  backed by the a carved-out of memory. If your system has these
	  regions, you should say Y here.
```

## drivers/dsp/dspgateway/Kconfig
```kconfig
config OMAP_DSP
	tristate "OMAP DSP driver (DSP Gateway)"
	depends on ARCH_OMAP15XX || ARCH_OMAP16XX || ARCH_OMAP24XX
	select OMAP_MMU_FWK
	select OMAP_MBOX_FWK
	help
	  This enables OMAP DSP driver, DSP Gateway.

config OMAP_DSP_MBCMD_VERBOSE
	bool "Mailbox Command Verbose LOG"
	depends on OMAP_DSP
	help
          This enables kernel log output in the Mailbox command exchanges
	  in the DSP Gateway driver.

config OMAP_DSP_FBEXPORT
	bool "Framebuffer export to DSP"
	depends on OMAP_DSP && FB
	help
          This enables to map the frame buffer to DSP.
	  By doing this, DSP can access the frame buffer directly without
	  bothering ARM.
```

## drivers/firmware/thead/Kconfig
```kconfig
# SPDX-License-Identifier: GPL-2.0-only
config LIGHT_AON
	bool "Thead Light Aon Protocol driver"
	depends on THEAD_LIGHT_MBOX
	default y
	help
	  Thead light Aon is a low-level system function which runs a dedicated
	  thead riscv E902 core to provide power, clock and resource management.

	  This driver manages the IPC interface between host cpu liks thead
	  and the Aon firmware running on thead riscv E902 core.

config LIGHT_AON_PD
	bool "Thead Light Aon Power Domain driver"
	depends on LIGHT_AON
	select PM_GENERIC_DOMAINS if PM
	help
	  The Aon power domain virtual driver.
```

## drivers/gpu-viv/Kconfig
```kconfig
menu "Light Vivante GPU support"

config LIGHT_GPU_VIV
        tristate "Light Vivante GPU support"
        help
         Add Vivante GPU driver support for Thead Light platform.
endmenu
```

## drivers/gpu/drm/img-rogue/Kconfig
```kconfig
config DRM_POWERVR_ROGUE
	tristate "PowerVR Rogue"
	depends on HAS_IOMEM
	depends on DRM
	select DRM_KMS_HELPER
	select DRM_POWERVR_APOLLO
	select PM_DEVFREQ
	select DEVFREQ_GOV_SIMPLE_ONDEMAND
	select PM_OPP
	select DEVFREQ_THERMAL
	help
	  Driver for PowerVR Rogue graphics hardware.

	  Say Y here if your SoC contains a PowerVR Rogue GPU. For more
	  information, see <http://www.imgtec.com/powervr/>.

config DRM_POWERVR_ROGUE_DEBUG
	bool "Enable PowerVR Rogue debug features"
	depends on DRM_POWERVR_ROGUE
	default n
	help
	  Add additional debug features to the PowerVR Rogue driver.
	  To build a matching userspace, enable the following build options:
	  BUILD=debug SUPPORT_PAGE_FAULT_DEBUG=1 PVRSRV_ENABLE_GPU_MEMORY_INFO=1

config DRM_POWERVR_PDP
	tristate "DRM Support for PowerVR PDP for Testchip"
	depends on DRM
	select DRM_KMS_HELPER
	select DRM_POWERVR_APOLLO
	help
	  Choose this option if you have a PowerVR Apollo-based testchip.
	  Containing a PDP.

config DRM_POWERVR_APOLLO
	tristate "PowerVR Apollo test chip support"
	depends on X86
	default n
```

## drivers/gpu/drm/omapdrm/Kconfig
```kconfig
# SPDX-License-Identifier: GPL-2.0-only
config DRM_OMAP
	tristate "OMAP DRM"
	depends on DRM
	depends on ARCH_OMAP2PLUS || ARCH_MULTIPLATFORM
	select OMAP2_DSS
	select DRM_KMS_HELPER
	default n
	help
	  DRM display driver for OMAP2/3/4 based boards.

if DRM_OMAP

config DRM_OMAP_WB
	bool "Enable writeback support for OMAP DRM driver"
	depends on DRM_OMAP
	depends on (VIDEO_V4L2 = y) || (VIDEO_V4L2 = m && DRM_OMAP = m)
	depends on VIDEO_DEV && HAS_DMA
	select VIDEOBUF2_DMA_CONTIG
	select V4L2_MEM2MEM_DEV
	default n
	help
	  Select this to enable memory-to-memory/capture writeback support.

source "drivers/gpu/drm/omapdrm/dss/Kconfig"
source "drivers/gpu/drm/omapdrm/displays/Kconfig"

endif
```
