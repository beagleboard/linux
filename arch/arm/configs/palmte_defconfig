## arch/arm/mach-omap2/Kconfig
```kconfig
comment "OMAP Core Type"
	depends on ARCH_OMAP2

config ARCH_OMAP24XX
	bool "OMAP24xx Based System"
	depends on ARCH_OMAP2

config ARCH_OMAP2420
	bool "OMAP2420 support"
	depends on ARCH_OMAP24XX
	select OMAP_DM_TIMER
	select ARCH_OMAP_OTG
	select CPU_V6

config ARCH_OMAP2430
	bool "OMAP2430 support"
	depends on ARCH_OMAP24XX
	select ARCH_OMAP_OTG
	select CPU_V6

config ARCH_OMAP34XX
	bool "OMAP34xx Based System"
	depends on ARCH_OMAP3

config ARCH_OMAP3430
	bool "OMAP3430 support"
	depends on ARCH_OMAP3 && ARCH_OMAP34XX
	select ARCH_OMAP_OTG
	select CPU_V7

comment "OMAP Board Type"
	depends on ARCH_OMAP2 || ARCH_OMAP3 || ARCH_OMAP4

config MACH_OMAP_GENERIC
	bool "Generic OMAP board"
	depends on ARCH_OMAP2 && ARCH_OMAP24XX

config MACH_NOKIA_RX51
	bool "Nokia RX-51 board"
	depends on ARCH_OMAP3 && ARCH_OMAP34XX

config MACH_OMAP2_TUSB6010
	bool
	depends on ARCH_OMAP2 && ARCH_OMAP2420
	default y if MACH_NOKIA_N800

config MACH_OMAP_H4
	bool "OMAP 2420 H4 board"
	depends on ARCH_OMAP2 && ARCH_OMAP2420
	select OMAP_DEBUG_DEVICES

config MACH_OMAP_H4_TUSB
	bool "TUSB 6010 EVM board"
	depends on MACH_OMAP_H4
	select MACH_OMAP2_TUSB6010
	help
	  Set this if you've got a TUSB6010 high speed USB board.
	  You may need to consult the schematics for your revisions
	  of the Menelaus and TUSB boards, and make changes to be
	  sure this is set up properly for your board stack.

	  Be sure to select OTG mode operation, not host-only or
	  peripheral-only.

config MACH_OMAP_H4_OTG
	bool "Use USB OTG connector, not device connector (S1.10)"
	depends on MACH_OMAP_H4
	help
	  Set this if you've set S1.10 (on the mainboard) to use the
	  Mini-AB (OTG) connector and OTG transceiver with the USB0
	  port, instead of the Mini-B ("download") connector with its
	  non-OTG transceiver.

	  Note that the "download" connector can be used to bootstrap
	  the system from the OMAP mask ROM.  Also, since this is a
	  development platform, you can also force the OTG port into
	  a non-OTG operational mode.

config MACH_OMAP2_H4_USB1
	bool "Use USB1 port, not UART2 (S3.3)"
	depends on MACH_OMAP_H4
	help
	  Set this if you've set SW3.3 (on the CPU card) so that the
	  expansion connectors receive USB1 signals instead of UART2.

config MACH_OMAP_APOLLON
	bool "OMAP 2420 Apollon board"
	depends on ARCH_OMAP2 && ARCH_OMAP2420

config MACH_OMAP_2430SDP
	bool "OMAP 2430 SDP board"
	depends on ARCH_OMAP2 && ARCH_OMAP2430

config MACH_OMAP_LDP
	bool "OMAP3 LDP board"
	depends on ARCH_OMAP3 && ARCH_OMAP34XX

config MACH_OMAP2EVM 
	bool "OMAP 2530 EVM board"
	depends on ARCH_OMAP2 && ARCH_OMAP24XX

config MACH_OMAP_3430SDP
	bool "OMAP 3430 SDP board"
	depends on ARCH_OMAP3 && ARCH_OMAP34XX

config MACH_OMAP3EVM
	bool "OMAP 3530 EVM board"
	depends on ARCH_OMAP3 && ARCH_OMAP34XX

config MACH_OMAP3_BEAGLE
	bool "OMAP3 BEAGLE board"
	depends on ARCH_OMAP3 && ARCH_OMAP34XX

config MACH_OVERO
	bool "Gumstix Overo board"
	depends on ARCH_OMAP3 && ARCH_OMAP34XX

config MACH_OMAP3_PANDORA
	bool "OMAP3 Pandora"
	depends on ARCH_OMAP3 && ARCH_OMAP34XX

config MACH_OMAP_ZOOM2
	bool "OMAP3 Zoom2 board"
	depends on ARCH_OMAP3 && ARCH_OMAP34XX

config MACH_OMAP_4430SDP
	bool "OMAP 4430 SDP board"
	depends on ARCH_OMAP4
```

## arch/arm/plat-omap/Kconfig
```kconfig
if ARCH_OMAP

menu "TI OMAP Implementations"

config ARCH_OMAP_OTG
	bool

choice
	prompt "OMAP System Type"
	default ARCH_OMAP1

config ARCH_OMAP1
	bool "TI OMAP1"
	select GENERIC_CLOCKEVENTS

config ARCH_OMAP2
	bool "TI OMAP2"

endchoice

comment "OMAP Feature Selections"

config OMAP_DEBUG_DEVICES
	bool
	help
	  For debug cards on TI reference boards.

config OMAP_DEBUG_LEDS
	bool
	depends on OMAP_DEBUG_DEVICES
	default y if LEDS || LEDS_OMAP_DEBUG

config OMAP_RESET_CLOCKS
	bool "Reset unused clocks during boot"
	depends on ARCH_OMAP
	help
	  Say Y if you want to reset unused clocks during boot.
	  This option saves power, but assumes all drivers are
	  using the clock framework. Broken drivers that do not
	  yet use clock framework may not work with this option.
	  If you are booting from another operating system, you
	  probably do not want this option enabled until your
	  device drivers work properly.

config OMAP_BOOT_TAG
	bool "OMAP bootloader information passing"
        depends on ARCH_OMAP
        default n
        help
          Say Y, if you have a bootloader which passes information
          about your board and its peripheral configuration.

config OMAP_BOOT_REASON
	bool "Support for boot reason"
        depends on OMAP_BOOT_TAG
        default n
        help
          Say Y, if you want to have a procfs entry for reading the boot
          reason in user-space.

config OMAP_COMPONENT_VERSION
	bool "Support for component version display"
	depends on OMAP_BOOT_TAG && PROC_FS
	default n
	help
	  Say Y, if you want to have a procfs entry for reading component
	  versions (supplied by the bootloader) in user-space.

config OMAP_GPIO_SWITCH
	bool "GPIO switch support"
        default n
        help
          Say Y, if you want to have support for reporting of GPIO
          switches (e.g. cover switches) via sysfs. Your bootloader has
          to provide information about the switches to the kernel via the
          ATAG_BOARD mechanism if they're not defined by the board config.

config OMAP_MUX
	bool "OMAP multiplexing support"
        depends on ARCH_OMAP
	default y
        help
          Pin multiplexing support for OMAP boards. If your bootloader
          sets the multiplexing correctly, say N. Otherwise, or if unsure,
          say Y.

config OMAP_MUX_DEBUG
	bool "Multiplexing debug output"
        depends on OMAP_MUX
        help
          Makes the multiplexing functions print out a lot of debug info.
          This is useful if you want to find out the correct values of the
          multiplexing registers.

config OMAP_MUX_WARNINGS
	bool "Warn about pins the bootloader didn't set up"
        depends on OMAP_MUX
        default y
        help
	  Choose Y here to warn whenever driver initialization logic needs
	  to change the pin multiplexing setup.  When there are no warnings
	  printed, it's safe to deselect OMAP_MUX for your product.

config OMAP_STI
	bool "STI/XTI support"
	depends on ARCH_OMAP16XX || ARCH_OMAP24XX
	default n

config OMAP_STI_CONSOLE
	bool "STI console support"
	depends on OMAP_STI
	help
	  This enables a console driver by way of STI/XTI.

config OMAP_MCBSP
	bool "McBSP support"
	depends on ARCH_OMAP
	default y
	help
	  Say Y here if you want support for the OMAP Multichannel
	  Buffered Serial Port.

config OMAP_MMU_FWK
	tristate "MMU framework support"
	depends on ARCH_OMAP
	default n
	help
	  Say Y here if you want to use OMAP MMU framework support for
	  DSP, IVA1.0 and Camera in OMAP1/2.

config OMAP_MBOX_FWK
	tristate "Mailbox framework support"
	depends on ARCH_OMAP
	default n
	help
	  Say Y here if you want to use OMAP Mailbox framework support for
	  DSP and IVA1.0 in OMAP1/2.

choice
        prompt "System timer"
	default OMAP_MPU_TIMER

config OMAP_MPU_TIMER
	bool "Use mpu timer"
	help
	  Select this option if you want to use the OMAP mpu timer. This
	  timer provides more intra-tick resolution than the 32KHz timer,
	  but consumes more power.

config OMAP_32K_TIMER
	bool "Use 32KHz timer"
	depends on ARCH_OMAP16XX || ARCH_OMAP24XX
	select GENERIC_TIME
	select GENERIC_CLOCKEVENTS
	help
	  Select this option if you want to enable the OMAP 32KHz timer.
	  This timer saves power compared to the OMAP_MPU_TIMER, and has
	  support for no tick during idle. The 32KHz timer provides less
	  intra-tick resolution than OMAP_MPU_TIMER. The 32KHz timer is
	  currently only available for OMAP16XX and 24XX.

endchoice

config OMAP_32K_TIMER_HZ
       int "Kernel internal timer frequency for 32KHz timer"
       range 32 1024
       depends on OMAP_32K_TIMER
       default "128"
       help
	  Kernel internal timer frequency should be a divisor of 32768,
	  such as 64 or 128.

config OMAP_DM_TIMER
	bool "Use dual-mode timer"
	depends on ARCH_OMAP16XX || ARCH_OMAP24XX
	help
	 Select this option if you want to use OMAP Dual-Mode timers.

choice
	prompt "Low-level debug console UART"
	depends on ARCH_OMAP
	default OMAP_LL_DEBUG_UART1

config OMAP_LL_DEBUG_UART1
	bool "UART1"

config OMAP_LL_DEBUG_UART2
	bool "UART2"

config OMAP_LL_DEBUG_UART3
	bool "UART3"

endchoice

config OMAP_SERIAL_WAKE
	bool "Enable wake-up events for serial ports"
	depends on OMAP_MUX
	default y
	help
	  Select this option if you want to have your system wake up
	  to data on the serial RX line. This allows you to wake the
	  system from serial console.

source "arch/arm/plat-omap/dsp/Kconfig"

endmenu

endif
```

## arch/arm/plat-omap/dsp/Kconfig
```kconfig
config OMAP_DSP
	tristate "OMAP DSP driver (DSP Gateway)"
	depends on ARCH_OMAP15XX || ARCH_OMAP16XX || ARCH_OMAP24XX
	help
	  This enables OMAP DSP driver, DSP Gateway.

config OMAP_DSP_MBCMD_VERBOSE
	bool "Mailbox Command Verbose LOG"
	depends on OMAP_DSP
	help
          This enables kernel log output in the Mailbox command exchanges
	  in the DSP Gateway driver.

config OMAP_DSP_TASK_MULTIOPEN
	bool "DSP Task Multiopen Capability"
	depends on OMAP_DSP
	help
          This enables DSP tasks to be opened by multiple times at a time.
	  Otherwise, they can be opened only once at a time.

config OMAP_DSP_FBEXPORT
	bool "Framebuffer export to DSP"
	depends on OMAP_DSP
	help
          This enables to map the frame buffer to DSP.
	  By doing this, DSP can access the frame buffer directly without
	  bothering ARM.
```

## arch/arm/xenomai/Kconfig
```kconfig
source "kernel/xenomai/Kconfig"
source "drivers/xenomai/Kconfig"

menu "Machine/platform-specific options"

config XENO_ARCH_UNLOCKED_SWITCH
	bool "Unlocked context switch"
	default y
	help
	The Cobalt core may allow non-atomic execution of the
	machine-dependent context switching code, so that other CPUs
	and/or local interrupts may execute concurrently.

	This option reduces interrupt latency when costly cache and
	TLB flushes are required to switch context.

	You definitely want to enable that option on low-end ARM
	platforms.
endmenu

config IPIPE_WANT_PREEMPTIBLE_SWITCH
	bool
	default y if XENO_ARCH_UNLOCKED_SWITCH
	default n if !XENO_ARCH_UNLOCKED_SWITCH

config XENO_ARCH_FPU
	def_bool VFP

config XENO_ARCH_SYS3264
        def_bool n

config XENO_ARCH_OUTOFLINE_XNLOCK
       bool
       default y
```
